//---------------------------------------------------------------------------------------------------------------------*
//                                                                                                                     *
//                                               File 'galgas_prgm.cpp'                                                *
//                                             Generated by version 3.0.0                                              *
//                                           october 5th, 2014, at 17h7'30"                                            *
//                                                                                                                     *
//---------------------------------------------------------------------------------------------------------------------*

//--- START OF USER ZONE 1


//--- END OF USER ZONE 1

#include "project_header.h"
#include "command_line_interface/F_mainForLIBPM.h"
#include "command_line_interface/F_Analyze_CLI_Options.h"
#include "utilities/F_DisplayException.h"
#include "galgas2/C_galgas_CLI_Options.h"
#include "galgas_prgm.h"
#include "lexiqueLL1grammar.h"
#include "galgas_cli_options.h"
#include "optionLL1grammar.h"
#include "guiGrammar.h"
#include "grammarLL1grammar.h"
#include "syntaxSLRgrammar.h"
#include "templateGrammar.h"
#include "semanticsSLRgrammar.h"
#include "programSLRgrammar.h"
#include "projectLL1grammar.h"
#include "galgas3ProjectGrammar.h"
#include "galgas3Grammar.h"

//---------------------------------------------------------------------------------------------------------------------*
//                                                                                                                     *
//                      print_tool_help_message                                                                        *
//                                                                                                                     *
//---------------------------------------------------------------------------------------------------------------------*

static void print_tool_help_message (void) {
  co << "Compiled with GALGAS revision NUMERO_REVISION_GALGAS\n" ;
}

//---------------------------------------------------------------------------------------------------------------------*

static const char * kSourceFileExtensions [] = {
  "gTemplate",
  "gOption",
  "gLexique",
  "gSemantics",
  "gSyntax",
  "gGrammar",
  "gGui",
  "gProgram",
  "gProject",
  "galgasProject",
  "galgas",
  NULL
} ;    

//---------------------------------------------------------------------------------------------------------------------*

static const char * kSourceFileHelpMessages [] = {
  "a GALGAS Template source file",
  "a GALGAS option source file",
  "a GALGAS lexique source file",
  "a GALGAS semantics source file",
  "a GALGAS syntax source file",
  "a GALGAS grammar source file",
  "a GALGAS GUI source file",
  "a GALGAS program source file",
  "a GALGAS project source file",
  "a GALGAS project source file",
  "a GALGAS source file",
  NULL
} ;    

//---------------------------------------------------------------------------------------------------------------------*

#ifndef DO_NOT_GENERATE_CHECKINGS
  static const char * kVersionString = "version " PROJECT_VERSION_STRING " [debug]" ;
#else
  static const char * kVersionString = "version " PROJECT_VERSION_STRING ;
#endif

//---------------------------------------------------------------------------------------------------------------------*
//                                                                                                                     *
//                                              Routine 'compileProject'                                               *
//                                                                                                                     *
//---------------------------------------------------------------------------------------------------------------------*

void routine_compileProject (const GALGAS_lstring constinArgument_inProjectSourceFile,
                             const GALGAS_string constinArgument_inSourceToAnalyze,
                             C_Compiler * inCompiler
                             COMMA_UNUSED_LOCATION_ARGS) {
  const enumGalgasBool test_0 = GALGAS_bool (gOption_galgas_5F_builtin_5F_options_verbose_5F_output.reader_value ()).boolEnum () ;
  if (kBoolTrue == test_0) {
    inCompiler->printMessage (GALGAS_string ("*** Parsing project files\n")  COMMA_SOURCE_FILE ("galgas_prgm.gProgram", 543)) ;
  }
  GALGAS_galgas_33_ProjectComponentAST var_projectComponentAST ;
  var_projectComponentAST.drop () ;
  cGrammar_galgas_33_ProjectGrammar::_performSourceFileParsing_ (inCompiler, constinArgument_inProjectSourceFile, var_projectComponentAST  COMMA_SOURCE_FILE ("galgas_prgm.gProgram", 545)) ;
  GALGAS_galgas_33_DeclarationAST var_declarationAST = GALGAS_galgas_33_DeclarationAST::constructor_default (SOURCE_FILE ("galgas_prgm.gProgram", 548)) ;
  cEnumerator_lstringlist enumerator_23843 (var_projectComponentAST.mAttribute_mProjectSourceList, kEnumeration_up) ;
  while (enumerator_23843.hasCurrentObject ()) {
    const enumGalgasBool test_1 = GALGAS_bool (kIsEqual, enumerator_23843.current_mValue (HERE).mAttribute_string.reader_pathExtension (SOURCE_FILE ("galgas_prgm.gProgram", 550)).objectCompare (GALGAS_string ("galgas"))).boolEnum () ;
    if (kBoolTrue == test_1) {
      GALGAS_string var_absoluteSourcePath = enumerator_23843.current_mValue (HERE).mAttribute_string.reader_absolutePathFromPath (constinArgument_inProjectSourceFile.mAttribute_string.reader_stringByDeletingLastPathComponent (SOURCE_FILE ("galgas_prgm.gProgram", 551)) COMMA_SOURCE_FILE ("galgas_prgm.gProgram", 551)) ;
      cGrammar_galgas_33_Grammar::_performSourceFileParsing_ (inCompiler, GALGAS_lstring::constructor_new (var_absoluteSourcePath, enumerator_23843.current_mValue (HERE).mAttribute_location  COMMA_SOURCE_FILE ("galgas_prgm.gProgram", 552)), var_declarationAST  COMMA_SOURCE_FILE ("galgas_prgm.gProgram", 552)) ;
    }else if (kBoolFalse == test_1) {
      GALGAS_location location_2 (enumerator_23843.current_mValue (HERE).reader_location (HERE)) ; // Implicit use of 'location' reader
      inCompiler->emitSemanticError (location_2, GALGAS_string ("only \".galgas\" extension is allowed here")  COMMA_SOURCE_FILE ("galgas_prgm.gProgram", 554)) ;
    }
    enumerator_23843.gotoNextObject () ;
  }
  GALGAS_stringlist var_handCodedLinkAppFileList = GALGAS_stringlist::constructor_emptyList (SOURCE_FILE ("galgas_prgm.gProgram", 558)) ;
  GALGAS_stringlist var_handCodedSourceAppFileList = GALGAS_stringlist::constructor_emptyList (SOURCE_FILE ("galgas_prgm.gProgram", 559)) ;
  GALGAS_stringlist var_handCodedSourceToolFileList = GALGAS_stringlist::constructor_emptyList (SOURCE_FILE ("galgas_prgm.gProgram", 560)) ;
  GALGAS_stringlist var_handCodedLinkToolFileList = GALGAS_stringlist::constructor_emptyList (SOURCE_FILE ("galgas_prgm.gProgram", 561)) ;
  GALGAS_stringset var_handCodedSourceDirectorySet = GALGAS_stringset::constructor_emptySet (SOURCE_FILE ("galgas_prgm.gProgram", 562)) ;
  cEnumerator_galgas_33_QualifiedFeatureList enumerator_24647 (var_projectComponentAST.mAttribute_mQualifiedFeatureList, kEnumeration_up) ;
  while (enumerator_24647.hasCurrentObject ()) {
    const enumGalgasBool test_3 = GALGAS_bool (kIsEqual, enumerator_24647.current_mFeatureName (HERE).mAttribute_string.objectCompare (GALGAS_string ("tool-source"))).boolEnum () ;
    if (kBoolTrue == test_3) {
      var_handCodedSourceToolFileList.addAssign_operation (enumerator_24647.current_mFeatureValue (HERE).mAttribute_string.reader_lastPathComponent (SOURCE_FILE ("galgas_prgm.gProgram", 565))  COMMA_SOURCE_FILE ("galgas_prgm.gProgram", 565)) ;
      GALGAS_string var_directory = enumerator_24647.current_mFeatureValue (HERE).mAttribute_string.reader_stringByDeletingLastPathComponent (SOURCE_FILE ("galgas_prgm.gProgram", 566)) ;
      const enumGalgasBool test_4 = GALGAS_bool (kIsNotEqual, var_directory.objectCompare (GALGAS_string::makeEmptyString ())).boolEnum () ;
      if (kBoolTrue == test_4) {
        var_handCodedSourceDirectorySet.addAssign_operation (GALGAS_string ("../").add_operation (var_directory, inCompiler COMMA_SOURCE_FILE ("galgas_prgm.gProgram", 568))  COMMA_SOURCE_FILE ("galgas_prgm.gProgram", 568)) ;
      }
    }else if (kBoolFalse == test_3) {
      const enumGalgasBool test_5 = GALGAS_bool (kIsEqual, enumerator_24647.current_mFeatureName (HERE).mAttribute_string.objectCompare (GALGAS_string ("app-source"))).boolEnum () ;
      if (kBoolTrue == test_5) {
        var_handCodedSourceAppFileList.addAssign_operation (enumerator_24647.current_mFeatureValue (HERE).mAttribute_string.reader_lastPathComponent (SOURCE_FILE ("galgas_prgm.gProgram", 571))  COMMA_SOURCE_FILE ("galgas_prgm.gProgram", 571)) ;
        GALGAS_string var_directory = enumerator_24647.current_mFeatureValue (HERE).mAttribute_string.reader_stringByDeletingLastPathComponent (SOURCE_FILE ("galgas_prgm.gProgram", 572)) ;
        const enumGalgasBool test_6 = GALGAS_bool (kIsNotEqual, var_directory.objectCompare (GALGAS_string::makeEmptyString ())).boolEnum () ;
        if (kBoolTrue == test_6) {
          var_handCodedSourceDirectorySet.addAssign_operation (GALGAS_string ("../").add_operation (var_directory, inCompiler COMMA_SOURCE_FILE ("galgas_prgm.gProgram", 574))  COMMA_SOURCE_FILE ("galgas_prgm.gProgram", 574)) ;
        }
      }else if (kBoolFalse == test_5) {
        const enumGalgasBool test_7 = GALGAS_bool (kIsEqual, enumerator_24647.current_mFeatureName (HERE).mAttribute_string.objectCompare (GALGAS_string ("tool-link"))).boolEnum () ;
        if (kBoolTrue == test_7) {
          var_handCodedLinkToolFileList.addAssign_operation (enumerator_24647.current_mFeatureValue (HERE).mAttribute_string  COMMA_SOURCE_FILE ("galgas_prgm.gProgram", 577)) ;
        }else if (kBoolFalse == test_7) {
          const enumGalgasBool test_8 = GALGAS_bool (kIsEqual, enumerator_24647.current_mFeatureName (HERE).mAttribute_string.objectCompare (GALGAS_string ("app-link"))).boolEnum () ;
          if (kBoolTrue == test_8) {
            var_handCodedLinkAppFileList.addAssign_operation (enumerator_24647.current_mFeatureValue (HERE).mAttribute_string  COMMA_SOURCE_FILE ("galgas_prgm.gProgram", 579)) ;
          }
        }
      }
    }
    enumerator_24647.gotoNextObject () ;
  }
  {
  routine_groupSyntaxComponentsGalgas_33_ (var_declarationAST.mAttribute_mSyntaxComponentList, var_declarationAST.mAttribute_mDeclarationList, inCompiler  COMMA_SOURCE_FILE ("galgas_prgm.gProgram", 595)) ;
  }
  GALGAS_string var_productDirectory = constinArgument_inProjectSourceFile.mAttribute_string.reader_stringByDeletingLastPathComponent (SOURCE_FILE ("galgas_prgm.gProgram", 600)).operator_concat (GALGAS_string ("/build/output")  COMMA_SOURCE_FILE ("galgas_prgm.gProgram", 600)) ;
  GALGAS_stringlist var_appProductFileList = GALGAS_stringlist::constructor_emptyList (SOURCE_FILE ("galgas_prgm.gProgram", 601)) ;
  GALGAS_semanticContext var_semanticContext = GALGAS_semanticContext::constructor_default (SOURCE_FILE ("galgas_prgm.gProgram", 602)) ;
  GALGAS_semanticDeclarationSortedListForGeneration var_semanticDeclarationSortedListForGeneration ;
  const enumGalgasBool test_9 = GALGAS_bool (kIsEqual, GALGAS_uint::constructor_errorCount (SOURCE_FILE ("galgas_prgm.gProgram", 604)).objectCompare (GALGAS_uint ((uint32_t) 0U))).boolEnum () ;
  if (kBoolTrue == test_9) {
    {
    routine_compileSemanticDeclarationsGalgas_33_ (var_productDirectory, var_projectComponentAST.mAttribute_mEndOfSourceFile, var_declarationAST.mAttribute_mDeclarationList, var_semanticContext, var_semanticDeclarationSortedListForGeneration, inCompiler  COMMA_SOURCE_FILE ("galgas_prgm.gProgram", 605)) ;
    }
  }else if (kBoolFalse == test_9) {
    var_semanticDeclarationSortedListForGeneration = GALGAS_semanticDeclarationSortedListForGeneration::constructor_emptySortedList (SOURCE_FILE ("galgas_prgm.gProgram", 613)) ;
  }
  GALGAS_optionComponentMapForGeneration var_optionComponentMapForGeneration ;
  const enumGalgasBool test_10 = GALGAS_bool (kIsEqual, GALGAS_uint::constructor_errorCount (SOURCE_FILE ("galgas_prgm.gProgram", 617)).objectCompare (GALGAS_uint ((uint32_t) 0U))).boolEnum () ;
  if (kBoolTrue == test_10) {
    {
    routine_compileAllGuiComponentFromASTGalgas_33_ (var_declarationAST.mAttribute_mGUIComponentList, var_semanticContext, var_optionComponentMapForGeneration, inCompiler  COMMA_SOURCE_FILE ("galgas_prgm.gProgram", 618)) ;
    }
  }else if (kBoolFalse == test_10) {
    var_optionComponentMapForGeneration = GALGAS_optionComponentMapForGeneration::constructor_emptyMap (SOURCE_FILE ("galgas_prgm.gProgram", 624)) ;
  }
  const enumGalgasBool test_11 = GALGAS_bool (kIsEqual, GALGAS_uint::constructor_errorCount (SOURCE_FILE ("galgas_prgm.gProgram", 627)).objectCompare (GALGAS_uint ((uint32_t) 0U))).boolEnum () ;
  if (kBoolTrue == test_11) {
    GALGAS_programComponentForGeneration var_programComponentForGeneration ;
    {
    routine_compileProgramComponentGalgas_33_ (var_declarationAST.mAttribute_mPrologueDeclarationList, var_declarationAST.mAttribute_mSourceRuleList, var_declarationAST.mAttribute_mEpilogueDeclarationList, var_semanticContext, var_programComponentForGeneration, inCompiler  COMMA_SOURCE_FILE ("galgas_prgm.gProgram", 628)) ;
    }
    var_semanticDeclarationSortedListForGeneration.addAssign_operation (GALGAS_string ("zprogram"), var_programComponentForGeneration, GALGAS_string ("z")  COMMA_SOURCE_FILE ("galgas_prgm.gProgram", 635)) ;
  }
  GALGAS_string var_typeDumpFilePath = constinArgument_inProjectSourceFile.mAttribute_string.reader_stringByDeletingLastPathComponent (SOURCE_FILE ("galgas_prgm.gProgram", 642)).add_operation (GALGAS_string ("/build/helpers/"), inCompiler COMMA_SOURCE_FILE ("galgas_prgm.gProgram", 642)).add_operation (constinArgument_inProjectSourceFile.mAttribute_string.reader_lastPathComponent (SOURCE_FILE ("galgas_prgm.gProgram", 642)), inCompiler COMMA_SOURCE_FILE ("galgas_prgm.gProgram", 642)).operator_concat (GALGAS_string (".html")  COMMA_SOURCE_FILE ("galgas_prgm.gProgram", 642)) ;
  const enumGalgasBool test_12 = GALGAS_bool (gOption_galgas_5F_cli_5F_options_outputHTMLTypeListFile.reader_value ()).boolEnum () ;
  if (kBoolTrue == test_12) {
    GALGAS_stringset var_firstLetterSet = GALGAS_stringset::constructor_emptySet (SOURCE_FILE ("galgas_prgm.gProgram", 644)) ;
    cEnumerator_unifiedTypeMap enumerator_28624 (var_semanticContext.mAttribute_mTypeMap, kEnumeration_up) ;
    while (enumerator_28624.hasCurrentObject ()) {
      var_firstLetterSet.addAssign_operation (enumerator_28624.current_lkey (HERE).mAttribute_string.reader_characterAtIndex (GALGAS_uint ((uint32_t) 0U), inCompiler COMMA_SOURCE_FILE ("galgas_prgm.gProgram", 646)).reader_string (SOURCE_FILE ("galgas_prgm.gProgram", 646))  COMMA_SOURCE_FILE ("galgas_prgm.gProgram", 646)) ;
      enumerator_28624.gotoNextObject () ;
    }
    GALGAS_string var_tableOfTypeString = GALGAS_string::makeEmptyString () ;
    GALGAS_char var_currentFirstLetter = GALGAS_char (TO_UNICODE (32)) ;
    cEnumerator_unifiedTypeMap enumerator_28829 (var_semanticContext.mAttribute_mTypeMap, kEnumeration_up) ;
    while (enumerator_28829.hasCurrentObject ()) {
      const enumGalgasBool test_13 = GALGAS_bool (kIsNotEqual, var_currentFirstLetter.objectCompare (enumerator_28829.current_lkey (HERE).mAttribute_string.reader_characterAtIndex (GALGAS_uint ((uint32_t) 0U), inCompiler COMMA_SOURCE_FILE ("galgas_prgm.gProgram", 651)))).boolEnum () ;
      if (kBoolTrue == test_13) {
        var_currentFirstLetter = enumerator_28829.current_lkey (HERE).mAttribute_string.reader_characterAtIndex (GALGAS_uint ((uint32_t) 0U), inCompiler COMMA_SOURCE_FILE ("galgas_prgm.gProgram", 652)) ;
        var_tableOfTypeString.dotAssign_operation (GALGAS_string ("<br><a name=\"").operator_concat (var_currentFirstLetter.reader_uint (SOURCE_FILE ("galgas_prgm.gProgram", 653)).reader_string (SOURCE_FILE ("galgas_prgm.gProgram", 653))  COMMA_SOURCE_FILE ("galgas_prgm.gProgram", 653)).operator_concat (GALGAS_string ("\"><b>")  COMMA_SOURCE_FILE ("galgas_prgm.gProgram", 653)).operator_concat (var_currentFirstLetter.reader_string (SOURCE_FILE ("galgas_prgm.gProgram", 653))  COMMA_SOURCE_FILE ("galgas_prgm.gProgram", 653)).operator_concat (GALGAS_string ("</b></a><br>")  COMMA_SOURCE_FILE ("galgas_prgm.gProgram", 653))  COMMA_SOURCE_FILE ("galgas_prgm.gProgram", 653)) ;
      }
      var_tableOfTypeString.dotAssign_operation (function_linkForType (enumerator_28829.current_lkey (HERE).mAttribute_string, inCompiler COMMA_SOURCE_FILE ("galgas_prgm.gProgram", 655)).operator_concat (GALGAS_string ("<br>")  COMMA_SOURCE_FILE ("galgas_prgm.gProgram", 655))  COMMA_SOURCE_FILE ("galgas_prgm.gProgram", 655)) ;
      enumerator_28829.gotoNextObject () ;
    }
    GALGAS_string var_typeDumpString = GALGAS_string (filewrapperTemplate_typeDumpGenerationTemplate_typeDump (inCompiler, constinArgument_inProjectSourceFile.mAttribute_string.reader_lastPathComponent (SOURCE_FILE ("galgas_prgm.gProgram", 658)), var_semanticContext.mAttribute_mTypeMap, var_firstLetterSet, var_tableOfTypeString COMMA_SOURCE_FILE ("galgas_prgm.gProgram", 657))) ;
    GALGAS_bool joker_29510_0 ; // Joker input parameter
    var_typeDumpString.method_writeToFileWhenDifferentContents (var_typeDumpFilePath, joker_29510_0, inCompiler COMMA_SOURCE_FILE ("galgas_prgm.gProgram", 663)) ;
  }else if (kBoolFalse == test_12) {
    {
    GALGAS_string::class_method_deleteFileIfExists (var_typeDumpFilePath, inCompiler COMMA_SOURCE_FILE ("galgas_prgm.gProgram", 665)) ;
    }
  }
  const enumGalgasBool test_14 = GALGAS_bool (kIsEqual, GALGAS_uint ((uint32_t) 0U).objectCompare (GALGAS_uint::constructor_errorCount (SOURCE_FILE ("galgas_prgm.gProgram", 668)))).operator_and (GALGAS_bool (kIsEqual, constinArgument_inSourceToAnalyze.objectCompare (GALGAS_string::makeEmptyString ())) COMMA_SOURCE_FILE ("galgas_prgm.gProgram", 668)).boolEnum () ;
  if (kBoolTrue == test_14) {
    {
    routine_performGalgas_33_ProjectGlobalCheckings (var_semanticContext, var_declarationAST.mAttribute_mDeclarationList, inCompiler  COMMA_SOURCE_FILE ("galgas_prgm.gProgram", 669)) ;
    }
  }
  const enumGalgasBool test_15 = GALGAS_bool (kIsEqual, GALGAS_uint ((uint32_t) 0U).objectCompare (GALGAS_uint::constructor_errorCount (SOURCE_FILE ("galgas_prgm.gProgram", 675)))).operator_and (GALGAS_bool (kIsEqual, constinArgument_inSourceToAnalyze.objectCompare (GALGAS_string::makeEmptyString ())) COMMA_SOURCE_FILE ("galgas_prgm.gProgram", 675)).boolEnum () ;
  if (kBoolTrue == test_15) {
    {
    routine_projectGeneration (var_productDirectory, var_optionComponentMapForGeneration, var_appProductFileList, var_semanticContext, var_semanticDeclarationSortedListForGeneration, var_declarationAST.mAttribute_mSourceRuleList, var_projectComponentAST, constinArgument_inProjectSourceFile.mAttribute_string, var_handCodedSourceDirectorySet, var_handCodedSourceToolFileList, var_handCodedLinkToolFileList, var_handCodedSourceAppFileList, var_handCodedLinkAppFileList, inCompiler  COMMA_SOURCE_FILE ("galgas_prgm.gProgram", 676)) ;
    }
  }
}


//---------------------------------------------------------------------------------------------------------------------*
//                                                                                                                     *
//                                             Routine 'projectGeneration'                                             *
//                                                                                                                     *
//---------------------------------------------------------------------------------------------------------------------*

void routine_projectGeneration (const GALGAS_string constinArgument_inProductDirectory,
                                const GALGAS_optionComponentMapForGeneration constinArgument_inOptionComponentMapForGeneration,
                                const GALGAS_stringlist constinArgument_inAppProductFileList,
                                const GALGAS_semanticContext constinArgument_inSemanticContext,
                                const GALGAS_semanticDeclarationSortedListForGeneration constinArgument_inSemanticDeclarationSortedListForGeneration,
                                const GALGAS_programRuleList constinArgument_inSourceRuleList,
                                const GALGAS_galgas_33_ProjectComponentAST constinArgument_inProjectComponentAST,
                                const GALGAS_string constinArgument_inProjectSourceFile,
                                const GALGAS_stringset constinArgument_inHandCodedSourceDirectorySet,
                                const GALGAS_stringlist constinArgument_inHandCodedSourceToolFileList,
                                const GALGAS_stringlist constinArgument_inHandCodedLinkToolFileList,
                                const GALGAS_stringlist constinArgument_inHandCodedSourceAppFileList,
                                const GALGAS_stringlist constinArgument_inHandCodedLinkAppFileList,
                                C_Compiler * inCompiler
                                COMMA_UNUSED_LOCATION_ARGS) {
  GALGAS_stringlist var_appProductFileList = constinArgument_inAppProductFileList ;
  const enumGalgasBool test_0 = GALGAS_bool (gOption_galgas_5F_builtin_5F_options_verbose_5F_output.reader_value ()).boolEnum () ;
  if (kBoolTrue == test_0) {
    inCompiler->printMessage (GALGAS_string ("*** Generating files\n")  COMMA_SOURCE_FILE ("galgas_prgm.gProgram", 718)) ;
  }
  GALGAS_stringlist var_toolCppFileList = GALGAS_stringlist::constructor_emptyList (SOURCE_FILE ("galgas_prgm.gProgram", 720)) ;
  GALGAS_stringset var_allProductFileSet = GALGAS_stringset::constructor_emptySet (SOURCE_FILE ("galgas_prgm.gProgram", 721)) ;
  const enumGalgasBool test_1 = GALGAS_bool (kIsEqual, GALGAS_uint::constructor_errorCount (SOURCE_FILE ("galgas_prgm.gProgram", 732)).objectCompare (GALGAS_uint ((uint32_t) 0U))).boolEnum () ;
  if (kBoolTrue == test_1) {
    {
    routine_generateAllGuiComponentsGalgas_33_ (constinArgument_inOptionComponentMapForGeneration, constinArgument_inProductDirectory, var_appProductFileList, var_allProductFileSet, inCompiler  COMMA_SOURCE_FILE ("galgas_prgm.gProgram", 733)) ;
    }
  }
  {
  routine_generateSemanticDeclarationsGalgas_33_ (constinArgument_inProductDirectory, constinArgument_inSemanticContext, constinArgument_inSemanticDeclarationSortedListForGeneration, var_toolCppFileList, var_allProductFileSet, inCompiler  COMMA_SOURCE_FILE ("galgas_prgm.gProgram", 742)) ;
  }
  const enumGalgasBool test_2 = GALGAS_bool (kIsEqual, GALGAS_uint ((uint32_t) 0U).objectCompare (GALGAS_uint::constructor_errorCount (SOURCE_FILE ("galgas_prgm.gProgram", 751)))).boolEnum () ;
  if (kBoolTrue == test_2) {
    GALGAS_stringset var_handledExtensionSet = GALGAS_stringset::constructor_emptySet (SOURCE_FILE ("galgas_prgm.gProgram", 752)) ;
    cEnumerator_programRuleList enumerator_32802 (constinArgument_inSourceRuleList, kEnumeration_up) ;
    while (enumerator_32802.hasCurrentObject ()) {
      var_handledExtensionSet.addAssign_operation (enumerator_32802.current_mSourceFileExtension (HERE).mAttribute_string  COMMA_SOURCE_FILE ("galgas_prgm.gProgram", 754)) ;
      enumerator_32802.gotoNextObject () ;
    }
    GALGAS_stringset var_ignoredFeatureSet = GALGAS_stringset::constructor_emptySet (SOURCE_FILE ("galgas_prgm.gProgram", 757)) ;
    var_ignoredFeatureSet.addAssign_operation (GALGAS_string ("tool-source")  COMMA_SOURCE_FILE ("galgas_prgm.gProgram", 758)) ;
    var_ignoredFeatureSet.addAssign_operation (GALGAS_string ("tool-link")  COMMA_SOURCE_FILE ("galgas_prgm.gProgram", 759)) ;
    var_ignoredFeatureSet.addAssign_operation (GALGAS_string ("app-source")  COMMA_SOURCE_FILE ("galgas_prgm.gProgram", 760)) ;
    GALGAS_projectQualifiedFeatureMap var_projectQualifiedFeatureMap = GALGAS_projectQualifiedFeatureMap::constructor_emptyMap (SOURCE_FILE ("galgas_prgm.gProgram", 761)) ;
    cEnumerator_galgas_33_QualifiedFeatureList enumerator_33220 (constinArgument_inProjectComponentAST.mAttribute_mQualifiedFeatureList, kEnumeration_up) ;
    while (enumerator_33220.hasCurrentObject ()) {
      const enumGalgasBool test_3 = var_ignoredFeatureSet.reader_hasKey (enumerator_33220.current_mFeatureName (HERE).mAttribute_string COMMA_SOURCE_FILE ("galgas_prgm.gProgram", 763)).operator_not (SOURCE_FILE ("galgas_prgm.gProgram", 763)).boolEnum () ;
      if (kBoolTrue == test_3) {
        {
        var_projectQualifiedFeatureMap.modifier_insertKey (enumerator_33220.current_mFeatureName (HERE), enumerator_33220.current_mFeatureValue (HERE), inCompiler COMMA_SOURCE_FILE ("galgas_prgm.gProgram", 764)) ;
        }
      }
      enumerator_33220.gotoNextObject () ;
    }
    {
    routine_updateGalgas_33_Targets (constinArgument_inProjectSourceFile, constinArgument_inProjectComponentAST.mAttribute_mTargetName.mAttribute_string, constinArgument_inProjectComponentAST.mAttribute_mEndOfSourceFile, constinArgument_inProjectComponentAST.mAttribute_mMajorVersion.mAttribute_uint.reader_string (SOURCE_FILE ("galgas_prgm.gProgram", 774)).operator_concat (GALGAS_string (".")  COMMA_SOURCE_FILE ("galgas_prgm.gProgram", 774)).operator_concat (constinArgument_inProjectComponentAST.mAttribute_mMinorVersion.mAttribute_uint.reader_string (SOURCE_FILE ("galgas_prgm.gProgram", 774))  COMMA_SOURCE_FILE ("galgas_prgm.gProgram", 774)).operator_concat (GALGAS_string (".")  COMMA_SOURCE_FILE ("galgas_prgm.gProgram", 774)).operator_concat (constinArgument_inProjectComponentAST.mAttribute_mRevisionVersion.mAttribute_uint.reader_string (SOURCE_FILE ("galgas_prgm.gProgram", 774))  COMMA_SOURCE_FILE ("galgas_prgm.gProgram", 774)), var_projectQualifiedFeatureMap, constinArgument_inProjectComponentAST.mAttribute_mGenerationFeatureList, var_toolCppFileList, var_appProductFileList, constinArgument_inHandCodedSourceToolFileList, constinArgument_inHandCodedSourceDirectorySet, var_handledExtensionSet, constinArgument_inHandCodedLinkToolFileList, var_allProductFileSet, constinArgument_inHandCodedSourceAppFileList, constinArgument_inHandCodedLinkAppFileList, inCompiler  COMMA_SOURCE_FILE ("galgas_prgm.gProgram", 770)) ;
    }
  }
  const enumGalgasBool test_4 = GALGAS_bool (kIsEqual, GALGAS_uint ((uint32_t) 0U).objectCompare (GALGAS_uint::constructor_errorCount (SOURCE_FILE ("galgas_prgm.gProgram", 789)))).boolEnum () ;
  if (kBoolTrue == test_4) {
    GALGAS_stringset var_allActualFileSet = GALGAS_stringset::constructor_emptySet (SOURCE_FILE ("galgas_prgm.gProgram", 790)) ;
    cEnumerator_stringlist enumerator_34326 (constinArgument_inProductDirectory.reader_regularFiles (GALGAS_bool (false) COMMA_SOURCE_FILE ("galgas_prgm.gProgram", 791)), kEnumeration_up) ;
    while (enumerator_34326.hasCurrentObject ()) {
      var_allActualFileSet.addAssign_operation (enumerator_34326.current_mValue (HERE)  COMMA_SOURCE_FILE ("galgas_prgm.gProgram", 792)) ;
      enumerator_34326.gotoNextObject () ;
    }
    GALGAS_stringset var_uselessFileSet = var_allActualFileSet.substract_operation (var_allProductFileSet, inCompiler COMMA_SOURCE_FILE ("galgas_prgm.gProgram", 794)) ;
    cEnumerator_stringset enumerator_34477 (var_uselessFileSet, kEnumeration_up) ;
    while (enumerator_34477.hasCurrentObject ()) {
      {
      GALGAS_string::class_method_deleteFile (constinArgument_inProductDirectory.operator_concat (GALGAS_string ("/")  COMMA_SOURCE_FILE ("galgas_prgm.gProgram", 796)).operator_concat (enumerator_34477.current_key (HERE)  COMMA_SOURCE_FILE ("galgas_prgm.gProgram", 796)), inCompiler COMMA_SOURCE_FILE ("galgas_prgm.gProgram", 796)) ;
      }
      enumerator_34477.gotoNextObject () ;
    }
  }
}


//---------------------------------------------------------------------------------------------------------------------*
//                                                                                                                     *
//                                                  Routine 'before'                                                   *
//                                                                                                                     *
//---------------------------------------------------------------------------------------------------------------------*

void routine_before (C_Compiler * inCompiler
                     COMMA_UNUSED_LOCATION_ARGS) {
  {
    GALGAS_string var_creationProjectName = GALGAS_string (gOption_galgas_5F_cli_5F_options_create_5F_project.reader_value ()) ;
    {
    routine_projectCreation (var_creationProjectName, inCompiler  COMMA_SOURCE_FILE ("galgas_prgm.gProgram", 43)) ;
    }
  }
  {
    const enumGalgasBool test_0 = GALGAS_bool (gOption_galgas_5F_cli_5F_options_printPredefinedLexicalActions.reader_value ()).boolEnum () ;
    if (kBoolTrue == test_0) {
      {
      routine_printPredefinedLexicalActions (inCompiler  COMMA_SOURCE_FILE ("galgas_prgm.gProgram", 49)) ;
      }
    }
  }
  {
    {
    routine_generatePredefinedTypeFiles (GALGAS_string (gOption_galgas_5F_cli_5F_options_generatePredefinedTypes.reader_value ()), inCompiler  COMMA_SOURCE_FILE ("galgas_prgm.gProgram", 55)) ;
    }
  }
  {
    const enumGalgasBool test_1 = GALGAS_bool (kIsNotEqual, GALGAS_string (gOption_galgas_5F_cli_5F_options_extractLIBPMOption.reader_value ()).objectCompare (GALGAS_string::makeEmptyString ())).boolEnum () ;
    if (kBoolTrue == test_1) {
      {
      routine_updateLIBPMatPath (GALGAS_string (gOption_galgas_5F_cli_5F_options_extractLIBPMOption.reader_value ()), inCompiler  COMMA_SOURCE_FILE ("galgas_prgm.gProgram", 61)) ;
      }
    }
  }
}


//---------------------------------------------------------------------------------------------------------------------*
//                                                                                                                     *
//                                               Routine 'programRule_0'                                               *
//                                                                                                                     *
//---------------------------------------------------------------------------------------------------------------------*

void routine_programRule_5F__30_ (const GALGAS_lstring constinArgument_inSourceFile,
                                  C_Compiler * inCompiler
                                  COMMA_UNUSED_LOCATION_ARGS) {
  GALGAS_templateInstructionListAST joker_3409_0 ; // Joker input parameter
  cGrammar_templateGrammar::_performSourceFileParsing_ (inCompiler, constinArgument_inSourceFile, joker_3409_0  COMMA_SOURCE_FILE ("galgas_prgm.gProgram", 75)) ;
}


//---------------------------------------------------------------------------------------------------------------------*
//                                                                                                                     *
//                                               Routine 'programRule_1'                                               *
//                                                                                                                     *
//---------------------------------------------------------------------------------------------------------------------*

void routine_programRule_5F__31_ (const GALGAS_lstring constinArgument_inSourceFile,
                                  C_Compiler * inCompiler
                                  COMMA_UNUSED_LOCATION_ARGS) {
  GALGAS_parsedComponentStruct var_parsedComponentStruct = GALGAS_parsedComponentStruct::constructor_new (GALGAS_parsedSemanticsComponentMap::constructor_emptyMap (SOURCE_FILE ("galgas_prgm.gProgram", 85)), GALGAS_parsedLexiqueComponentMap::constructor_emptyMap (SOURCE_FILE ("galgas_prgm.gProgram", 86)), GALGAS_parsedSyntaxComponentMap::constructor_emptyMap (SOURCE_FILE ("galgas_prgm.gProgram", 87)), GALGAS_parsedOptionComponentMap::constructor_emptyMap (SOURCE_FILE ("galgas_prgm.gProgram", 88)), GALGAS_parsedGrammarComponentMap::constructor_emptyMap (SOURCE_FILE ("galgas_prgm.gProgram", 89)), GALGAS_parsedProgramComponentMap::constructor_emptyMap (SOURCE_FILE ("galgas_prgm.gProgram", 90)), GALGAS_parsedGuiComponentMap::constructor_emptyMap (SOURCE_FILE ("galgas_prgm.gProgram", 91)) COMMA_SOURCE_FILE ("galgas_prgm.gProgram", 84)) ;
  {
  routine_compileOptionComponentFromSourceFile (constinArgument_inSourceFile, function_outputDirectory (constinArgument_inSourceFile, inCompiler COMMA_SOURCE_FILE ("galgas_prgm.gProgram", 93)), var_parsedComponentStruct, inCompiler  COMMA_SOURCE_FILE ("galgas_prgm.gProgram", 93)) ;
  }
}


//---------------------------------------------------------------------------------------------------------------------*
//                                                                                                                     *
//                                               Routine 'programRule_2'                                               *
//                                                                                                                     *
//---------------------------------------------------------------------------------------------------------------------*

void routine_programRule_5F__32_ (const GALGAS_lstring constinArgument_inSourceFile,
                                  C_Compiler * inCompiler
                                  COMMA_UNUSED_LOCATION_ARGS) {
  GALGAS_parsedComponentStruct var_parsedComponentStruct = GALGAS_parsedComponentStruct::constructor_new (GALGAS_parsedSemanticsComponentMap::constructor_emptyMap (SOURCE_FILE ("galgas_prgm.gProgram", 103)), GALGAS_parsedLexiqueComponentMap::constructor_emptyMap (SOURCE_FILE ("galgas_prgm.gProgram", 104)), GALGAS_parsedSyntaxComponentMap::constructor_emptyMap (SOURCE_FILE ("galgas_prgm.gProgram", 105)), GALGAS_parsedOptionComponentMap::constructor_emptyMap (SOURCE_FILE ("galgas_prgm.gProgram", 106)), GALGAS_parsedGrammarComponentMap::constructor_emptyMap (SOURCE_FILE ("galgas_prgm.gProgram", 107)), GALGAS_parsedProgramComponentMap::constructor_emptyMap (SOURCE_FILE ("galgas_prgm.gProgram", 108)), GALGAS_parsedGuiComponentMap::constructor_emptyMap (SOURCE_FILE ("galgas_prgm.gProgram", 109)) COMMA_SOURCE_FILE ("galgas_prgm.gProgram", 102)) ;
  {
  routine_compileLexiqueComponentFromSource (constinArgument_inSourceFile, function_outputDirectory (constinArgument_inSourceFile, inCompiler COMMA_SOURCE_FILE ("galgas_prgm.gProgram", 111)), var_parsedComponentStruct, inCompiler  COMMA_SOURCE_FILE ("galgas_prgm.gProgram", 111)) ;
  }
}


//---------------------------------------------------------------------------------------------------------------------*
//                                                                                                                     *
//                                               Routine 'programRule_3'                                               *
//                                                                                                                     *
//---------------------------------------------------------------------------------------------------------------------*

void routine_programRule_5F__33_ (const GALGAS_lstring constinArgument_inSourceFile,
                                  C_Compiler * inCompiler
                                  COMMA_UNUSED_LOCATION_ARGS) {
  GALGAS_parsedComponentStruct var_parsedComponentStruct = GALGAS_parsedComponentStruct::constructor_new (GALGAS_parsedSemanticsComponentMap::constructor_emptyMap (SOURCE_FILE ("galgas_prgm.gProgram", 121)), GALGAS_parsedLexiqueComponentMap::constructor_emptyMap (SOURCE_FILE ("galgas_prgm.gProgram", 122)), GALGAS_parsedSyntaxComponentMap::constructor_emptyMap (SOURCE_FILE ("galgas_prgm.gProgram", 123)), GALGAS_parsedOptionComponentMap::constructor_emptyMap (SOURCE_FILE ("galgas_prgm.gProgram", 124)), GALGAS_parsedGrammarComponentMap::constructor_emptyMap (SOURCE_FILE ("galgas_prgm.gProgram", 125)), GALGAS_parsedProgramComponentMap::constructor_emptyMap (SOURCE_FILE ("galgas_prgm.gProgram", 126)), GALGAS_parsedGuiComponentMap::constructor_emptyMap (SOURCE_FILE ("galgas_prgm.gProgram", 127)) COMMA_SOURCE_FILE ("galgas_prgm.gProgram", 120)) ;
  {
  routine_compileSemanticsComponentFromSourceFile (constinArgument_inSourceFile, function_outputDirectory (constinArgument_inSourceFile, inCompiler COMMA_SOURCE_FILE ("galgas_prgm.gProgram", 129)), var_parsedComponentStruct, inCompiler  COMMA_SOURCE_FILE ("galgas_prgm.gProgram", 129)) ;
  }
}


//---------------------------------------------------------------------------------------------------------------------*
//                                                                                                                     *
//                                               Routine 'programRule_4'                                               *
//                                                                                                                     *
//---------------------------------------------------------------------------------------------------------------------*

void routine_programRule_5F__34_ (const GALGAS_lstring constinArgument_inSourceFile,
                                  C_Compiler * inCompiler
                                  COMMA_UNUSED_LOCATION_ARGS) {
  GALGAS_parsedComponentStruct var_parsedComponentStruct = GALGAS_parsedComponentStruct::constructor_new (GALGAS_parsedSemanticsComponentMap::constructor_emptyMap (SOURCE_FILE ("galgas_prgm.gProgram", 139)), GALGAS_parsedLexiqueComponentMap::constructor_emptyMap (SOURCE_FILE ("galgas_prgm.gProgram", 140)), GALGAS_parsedSyntaxComponentMap::constructor_emptyMap (SOURCE_FILE ("galgas_prgm.gProgram", 141)), GALGAS_parsedOptionComponentMap::constructor_emptyMap (SOURCE_FILE ("galgas_prgm.gProgram", 142)), GALGAS_parsedGrammarComponentMap::constructor_emptyMap (SOURCE_FILE ("galgas_prgm.gProgram", 143)), GALGAS_parsedProgramComponentMap::constructor_emptyMap (SOURCE_FILE ("galgas_prgm.gProgram", 144)), GALGAS_parsedGuiComponentMap::constructor_emptyMap (SOURCE_FILE ("galgas_prgm.gProgram", 145)) COMMA_SOURCE_FILE ("galgas_prgm.gProgram", 138)) ;
  {
  routine_compileSyntaxComponentFromSourceFile (constinArgument_inSourceFile, function_outputDirectory (constinArgument_inSourceFile, inCompiler COMMA_SOURCE_FILE ("galgas_prgm.gProgram", 147)), var_parsedComponentStruct, inCompiler  COMMA_SOURCE_FILE ("galgas_prgm.gProgram", 147)) ;
  }
}


//---------------------------------------------------------------------------------------------------------------------*
//                                                                                                                     *
//                                               Routine 'programRule_5'                                               *
//                                                                                                                     *
//---------------------------------------------------------------------------------------------------------------------*

void routine_programRule_5F__35_ (const GALGAS_lstring constinArgument_inSourceFile,
                                  C_Compiler * inCompiler
                                  COMMA_UNUSED_LOCATION_ARGS) {
  GALGAS_parsedComponentStruct var_parsedComponentStruct = GALGAS_parsedComponentStruct::constructor_new (GALGAS_parsedSemanticsComponentMap::constructor_emptyMap (SOURCE_FILE ("galgas_prgm.gProgram", 157)), GALGAS_parsedLexiqueComponentMap::constructor_emptyMap (SOURCE_FILE ("galgas_prgm.gProgram", 158)), GALGAS_parsedSyntaxComponentMap::constructor_emptyMap (SOURCE_FILE ("galgas_prgm.gProgram", 159)), GALGAS_parsedOptionComponentMap::constructor_emptyMap (SOURCE_FILE ("galgas_prgm.gProgram", 160)), GALGAS_parsedGrammarComponentMap::constructor_emptyMap (SOURCE_FILE ("galgas_prgm.gProgram", 161)), GALGAS_parsedProgramComponentMap::constructor_emptyMap (SOURCE_FILE ("galgas_prgm.gProgram", 162)), GALGAS_parsedGuiComponentMap::constructor_emptyMap (SOURCE_FILE ("galgas_prgm.gProgram", 163)) COMMA_SOURCE_FILE ("galgas_prgm.gProgram", 156)) ;
  {
  routine_compileGrammarComponentFromSourceFile (constinArgument_inSourceFile, function_outputDirectory (constinArgument_inSourceFile, inCompiler COMMA_SOURCE_FILE ("galgas_prgm.gProgram", 167)), var_parsedComponentStruct, inCompiler  COMMA_SOURCE_FILE ("galgas_prgm.gProgram", 165)) ;
  }
}


//---------------------------------------------------------------------------------------------------------------------*
//                                                                                                                     *
//                                               Routine 'programRule_6'                                               *
//                                                                                                                     *
//---------------------------------------------------------------------------------------------------------------------*

void routine_programRule_5F__36_ (const GALGAS_lstring constinArgument_inSourceFile,
                                  C_Compiler * inCompiler
                                  COMMA_UNUSED_LOCATION_ARGS) {
  GALGAS_parsedComponentStruct var_parsedComponentStruct = GALGAS_parsedComponentStruct::constructor_new (GALGAS_parsedSemanticsComponentMap::constructor_emptyMap (SOURCE_FILE ("galgas_prgm.gProgram", 178)), GALGAS_parsedLexiqueComponentMap::constructor_emptyMap (SOURCE_FILE ("galgas_prgm.gProgram", 179)), GALGAS_parsedSyntaxComponentMap::constructor_emptyMap (SOURCE_FILE ("galgas_prgm.gProgram", 180)), GALGAS_parsedOptionComponentMap::constructor_emptyMap (SOURCE_FILE ("galgas_prgm.gProgram", 181)), GALGAS_parsedGrammarComponentMap::constructor_emptyMap (SOURCE_FILE ("galgas_prgm.gProgram", 182)), GALGAS_parsedProgramComponentMap::constructor_emptyMap (SOURCE_FILE ("galgas_prgm.gProgram", 183)), GALGAS_parsedGuiComponentMap::constructor_emptyMap (SOURCE_FILE ("galgas_prgm.gProgram", 184)) COMMA_SOURCE_FILE ("galgas_prgm.gProgram", 177)) ;
  {
  routine_compileGuiComponentFromSourceFile (constinArgument_inSourceFile, function_outputDirectory (constinArgument_inSourceFile, inCompiler COMMA_SOURCE_FILE ("galgas_prgm.gProgram", 186)), var_parsedComponentStruct, inCompiler  COMMA_SOURCE_FILE ("galgas_prgm.gProgram", 186)) ;
  }
}


//---------------------------------------------------------------------------------------------------------------------*
//                                                                                                                     *
//                                               Routine 'programRule_7'                                               *
//                                                                                                                     *
//---------------------------------------------------------------------------------------------------------------------*

void routine_programRule_5F__37_ (const GALGAS_lstring constinArgument_inSourceFile,
                                  C_Compiler * inCompiler
                                  COMMA_UNUSED_LOCATION_ARGS) {
  GALGAS_parsedComponentStruct var_parsedComponentStruct = GALGAS_parsedComponentStruct::constructor_new (GALGAS_parsedSemanticsComponentMap::constructor_emptyMap (SOURCE_FILE ("galgas_prgm.gProgram", 196)), GALGAS_parsedLexiqueComponentMap::constructor_emptyMap (SOURCE_FILE ("galgas_prgm.gProgram", 197)), GALGAS_parsedSyntaxComponentMap::constructor_emptyMap (SOURCE_FILE ("galgas_prgm.gProgram", 198)), GALGAS_parsedOptionComponentMap::constructor_emptyMap (SOURCE_FILE ("galgas_prgm.gProgram", 199)), GALGAS_parsedGrammarComponentMap::constructor_emptyMap (SOURCE_FILE ("galgas_prgm.gProgram", 200)), GALGAS_parsedProgramComponentMap::constructor_emptyMap (SOURCE_FILE ("galgas_prgm.gProgram", 201)), GALGAS_parsedGuiComponentMap::constructor_emptyMap (SOURCE_FILE ("galgas_prgm.gProgram", 202)) COMMA_SOURCE_FILE ("galgas_prgm.gProgram", 195)) ;
  {
  routine_compileProgramComponentFromSourceFile (constinArgument_inSourceFile, function_outputDirectory (constinArgument_inSourceFile, inCompiler COMMA_SOURCE_FILE ("galgas_prgm.gProgram", 204)), var_parsedComponentStruct, inCompiler  COMMA_SOURCE_FILE ("galgas_prgm.gProgram", 204)) ;
  }
}


//---------------------------------------------------------------------------------------------------------------------*
//                                                                                                                     *
//                                               Routine 'programRule_8'                                               *
//                                                                                                                     *
//---------------------------------------------------------------------------------------------------------------------*

void routine_programRule_5F__38_ (const GALGAS_lstring constinArgument_inProjectSourceFile,
                                  C_Compiler * inCompiler
                                  COMMA_UNUSED_LOCATION_ARGS) {
  GALGAS_string var_outputDirectory = function_outputDirectory (constinArgument_inProjectSourceFile, inCompiler COMMA_SOURCE_FILE ("galgas_prgm.gProgram", 217)) ;
  GALGAS_projectComponentAST var_projectComponentAST ;
  var_projectComponentAST.drop () ;
  C_String syntaxDirectedTranslationResult_8708 ;
  cGrammar_projectLL_31_grammar::_performSourceFileParsing_ (inCompiler, syntaxDirectedTranslationResult_8708, constinArgument_inProjectSourceFile, var_projectComponentAST  COMMA_SOURCE_FILE ("galgas_prgm.gProgram", 219)) ;
  const GALGAS_string var_translatedProject (syntaxDirectedTranslationResult_8708) ;
  const enumGalgasBool test_0 = GALGAS_bool (gOption_galgas_5F_cli_5F_options_convertToGalgas_33_.reader_value ()).boolEnum () ;
  if (kBoolTrue == test_0) {
    GALGAS_string var_directory = constinArgument_inProjectSourceFile.mAttribute_string.reader_stringByDeletingLastPathComponent (SOURCE_FILE ("galgas_prgm.gProgram", 221)).operator_concat (GALGAS_string ("/../")  COMMA_SOURCE_FILE ("galgas_prgm.gProgram", 221)) ;
    GALGAS_string var_newProjectFile = var_directory.operator_concat (GALGAS_string ("+")  COMMA_SOURCE_FILE ("galgas_prgm.gProgram", 222)).operator_concat (var_projectComponentAST.mAttribute_mTargetName.reader_string (SOURCE_FILE ("galgas_prgm.gProgram", 222))  COMMA_SOURCE_FILE ("galgas_prgm.gProgram", 222)).operator_concat (GALGAS_string (".galgasProject")  COMMA_SOURCE_FILE ("galgas_prgm.gProgram", 222)) ;
    GALGAS_bool joker_9132_0 ; // Joker input parameter
    var_translatedProject.method_writeToFileWhenDifferentContents (var_newProjectFile, joker_9132_0, inCompiler COMMA_SOURCE_FILE ("galgas_prgm.gProgram", 223)) ;
  }
  const enumGalgasBool test_1 = GALGAS_bool (kIsNotEqual, var_projectComponentAST.reader_mProjectName (SOURCE_FILE ("galgas_prgm.gProgram", 226)).reader_string (SOURCE_FILE ("galgas_prgm.gProgram", 226)).objectCompare (constinArgument_inProjectSourceFile.mAttribute_string.reader_lastPathComponent (SOURCE_FILE ("galgas_prgm.gProgram", 226)).reader_stringByDeletingPathExtension (SOURCE_FILE ("galgas_prgm.gProgram", 226)))).boolEnum () ;
  if (kBoolTrue == test_1) {
    GALGAS_location location_2 (var_projectComponentAST.reader_mProjectName (SOURCE_FILE ("galgas_prgm.gProgram", 227)).reader_location (HERE)) ; // Implicit use of 'location' reader
    inCompiler->emitSemanticError (location_2, GALGAS_string ("the project name ('").operator_concat (var_projectComponentAST.reader_mProjectName (SOURCE_FILE ("galgas_prgm.gProgram", 228)).reader_string (SOURCE_FILE ("galgas_prgm.gProgram", 228))  COMMA_SOURCE_FILE ("galgas_prgm.gProgram", 228)).operator_concat (GALGAS_string ("') should be the same as the source file base name ('")  COMMA_SOURCE_FILE ("galgas_prgm.gProgram", 228)).operator_concat (constinArgument_inProjectSourceFile.mAttribute_string.reader_lastPathComponent (SOURCE_FILE ("galgas_prgm.gProgram", 229)).reader_stringByDeletingPathExtension (SOURCE_FILE ("galgas_prgm.gProgram", 229))  COMMA_SOURCE_FILE ("galgas_prgm.gProgram", 228)).operator_concat (GALGAS_string ("')")  COMMA_SOURCE_FILE ("galgas_prgm.gProgram", 229))  COMMA_SOURCE_FILE ("galgas_prgm.gProgram", 227)) ;
  }
  GALGAS_string var_targetName = var_projectComponentAST.reader_mTargetName (SOURCE_FILE ("galgas_prgm.gProgram", 232)).reader_string (SOURCE_FILE ("galgas_prgm.gProgram", 232)) ;
  const enumGalgasBool test_3 = GALGAS_bool (kIsEqual, var_targetName.objectCompare (GALGAS_string::makeEmptyString ())).boolEnum () ;
  if (kBoolTrue == test_3) {
    GALGAS_location location_4 (var_projectComponentAST.reader_mTargetName (SOURCE_FILE ("galgas_prgm.gProgram", 234)).reader_location (HERE)) ; // Implicit use of 'location' reader
    inCompiler->emitSemanticError (location_4, GALGAS_string ("the target name should not be empty")  COMMA_SOURCE_FILE ("galgas_prgm.gProgram", 234)) ;
  }
  GALGAS_projectQualifiedFeatureMap var_projectQualifiedFeatureMap = GALGAS_projectQualifiedFeatureMap::constructor_emptyMap (SOURCE_FILE ("galgas_prgm.gProgram", 237)) ;
  cEnumerator_qualifiedFeatureList enumerator_9943 (var_projectComponentAST.mAttribute_mQualifiedFeatureList, kEnumeration_up) ;
  while (enumerator_9943.hasCurrentObject ()) {
    {
    var_projectQualifiedFeatureMap.modifier_insertKey (enumerator_9943.current_mFeatureName (HERE), enumerator_9943.current_mFeatureValue (HERE), inCompiler COMMA_SOURCE_FILE ("galgas_prgm.gProgram", 239)) ;
    }
    enumerator_9943.gotoNextObject () ;
  }
  GALGAS_parsedComponentStruct var_parsedComponentStruct = GALGAS_parsedComponentStruct::constructor_new (GALGAS_parsedSemanticsComponentMap::constructor_emptyMap (SOURCE_FILE ("galgas_prgm.gProgram", 246)), GALGAS_parsedLexiqueComponentMap::constructor_emptyMap (SOURCE_FILE ("galgas_prgm.gProgram", 247)), GALGAS_parsedSyntaxComponentMap::constructor_emptyMap (SOURCE_FILE ("galgas_prgm.gProgram", 248)), GALGAS_parsedOptionComponentMap::constructor_emptyMap (SOURCE_FILE ("galgas_prgm.gProgram", 249)), GALGAS_parsedGrammarComponentMap::constructor_emptyMap (SOURCE_FILE ("galgas_prgm.gProgram", 250)), GALGAS_parsedProgramComponentMap::constructor_emptyMap (SOURCE_FILE ("galgas_prgm.gProgram", 251)), GALGAS_parsedGuiComponentMap::constructor_emptyMap (SOURCE_FILE ("galgas_prgm.gProgram", 252)) COMMA_SOURCE_FILE ("galgas_prgm.gProgram", 245)) ;
  cEnumerator_projectSourceList enumerator_10539 (var_projectComponentAST.reader_mProjectSourceList (SOURCE_FILE ("galgas_prgm.gProgram", 255)), kEnumeration_up) ;
  while (enumerator_10539.hasCurrentObject ()) {
    GALGAS_string var_extension = enumerator_10539.current_mFilePath (HERE).mAttribute_string.reader_pathExtension (SOURCE_FILE ("galgas_prgm.gProgram", 256)) ;
    GALGAS_lstring var_componentName = GALGAS_lstring::constructor_new (enumerator_10539.current_mFilePath (HERE).mAttribute_string.reader_lastPathComponent (SOURCE_FILE ("galgas_prgm.gProgram", 258)).reader_stringByDeletingPathExtension (SOURCE_FILE ("galgas_prgm.gProgram", 258)), enumerator_10539.current_mFilePath (HERE).reader_location (SOURCE_FILE ("galgas_prgm.gProgram", 259))  COMMA_SOURCE_FILE ("galgas_prgm.gProgram", 257)) ;
    GALGAS_lstring var_fullFilePath = GALGAS_lstring::constructor_new (constinArgument_inProjectSourceFile.mAttribute_string.reader_stringByDeletingLastPathComponent (SOURCE_FILE ("galgas_prgm.gProgram", 262)).operator_concat (GALGAS_string ("/")  COMMA_SOURCE_FILE ("galgas_prgm.gProgram", 262)).operator_concat (enumerator_10539.current_mFilePath (HERE).reader_string (SOURCE_FILE ("galgas_prgm.gProgram", 262))  COMMA_SOURCE_FILE ("galgas_prgm.gProgram", 262)), enumerator_10539.current_mFilePath (HERE).reader_location (SOURCE_FILE ("galgas_prgm.gProgram", 263))  COMMA_SOURCE_FILE ("galgas_prgm.gProgram", 261)) ;
    if (enumerator_10539.current_mSourceKind (HERE).isValid ()) {
      switch (enumerator_10539.current_mSourceKind (HERE).enumValue ()) {
      case GALGAS_sourceFileKind::kNotBuilt:
        break ;
      case GALGAS_sourceFileKind::kEnum_externSourceFile: {
        } break ;
      case GALGAS_sourceFileKind::kEnum_guiSourceFile: {
        const enumGalgasBool test_5 = GALGAS_bool (kIsEqual, var_extension.objectCompare (GALGAS_string ("gGui"))).boolEnum () ;
        if (kBoolTrue == test_5) {
          const enumGalgasBool test_6 = GALGAS_bool (gOption_galgas_5F_builtin_5F_options_verbose_5F_output.reader_value ()).boolEnum () ;
          if (kBoolTrue == test_6) {
            inCompiler->printMessage (GALGAS_string ("*** Parse '").operator_concat (var_fullFilePath.mAttribute_string.reader_lastPathComponent (SOURCE_FILE ("galgas_prgm.gProgram", 270))  COMMA_SOURCE_FILE ("galgas_prgm.gProgram", 270)).operator_concat (GALGAS_string ("'\n")  COMMA_SOURCE_FILE ("galgas_prgm.gProgram", 270))  COMMA_SOURCE_FILE ("galgas_prgm.gProgram", 270)) ;
          }
          GALGAS_guiComponentAST var_guiComponentRoot ;
          var_guiComponentRoot.drop () ;
          C_String syntaxDirectedTranslationResult_11227 ;
          cGrammar_guiGrammar::_performSourceFileParsing_ (inCompiler, syntaxDirectedTranslationResult_11227, var_fullFilePath, var_guiComponentRoot  COMMA_SOURCE_FILE ("galgas_prgm.gProgram", 273)) ;
          const GALGAS_string var_translatedGUI (syntaxDirectedTranslationResult_11227) ;
          const enumGalgasBool test_7 = GALGAS_bool (gOption_galgas_5F_cli_5F_options_convertToGalgas_33_.reader_value ()).boolEnum () ;
          if (kBoolTrue == test_7) {
            GALGAS_string var_projectName = var_fullFilePath.mAttribute_string.reader_lastPathComponent (SOURCE_FILE ("galgas_prgm.gProgram", 275)).reader_stringByDeletingPathExtension (SOURCE_FILE ("galgas_prgm.gProgram", 275)) ;
            GALGAS_string var_directory = var_fullFilePath.mAttribute_string.reader_stringByDeletingLastPathComponent (SOURCE_FILE ("galgas_prgm.gProgram", 276)).operator_concat (GALGAS_string ("/../galgas-sources/")  COMMA_SOURCE_FILE ("galgas_prgm.gProgram", 276)) ;
            GALGAS_string var_newProjectFile = var_directory.operator_concat (var_projectName  COMMA_SOURCE_FILE ("galgas_prgm.gProgram", 277)).operator_concat (GALGAS_string (".galgas")  COMMA_SOURCE_FILE ("galgas_prgm.gProgram", 277)) ;
            GALGAS_bool joker_11707_0 ; // Joker input parameter
            var_translatedGUI.method_writeToFileWhenDifferentContents (var_newProjectFile, joker_11707_0, inCompiler COMMA_SOURCE_FILE ("galgas_prgm.gProgram", 278)) ;
          }
          {
          var_parsedComponentStruct.mAttribute_mParsedGuiComponentMap.modifier_insertKey (var_componentName, var_fullFilePath, var_guiComponentRoot, inCompiler COMMA_SOURCE_FILE ("galgas_prgm.gProgram", 280)) ;
          }
        }else if (kBoolFalse == test_5) {
          GALGAS_location location_8 (enumerator_10539.current_mFilePath (HERE).reader_location (HERE)) ; // Implicit use of 'location' reader
          inCompiler->emitSemanticError (location_8, GALGAS_string ("extension of a gui component should be '.gGui'.")  COMMA_SOURCE_FILE ("galgas_prgm.gProgram", 282)) ;
        }
        } break ;
      case GALGAS_sourceFileKind::kEnum_lexiqueSourceFile: {
        const enumGalgasBool test_9 = GALGAS_bool (kIsEqual, var_extension.objectCompare (GALGAS_string ("gLexique"))).boolEnum () ;
        if (kBoolTrue == test_9) {
          const enumGalgasBool test_10 = GALGAS_bool (gOption_galgas_5F_builtin_5F_options_verbose_5F_output.reader_value ()).boolEnum () ;
          if (kBoolTrue == test_10) {
            inCompiler->printMessage (GALGAS_string ("*** Parse '").operator_concat (var_fullFilePath.mAttribute_string.reader_lastPathComponent (SOURCE_FILE ("galgas_prgm.gProgram", 287))  COMMA_SOURCE_FILE ("galgas_prgm.gProgram", 287)).operator_concat (GALGAS_string ("'\n")  COMMA_SOURCE_FILE ("galgas_prgm.gProgram", 287))  COMMA_SOURCE_FILE ("galgas_prgm.gProgram", 287)) ;
          }
          GALGAS_galgas_33_LexiqueComponentListAST_2D_element var_lexiqueComponentRoot ;
          var_lexiqueComponentRoot.drop () ;
          C_String syntaxDirectedTranslationResult_12260 ;
          cGrammar_lexiqueLL_31_grammar::_performSourceFileParsing_ (inCompiler, syntaxDirectedTranslationResult_12260, var_fullFilePath, var_lexiqueComponentRoot  COMMA_SOURCE_FILE ("galgas_prgm.gProgram", 290)) ;
          const GALGAS_string var_translatedSource (syntaxDirectedTranslationResult_12260) ;
          const enumGalgasBool test_11 = GALGAS_bool (gOption_galgas_5F_cli_5F_options_convertToGalgas_33_.reader_value ()).boolEnum () ;
          if (kBoolTrue == test_11) {
            GALGAS_string var_projectName = var_fullFilePath.mAttribute_string.reader_lastPathComponent (SOURCE_FILE ("galgas_prgm.gProgram", 292)).reader_stringByDeletingPathExtension (SOURCE_FILE ("galgas_prgm.gProgram", 292)) ;
            GALGAS_string var_directory = var_fullFilePath.mAttribute_string.reader_stringByDeletingLastPathComponent (SOURCE_FILE ("galgas_prgm.gProgram", 293)).operator_concat (GALGAS_string ("/../galgas-sources/")  COMMA_SOURCE_FILE ("galgas_prgm.gProgram", 293)) ;
            GALGAS_string var_newProjectFile = var_directory.operator_concat (var_projectName  COMMA_SOURCE_FILE ("galgas_prgm.gProgram", 294)).operator_concat (GALGAS_string (".galgas")  COMMA_SOURCE_FILE ("galgas_prgm.gProgram", 294)) ;
            GALGAS_bool joker_12750_0 ; // Joker input parameter
            var_translatedSource.method_writeToFileWhenDifferentContents (var_newProjectFile, joker_12750_0, inCompiler COMMA_SOURCE_FILE ("galgas_prgm.gProgram", 295)) ;
          }
          {
          var_parsedComponentStruct.mAttribute_mParsedLexiqueComponentMap.modifier_insertKey (var_componentName, var_lexiqueComponentRoot, inCompiler COMMA_SOURCE_FILE ("galgas_prgm.gProgram", 297)) ;
          }
        }else if (kBoolFalse == test_9) {
          GALGAS_location location_12 (enumerator_10539.current_mFilePath (HERE).reader_location (HERE)) ; // Implicit use of 'location' reader
          inCompiler->emitSemanticError (location_12, GALGAS_string ("extension of a lexique component should be '.gLexique'.")  COMMA_SOURCE_FILE ("galgas_prgm.gProgram", 299)) ;
        }
        } break ;
      case GALGAS_sourceFileKind::kEnum_optionSourceFile: {
        const enumGalgasBool test_13 = GALGAS_bool (kIsEqual, var_extension.objectCompare (GALGAS_string ("gOption"))).boolEnum () ;
        if (kBoolTrue == test_13) {
          const enumGalgasBool test_14 = GALGAS_bool (gOption_galgas_5F_builtin_5F_options_verbose_5F_output.reader_value ()).boolEnum () ;
          if (kBoolTrue == test_14) {
            inCompiler->printMessage (GALGAS_string ("*** Parse '").operator_concat (var_fullFilePath.mAttribute_string.reader_lastPathComponent (SOURCE_FILE ("galgas_prgm.gProgram", 304))  COMMA_SOURCE_FILE ("galgas_prgm.gProgram", 304)).operator_concat (GALGAS_string ("'\n")  COMMA_SOURCE_FILE ("galgas_prgm.gProgram", 304))  COMMA_SOURCE_FILE ("galgas_prgm.gProgram", 304)) ;
          }
          GALGAS_optionComponentAST var_optionComponentAST ;
          var_optionComponentAST.drop () ;
          C_String syntaxDirectedTranslationResult_13280 ;
          cGrammar_optionLL_31_grammar::_performSourceFileParsing_ (inCompiler, syntaxDirectedTranslationResult_13280, var_fullFilePath, var_optionComponentAST  COMMA_SOURCE_FILE ("galgas_prgm.gProgram", 307)) ;
          const GALGAS_string var_translatedSource (syntaxDirectedTranslationResult_13280) ;
          const enumGalgasBool test_15 = GALGAS_bool (gOption_galgas_5F_cli_5F_options_convertToGalgas_33_.reader_value ()).boolEnum () ;
          if (kBoolTrue == test_15) {
            GALGAS_string var_projectName = var_fullFilePath.mAttribute_string.reader_lastPathComponent (SOURCE_FILE ("galgas_prgm.gProgram", 309)).reader_stringByDeletingPathExtension (SOURCE_FILE ("galgas_prgm.gProgram", 309)) ;
            GALGAS_string var_directory = var_fullFilePath.mAttribute_string.reader_stringByDeletingLastPathComponent (SOURCE_FILE ("galgas_prgm.gProgram", 310)).operator_concat (GALGAS_string ("/../galgas-sources/")  COMMA_SOURCE_FILE ("galgas_prgm.gProgram", 310)) ;
            GALGAS_string var_newProjectFile = var_directory.operator_concat (var_projectName  COMMA_SOURCE_FILE ("galgas_prgm.gProgram", 311)).operator_concat (GALGAS_string (".galgas")  COMMA_SOURCE_FILE ("galgas_prgm.gProgram", 311)) ;
            GALGAS_bool joker_13768_0 ; // Joker input parameter
            var_translatedSource.method_writeToFileWhenDifferentContents (var_newProjectFile, joker_13768_0, inCompiler COMMA_SOURCE_FILE ("galgas_prgm.gProgram", 312)) ;
          }
          GALGAS_commandLineOptionMap var_boolOptionMap ;
          GALGAS_commandLineOptionMap var_UIntOptionMap ;
          GALGAS_commandLineOptionMap var_stringOptionMap ;
          {
          routine_semanticAnalysisOfOptionComponent (var_optionComponentAST, var_boolOptionMap, var_UIntOptionMap, var_stringOptionMap, inCompiler  COMMA_SOURCE_FILE ("galgas_prgm.gProgram", 318)) ;
          }
          {
          var_parsedComponentStruct.mAttribute_mParsedOptionComponentMap.modifier_insertKey (var_componentName, var_boolOptionMap, var_UIntOptionMap, var_stringOptionMap, inCompiler COMMA_SOURCE_FILE ("galgas_prgm.gProgram", 324)) ;
          }
        }else if (kBoolFalse == test_13) {
          GALGAS_location location_16 (enumerator_10539.current_mFilePath (HERE).reader_location (HERE)) ; // Implicit use of 'location' reader
          inCompiler->emitSemanticError (location_16, GALGAS_string ("extension of an option component should be '.gOption'.")  COMMA_SOURCE_FILE ("galgas_prgm.gProgram", 331)) ;
        }
        } break ;
      case GALGAS_sourceFileKind::kEnum_semanticsSourceFile: {
        const enumGalgasBool test_17 = GALGAS_bool (kIsEqual, var_extension.objectCompare (GALGAS_string ("gSemantics"))).boolEnum () ;
        if (kBoolTrue == test_17) {
          const enumGalgasBool test_18 = GALGAS_bool (gOption_galgas_5F_builtin_5F_options_verbose_5F_output.reader_value ()).boolEnum () ;
          if (kBoolTrue == test_18) {
            inCompiler->printMessage (GALGAS_string ("*** Parse '").operator_concat (var_fullFilePath.mAttribute_string.reader_lastPathComponent (SOURCE_FILE ("galgas_prgm.gProgram", 336))  COMMA_SOURCE_FILE ("galgas_prgm.gProgram", 336)).operator_concat (GALGAS_string ("'\n")  COMMA_SOURCE_FILE ("galgas_prgm.gProgram", 336))  COMMA_SOURCE_FILE ("galgas_prgm.gProgram", 336)) ;
          }
          GALGAS_semanticsComponentAST var_semanticsComponentRoot ;
          var_semanticsComponentRoot.drop () ;
          C_String syntaxDirectedTranslationResult_14734 ;
          cGrammar_semanticsSLRgrammar::_performSourceFileParsing_ (inCompiler, syntaxDirectedTranslationResult_14734, var_fullFilePath, var_semanticsComponentRoot  COMMA_SOURCE_FILE ("galgas_prgm.gProgram", 339)) ;
          const GALGAS_string var_translatedSource (syntaxDirectedTranslationResult_14734) ;
          const enumGalgasBool test_19 = GALGAS_bool (gOption_galgas_5F_cli_5F_options_convertToGalgas_33_.reader_value ()).boolEnum () ;
          if (kBoolTrue == test_19) {
            GALGAS_string var_projectName = var_fullFilePath.mAttribute_string.reader_lastPathComponent (SOURCE_FILE ("galgas_prgm.gProgram", 341)).reader_stringByDeletingPathExtension (SOURCE_FILE ("galgas_prgm.gProgram", 341)) ;
            GALGAS_string var_directory = var_fullFilePath.mAttribute_string.reader_stringByDeletingLastPathComponent (SOURCE_FILE ("galgas_prgm.gProgram", 342)).operator_concat (GALGAS_string ("/../galgas-sources/")  COMMA_SOURCE_FILE ("galgas_prgm.gProgram", 342)) ;
            GALGAS_string var_newProjectFile = var_directory.operator_concat (var_projectName  COMMA_SOURCE_FILE ("galgas_prgm.gProgram", 343)).operator_concat (GALGAS_string (".galgas")  COMMA_SOURCE_FILE ("galgas_prgm.gProgram", 343)) ;
            GALGAS_bool joker_15226_0 ; // Joker input parameter
            var_translatedSource.method_writeToFileWhenDifferentContents (var_newProjectFile, joker_15226_0, inCompiler COMMA_SOURCE_FILE ("galgas_prgm.gProgram", 344)) ;
          }
          {
          var_parsedComponentStruct.mAttribute_mParsedSemanticsComponentMap.modifier_insertKey (var_componentName, var_fullFilePath, var_semanticsComponentRoot, inCompiler COMMA_SOURCE_FILE ("galgas_prgm.gProgram", 346)) ;
          }
        }else if (kBoolFalse == test_17) {
          GALGAS_location location_20 (enumerator_10539.current_mFilePath (HERE).reader_location (HERE)) ; // Implicit use of 'location' reader
          inCompiler->emitSemanticError (location_20, GALGAS_string ("extension of a semantics component should be '.gSemantics'.")  COMMA_SOURCE_FILE ("galgas_prgm.gProgram", 348)) ;
        }
        } break ;
      case GALGAS_sourceFileKind::kEnum_syntaxSourceFile: {
        const enumGalgasBool test_21 = GALGAS_bool (kIsEqual, var_extension.objectCompare (GALGAS_string ("gSyntax"))).boolEnum () ;
        if (kBoolTrue == test_21) {
          const enumGalgasBool test_22 = GALGAS_bool (gOption_galgas_5F_builtin_5F_options_verbose_5F_output.reader_value ()).boolEnum () ;
          if (kBoolTrue == test_22) {
            inCompiler->printMessage (GALGAS_string ("*** Parse '").operator_concat (var_fullFilePath.mAttribute_string.reader_lastPathComponent (SOURCE_FILE ("galgas_prgm.gProgram", 353))  COMMA_SOURCE_FILE ("galgas_prgm.gProgram", 353)).operator_concat (GALGAS_string ("'\n")  COMMA_SOURCE_FILE ("galgas_prgm.gProgram", 353))  COMMA_SOURCE_FILE ("galgas_prgm.gProgram", 353)) ;
          }
          GALGAS_galgas_33_SyntaxComponentListAST_2D_element var_syntaxComponentRoot ;
          var_syntaxComponentRoot.drop () ;
          C_String syntaxDirectedTranslationResult_15798 ;
          cGrammar_syntaxSLRgrammar::_performSourceFileParsing_ (inCompiler, syntaxDirectedTranslationResult_15798, var_fullFilePath, var_syntaxComponentRoot  COMMA_SOURCE_FILE ("galgas_prgm.gProgram", 356)) ;
          const GALGAS_string var_translatedSource (syntaxDirectedTranslationResult_15798) ;
          const enumGalgasBool test_23 = GALGAS_bool (gOption_galgas_5F_cli_5F_options_convertToGalgas_33_.reader_value ()).boolEnum () ;
          if (kBoolTrue == test_23) {
            GALGAS_string var_projectName = var_fullFilePath.mAttribute_string.reader_lastPathComponent (SOURCE_FILE ("galgas_prgm.gProgram", 358)).reader_stringByDeletingPathExtension (SOURCE_FILE ("galgas_prgm.gProgram", 358)) ;
            GALGAS_string var_directory = var_fullFilePath.mAttribute_string.reader_stringByDeletingLastPathComponent (SOURCE_FILE ("galgas_prgm.gProgram", 359)).operator_concat (GALGAS_string ("/../galgas-sources/")  COMMA_SOURCE_FILE ("galgas_prgm.gProgram", 359)) ;
            GALGAS_string var_newProjectFile = var_directory.operator_concat (var_projectName  COMMA_SOURCE_FILE ("galgas_prgm.gProgram", 360)).operator_concat (GALGAS_string (".galgas")  COMMA_SOURCE_FILE ("galgas_prgm.gProgram", 360)) ;
            GALGAS_bool joker_16287_0 ; // Joker input parameter
            var_translatedSource.method_writeToFileWhenDifferentContents (var_newProjectFile, joker_16287_0, inCompiler COMMA_SOURCE_FILE ("galgas_prgm.gProgram", 361)) ;
          }
          {
          var_parsedComponentStruct.mAttribute_mParsedSyntaxComponentMap.modifier_insertKey (var_componentName, var_fullFilePath, var_syntaxComponentRoot, inCompiler COMMA_SOURCE_FILE ("galgas_prgm.gProgram", 363)) ;
          }
        }else if (kBoolFalse == test_21) {
          GALGAS_location location_24 (enumerator_10539.current_mFilePath (HERE).reader_location (HERE)) ; // Implicit use of 'location' reader
          inCompiler->emitSemanticError (location_24, GALGAS_string ("extension of a syntax component should be '.gSyntax'.")  COMMA_SOURCE_FILE ("galgas_prgm.gProgram", 365)) ;
        }
        } break ;
      case GALGAS_sourceFileKind::kEnum_grammarSourceFile: {
        const enumGalgasBool test_25 = GALGAS_bool (kIsEqual, var_extension.objectCompare (GALGAS_string ("gGrammar"))).boolEnum () ;
        if (kBoolTrue == test_25) {
          const enumGalgasBool test_26 = GALGAS_bool (gOption_galgas_5F_builtin_5F_options_verbose_5F_output.reader_value ()).boolEnum () ;
          if (kBoolTrue == test_26) {
            inCompiler->printMessage (GALGAS_string ("*** Parse '").operator_concat (var_fullFilePath.mAttribute_string.reader_lastPathComponent (SOURCE_FILE ("galgas_prgm.gProgram", 370))  COMMA_SOURCE_FILE ("galgas_prgm.gProgram", 370)).operator_concat (GALGAS_string ("'\n")  COMMA_SOURCE_FILE ("galgas_prgm.gProgram", 370))  COMMA_SOURCE_FILE ("galgas_prgm.gProgram", 370)) ;
          }
          GALGAS_galgas_33_GrammarComponentListAST_2D_element var_grammarComponentRoot ;
          var_grammarComponentRoot.drop () ;
          C_String syntaxDirectedTranslationResult_16852 ;
          cGrammar_grammarLL_31_grammar::_performSourceFileParsing_ (inCompiler, syntaxDirectedTranslationResult_16852, var_fullFilePath, var_grammarComponentRoot  COMMA_SOURCE_FILE ("galgas_prgm.gProgram", 373)) ;
          const GALGAS_string var_translatedSource (syntaxDirectedTranslationResult_16852) ;
          const enumGalgasBool test_27 = GALGAS_bool (gOption_galgas_5F_cli_5F_options_convertToGalgas_33_.reader_value ()).boolEnum () ;
          if (kBoolTrue == test_27) {
            GALGAS_string var_projectName = var_fullFilePath.mAttribute_string.reader_lastPathComponent (SOURCE_FILE ("galgas_prgm.gProgram", 375)).reader_stringByDeletingPathExtension (SOURCE_FILE ("galgas_prgm.gProgram", 375)) ;
            GALGAS_string var_directory = var_fullFilePath.mAttribute_string.reader_stringByDeletingLastPathComponent (SOURCE_FILE ("galgas_prgm.gProgram", 376)).operator_concat (GALGAS_string ("/../galgas-sources/")  COMMA_SOURCE_FILE ("galgas_prgm.gProgram", 376)) ;
            GALGAS_string var_newProjectFile = var_directory.operator_concat (var_projectName  COMMA_SOURCE_FILE ("galgas_prgm.gProgram", 377)).operator_concat (GALGAS_string (".galgas")  COMMA_SOURCE_FILE ("galgas_prgm.gProgram", 377)) ;
            GALGAS_bool joker_17342_0 ; // Joker input parameter
            var_translatedSource.method_writeToFileWhenDifferentContents (var_newProjectFile, joker_17342_0, inCompiler COMMA_SOURCE_FILE ("galgas_prgm.gProgram", 378)) ;
          }
          {
          var_parsedComponentStruct.mAttribute_mParsedGrammarComponentMap.modifier_insertKey (var_componentName, var_fullFilePath, var_grammarComponentRoot, inCompiler COMMA_SOURCE_FILE ("galgas_prgm.gProgram", 380)) ;
          }
        }else if (kBoolFalse == test_25) {
          GALGAS_location location_28 (enumerator_10539.current_mFilePath (HERE).reader_location (HERE)) ; // Implicit use of 'location' reader
          inCompiler->emitSemanticError (location_28, GALGAS_string ("extension of a grammar component should be '.gGrammar'.")  COMMA_SOURCE_FILE ("galgas_prgm.gProgram", 382)) ;
        }
        } break ;
      case GALGAS_sourceFileKind::kEnum_programSourceFile: {
        const enumGalgasBool test_29 = GALGAS_bool (kIsEqual, var_extension.objectCompare (GALGAS_string ("gProgram"))).boolEnum () ;
        if (kBoolTrue == test_29) {
          const enumGalgasBool test_30 = GALGAS_bool (gOption_galgas_5F_builtin_5F_options_verbose_5F_output.reader_value ()).boolEnum () ;
          if (kBoolTrue == test_30) {
            inCompiler->printMessage (GALGAS_string ("*** Parse '").operator_concat (var_fullFilePath.mAttribute_string.reader_lastPathComponent (SOURCE_FILE ("galgas_prgm.gProgram", 387))  COMMA_SOURCE_FILE ("galgas_prgm.gProgram", 387)).operator_concat (GALGAS_string ("'\n")  COMMA_SOURCE_FILE ("galgas_prgm.gProgram", 387))  COMMA_SOURCE_FILE ("galgas_prgm.gProgram", 387)) ;
          }
          GALGAS_programComponentAST var_programComponentAST ;
          var_programComponentAST.drop () ;
          C_String syntaxDirectedTranslationResult_17891 ;
          cGrammar_programSLRgrammar::_performSourceFileParsing_ (inCompiler, syntaxDirectedTranslationResult_17891, var_fullFilePath, var_programComponentAST  COMMA_SOURCE_FILE ("galgas_prgm.gProgram", 390)) ;
          const GALGAS_string var_translatedSource (syntaxDirectedTranslationResult_17891) ;
          const enumGalgasBool test_31 = GALGAS_bool (gOption_galgas_5F_cli_5F_options_convertToGalgas_33_.reader_value ()).boolEnum () ;
          if (kBoolTrue == test_31) {
            GALGAS_string var_projectName = var_fullFilePath.mAttribute_string.reader_lastPathComponent (SOURCE_FILE ("galgas_prgm.gProgram", 392)).reader_stringByDeletingPathExtension (SOURCE_FILE ("galgas_prgm.gProgram", 392)) ;
            GALGAS_string var_directory = var_fullFilePath.mAttribute_string.reader_stringByDeletingLastPathComponent (SOURCE_FILE ("galgas_prgm.gProgram", 393)).operator_concat (GALGAS_string ("/../galgas-sources/")  COMMA_SOURCE_FILE ("galgas_prgm.gProgram", 393)) ;
            GALGAS_string var_newProjectFile = var_directory.operator_concat (var_projectName  COMMA_SOURCE_FILE ("galgas_prgm.gProgram", 394)).operator_concat (GALGAS_string (".galgas")  COMMA_SOURCE_FILE ("galgas_prgm.gProgram", 394)) ;
            GALGAS_bool joker_18380_0 ; // Joker input parameter
            var_translatedSource.method_writeToFileWhenDifferentContents (var_newProjectFile, joker_18380_0, inCompiler COMMA_SOURCE_FILE ("galgas_prgm.gProgram", 395)) ;
          }
          {
          var_parsedComponentStruct.mAttribute_mParsedProgramComponentMap.modifier_insertKey (var_componentName, var_fullFilePath, var_programComponentAST, inCompiler COMMA_SOURCE_FILE ("galgas_prgm.gProgram", 397)) ;
          }
        }else if (kBoolFalse == test_29) {
          GALGAS_location location_32 (enumerator_10539.current_mFilePath (HERE).reader_location (HERE)) ; // Implicit use of 'location' reader
          inCompiler->emitSemanticError (location_32, GALGAS_string ("extension of a program component should be '.gProgram'.")  COMMA_SOURCE_FILE ("galgas_prgm.gProgram", 399)) ;
        }
        } break ;
      }
    }
    enumerator_10539.gotoNextObject () ;
  }
  GALGAS_stringset var_handledExtensionSet = GALGAS_stringset::constructor_emptySet (SOURCE_FILE ("galgas_prgm.gProgram", 404)) ;
  const enumGalgasBool test_33 = GALGAS_bool (kIsEqual, GALGAS_uint::constructor_errorCount (SOURCE_FILE ("galgas_prgm.gProgram", 405)).objectCompare (GALGAS_uint ((uint32_t) 0U))).boolEnum () ;
  if (kBoolTrue == test_33) {
    cEnumerator_parsedLexiqueComponentMap enumerator_18895 (var_parsedComponentStruct.mAttribute_mParsedLexiqueComponentMap, kEnumeration_up) ;
    while (enumerator_18895.hasCurrentObject ()) {
      const enumGalgasBool test_34 = GALGAS_bool (gOption_galgas_5F_builtin_5F_options_verbose_5F_output.reader_value ()).boolEnum () ;
      if (kBoolTrue == test_34) {
        inCompiler->printMessage (GALGAS_string ("*** Compiling '").operator_concat (enumerator_18895.current_lkey (HERE).reader_string (SOURCE_FILE ("galgas_prgm.gProgram", 409))  COMMA_SOURCE_FILE ("galgas_prgm.gProgram", 409)).operator_concat (GALGAS_string (".gLexique'\n")  COMMA_SOURCE_FILE ("galgas_prgm.gProgram", 409))  COMMA_SOURCE_FILE ("galgas_prgm.gProgram", 409)) ;
      }
      {
      routine_compileLexiqueComponentFromAST (enumerator_18895.current_lkey (HERE).mAttribute_string, var_outputDirectory, enumerator_18895.current_mLexiqueComponentAST (HERE), inCompiler  COMMA_SOURCE_FILE ("galgas_prgm.gProgram", 411)) ;
      }
      enumerator_18895.gotoNextObject () ;
    }
    cEnumerator_parsedGuiComponentMap enumerator_19238 (var_parsedComponentStruct.mAttribute_mParsedGuiComponentMap, kEnumeration_up) ;
    while (enumerator_19238.hasCurrentObject ()) {
      const enumGalgasBool test_35 = GALGAS_bool (gOption_galgas_5F_builtin_5F_options_verbose_5F_output.reader_value ()).boolEnum () ;
      if (kBoolTrue == test_35) {
        inCompiler->printMessage (GALGAS_string ("*** Compiling '").operator_concat (enumerator_19238.current_lkey (HERE).reader_string (SOURCE_FILE ("galgas_prgm.gProgram", 420))  COMMA_SOURCE_FILE ("galgas_prgm.gProgram", 420)).operator_concat (GALGAS_string (".gGui'\n")  COMMA_SOURCE_FILE ("galgas_prgm.gProgram", 420))  COMMA_SOURCE_FILE ("galgas_prgm.gProgram", 420)) ;
      }
      {
      routine_compileGuiComponentFromAST (enumerator_19238.current_mSourceFullFilePath (HERE), var_outputDirectory, enumerator_19238.current_mGuiComponentAST (HERE), var_parsedComponentStruct, inCompiler  COMMA_SOURCE_FILE ("galgas_prgm.gProgram", 422)) ;
      }
      enumerator_19238.gotoNextObject () ;
    }
    cEnumerator_parsedOptionComponentMap enumerator_19614 (var_parsedComponentStruct.mAttribute_mParsedOptionComponentMap, kEnumeration_up) ;
    while (enumerator_19614.hasCurrentObject ()) {
      const enumGalgasBool test_36 = GALGAS_bool (gOption_galgas_5F_builtin_5F_options_verbose_5F_output.reader_value ()).boolEnum () ;
      if (kBoolTrue == test_36) {
        inCompiler->printMessage (GALGAS_string ("*** Compiling '").operator_concat (enumerator_19614.current_lkey (HERE).reader_string (SOURCE_FILE ("galgas_prgm.gProgram", 432))  COMMA_SOURCE_FILE ("galgas_prgm.gProgram", 432)).operator_concat (GALGAS_string (".gOption'\n")  COMMA_SOURCE_FILE ("galgas_prgm.gProgram", 432))  COMMA_SOURCE_FILE ("galgas_prgm.gProgram", 432)) ;
      }
      {
      routine_compileOptionComponentAST (var_outputDirectory, enumerator_19614.current_lkey (HERE), enumerator_19614.current_mBoolOptionMap (HERE), enumerator_19614.current_mUIntOptionMap (HERE), enumerator_19614.current_mStringOptionMap (HERE), inCompiler  COMMA_SOURCE_FILE ("galgas_prgm.gProgram", 434)) ;
      }
      enumerator_19614.gotoNextObject () ;
    }
    cEnumerator_parsedSemanticsComponentMap enumerator_19998 (var_parsedComponentStruct.mAttribute_mParsedSemanticsComponentMap, kEnumeration_up) ;
    while (enumerator_19998.hasCurrentObject ()) {
      const enumGalgasBool test_37 = GALGAS_bool (gOption_galgas_5F_builtin_5F_options_verbose_5F_output.reader_value ()).boolEnum () ;
      if (kBoolTrue == test_37) {
        inCompiler->printMessage (GALGAS_string ("*** Compiling '").operator_concat (enumerator_19998.current_lkey (HERE).reader_string (SOURCE_FILE ("galgas_prgm.gProgram", 445))  COMMA_SOURCE_FILE ("galgas_prgm.gProgram", 445)).operator_concat (GALGAS_string (".gSemantics'\n")  COMMA_SOURCE_FILE ("galgas_prgm.gProgram", 445))  COMMA_SOURCE_FILE ("galgas_prgm.gProgram", 445)) ;
      }
      {
      routine_compileSemanticsComponentAST (enumerator_19998.current_mSourceFullFilePath (HERE), var_outputDirectory, enumerator_19998.current_mSemanticComponentRoot (HERE), var_parsedComponentStruct, inCompiler  COMMA_SOURCE_FILE ("galgas_prgm.gProgram", 447)) ;
      }
      enumerator_19998.gotoNextObject () ;
    }
    cEnumerator_parsedSyntaxComponentMap enumerator_20388 (var_parsedComponentStruct.mAttribute_mParsedSyntaxComponentMap, kEnumeration_up) ;
    while (enumerator_20388.hasCurrentObject ()) {
      const enumGalgasBool test_38 = GALGAS_bool (gOption_galgas_5F_builtin_5F_options_verbose_5F_output.reader_value ()).boolEnum () ;
      if (kBoolTrue == test_38) {
        inCompiler->printMessage (GALGAS_string ("*** Compiling '").operator_concat (enumerator_20388.current_lkey (HERE).reader_string (SOURCE_FILE ("galgas_prgm.gProgram", 457))  COMMA_SOURCE_FILE ("galgas_prgm.gProgram", 457)).operator_concat (GALGAS_string (".gSyntax'\n")  COMMA_SOURCE_FILE ("galgas_prgm.gProgram", 457))  COMMA_SOURCE_FILE ("galgas_prgm.gProgram", 457)) ;
      }
      {
      routine_compileSyntaxComponentFromAST (enumerator_20388.current_mSourceFullFilePath (HERE), var_outputDirectory, enumerator_20388.current_mSyntaxComponentRoot (HERE), var_parsedComponentStruct, inCompiler  COMMA_SOURCE_FILE ("galgas_prgm.gProgram", 459)) ;
      }
      enumerator_20388.gotoNextObject () ;
    }
    cEnumerator_parsedGrammarComponentMap enumerator_20776 (var_parsedComponentStruct.mAttribute_mParsedGrammarComponentMap, kEnumeration_up) ;
    while (enumerator_20776.hasCurrentObject ()) {
      const enumGalgasBool test_39 = GALGAS_bool (gOption_galgas_5F_builtin_5F_options_verbose_5F_output.reader_value ()).boolEnum () ;
      if (kBoolTrue == test_39) {
        inCompiler->printMessage (GALGAS_string ("*** Compiling '").operator_concat (enumerator_20776.current_lkey (HERE).reader_string (SOURCE_FILE ("galgas_prgm.gProgram", 469))  COMMA_SOURCE_FILE ("galgas_prgm.gProgram", 469)).operator_concat (GALGAS_string (".gGrammar'\n")  COMMA_SOURCE_FILE ("galgas_prgm.gProgram", 469))  COMMA_SOURCE_FILE ("galgas_prgm.gProgram", 469)) ;
      }
      {
      routine_compileGrammarComponentFromAST (enumerator_20776.current_mSourceFullFilePath (HERE), var_outputDirectory, enumerator_20776.current_mGrammarComponentRoot (HERE), var_parsedComponentStruct, inCompiler  COMMA_SOURCE_FILE ("galgas_prgm.gProgram", 471)) ;
      }
      enumerator_20776.gotoNextObject () ;
    }
    cEnumerator_parsedProgramComponentMap enumerator_21167 (var_parsedComponentStruct.mAttribute_mParsedProgramComponentMap, kEnumeration_up) ;
    while (enumerator_21167.hasCurrentObject ()) {
      cEnumerator_programRuleList enumerator_21220 (enumerator_21167.current_mProgramComponentAST (HERE).mAttribute_mProgramRules, kEnumeration_up) ;
      while (enumerator_21220.hasCurrentObject ()) {
        var_handledExtensionSet.addAssign_operation (enumerator_21220.current_mSourceFileExtension (HERE).mAttribute_string  COMMA_SOURCE_FILE ("galgas_prgm.gProgram", 481)) ;
        enumerator_21220.gotoNextObject () ;
      }
      const enumGalgasBool test_40 = GALGAS_bool (gOption_galgas_5F_builtin_5F_options_verbose_5F_output.reader_value ()).boolEnum () ;
      if (kBoolTrue == test_40) {
        inCompiler->printMessage (GALGAS_string ("*** Compiling '").operator_concat (enumerator_21167.current_lkey (HERE).reader_string (SOURCE_FILE ("galgas_prgm.gProgram", 484))  COMMA_SOURCE_FILE ("galgas_prgm.gProgram", 484)).operator_concat (GALGAS_string (".gProgram'\n")  COMMA_SOURCE_FILE ("galgas_prgm.gProgram", 484))  COMMA_SOURCE_FILE ("galgas_prgm.gProgram", 484)) ;
      }
      {
      routine_compileProgramComponentFromAST (enumerator_21167.current_mSourceFullFilePath (HERE), var_outputDirectory, enumerator_21167.current_mProgramComponentAST (HERE), var_parsedComponentStruct, inCompiler  COMMA_SOURCE_FILE ("galgas_prgm.gProgram", 486)) ;
      }
      enumerator_21167.gotoNextObject () ;
    }
  }
  const enumGalgasBool test_41 = GALGAS_bool (kIsEqual, GALGAS_uint::constructor_errorCount (SOURCE_FILE ("galgas_prgm.gProgram", 495)).objectCompare (GALGAS_uint ((uint32_t) 0U))).boolEnum () ;
  if (kBoolTrue == test_41) {
    const enumGalgasBool test_42 = GALGAS_bool (gOption_galgas_5F_builtin_5F_options_verbose_5F_output.reader_value ()).boolEnum () ;
    if (kBoolTrue == test_42) {
      inCompiler->printMessage (GALGAS_string ("*** Perform global checkings\n")  COMMA_SOURCE_FILE ("galgas_prgm.gProgram", 497)) ;
    }
    {
    routine_performProjectGlobalCheckings (var_parsedComponentStruct, constinArgument_inProjectSourceFile.mAttribute_string, inCompiler  COMMA_SOURCE_FILE ("galgas_prgm.gProgram", 499)) ;
    }
  }
  const enumGalgasBool test_43 = GALGAS_bool (kIsEqual, GALGAS_uint ((uint32_t) 0U).objectCompare (GALGAS_uint::constructor_errorCount (SOURCE_FILE ("galgas_prgm.gProgram", 505)))).boolEnum () ;
  if (kBoolTrue == test_43) {
    {
    routine_updateTargets (constinArgument_inProjectSourceFile, var_projectComponentAST.mAttribute_mMajorVersion.mAttribute_uint.reader_string (SOURCE_FILE ("galgas_prgm.gProgram", 508)).operator_concat (GALGAS_string (".")  COMMA_SOURCE_FILE ("galgas_prgm.gProgram", 508)).operator_concat (var_projectComponentAST.mAttribute_mMinorVersion.mAttribute_uint.reader_string (SOURCE_FILE ("galgas_prgm.gProgram", 508))  COMMA_SOURCE_FILE ("galgas_prgm.gProgram", 508)).operator_concat (GALGAS_string (".")  COMMA_SOURCE_FILE ("galgas_prgm.gProgram", 508)).operator_concat (var_projectComponentAST.mAttribute_mRevisionVersion.mAttribute_uint.reader_string (SOURCE_FILE ("galgas_prgm.gProgram", 508))  COMMA_SOURCE_FILE ("galgas_prgm.gProgram", 508)), var_projectComponentAST.reader_mProjectName (SOURCE_FILE ("galgas_prgm.gProgram", 509)), var_targetName, var_projectQualifiedFeatureMap, var_projectComponentAST.reader_mGenerationFeatureList (SOURCE_FILE ("galgas_prgm.gProgram", 512)), var_projectComponentAST.reader_mProjectSourceList (SOURCE_FILE ("galgas_prgm.gProgram", 513)), var_handledExtensionSet, inCompiler  COMMA_SOURCE_FILE ("galgas_prgm.gProgram", 506)) ;
    }
  }
}


//---------------------------------------------------------------------------------------------------------------------*
//                                                                                                                     *
//                                               Routine 'programRule_9'                                               *
//                                                                                                                     *
//---------------------------------------------------------------------------------------------------------------------*

void routine_programRule_5F__39_ (const GALGAS_lstring constinArgument_inProjectSourceFile,
                                  C_Compiler * inCompiler
                                  COMMA_UNUSED_LOCATION_ARGS) {
  {
  routine_compileProject (constinArgument_inProjectSourceFile, GALGAS_string::makeEmptyString (), inCompiler  COMMA_SOURCE_FILE ("galgas_prgm.gProgram", 529)) ;
  }
}


//---------------------------------------------------------------------------------------------------------------------*
//                                                                                                                     *
//                                              Routine 'programRule_10'                                               *
//                                                                                                                     *
//---------------------------------------------------------------------------------------------------------------------*

void routine_programRule_5F__31__30_ (const GALGAS_lstring constinArgument_inSourceFile,
                                      C_Compiler * inCompiler
                                      COMMA_UNUSED_LOCATION_ARGS) {
  GALGAS_string var_parentDirectory = constinArgument_inSourceFile.mAttribute_string.reader_stringByDeletingLastPathComponent (SOURCE_FILE ("galgas_prgm.gProgram", 812)).reader_stringByDeletingLastPathComponent (SOURCE_FILE ("galgas_prgm.gProgram", 812)) ;
  GALGAS_stringlist temp_0 = GALGAS_stringlist::constructor_emptyList (SOURCE_FILE ("galgas_prgm.gProgram", 813)) ;
  temp_0.addAssign_operation (GALGAS_string ("galgasProject")  COMMA_SOURCE_FILE ("galgas_prgm.gProgram", 813)) ;
  GALGAS_stringlist var_candidateProjectFiles = var_parentDirectory.reader_regularFilesWithExtensions (GALGAS_bool (false), temp_0 COMMA_SOURCE_FILE ("galgas_prgm.gProgram", 813)) ;
  const enumGalgasBool test_1 = GALGAS_bool (kIsEqual, var_candidateProjectFiles.reader_length (SOURCE_FILE ("galgas_prgm.gProgram", 814)).objectCompare (GALGAS_uint ((uint32_t) 0U))).boolEnum () ;
  if (kBoolTrue == test_1) {
    GALGAS_location location_2 (constinArgument_inSourceFile.reader_location (HERE)) ; // Implicit use of 'location' reader
    inCompiler->emitSemanticError (location_2, GALGAS_string ("no project file in parent directory of source file")  COMMA_SOURCE_FILE ("galgas_prgm.gProgram", 815)) ;
  }else if (kBoolFalse == test_1) {
    const enumGalgasBool test_3 = GALGAS_bool (kIsStrictSup, var_candidateProjectFiles.reader_length (SOURCE_FILE ("galgas_prgm.gProgram", 816)).objectCompare (GALGAS_uint ((uint32_t) 1U))).boolEnum () ;
    if (kBoolTrue == test_3) {
      GALGAS_string var_s = GALGAS_string ("several project files in source file parent directory:") ;
      cEnumerator_stringlist enumerator_35645 (var_candidateProjectFiles, kEnumeration_up) ;
      while (enumerator_35645.hasCurrentObject ()) {
        var_s.dotAssign_operation (GALGAS_string ("\n"
          "  - ").add_operation (enumerator_35645.current_mValue (HERE), inCompiler COMMA_SOURCE_FILE ("galgas_prgm.gProgram", 819))  COMMA_SOURCE_FILE ("galgas_prgm.gProgram", 819)) ;
        enumerator_35645.gotoNextObject () ;
      }
      GALGAS_location location_4 (constinArgument_inSourceFile.reader_location (HERE)) ; // Implicit use of 'location' reader
      inCompiler->emitSemanticError (location_4, var_s  COMMA_SOURCE_FILE ("galgas_prgm.gProgram", 821)) ;
    }else if (kBoolFalse == test_3) {
      GALGAS_string var_projectFilePath = var_parentDirectory.add_operation (GALGAS_string ("/"), inCompiler COMMA_SOURCE_FILE ("galgas_prgm.gProgram", 823)).add_operation (var_candidateProjectFiles.reader_mValueAtIndex (GALGAS_uint ((uint32_t) 0U), inCompiler COMMA_SOURCE_FILE ("galgas_prgm.gProgram", 823)), inCompiler COMMA_SOURCE_FILE ("galgas_prgm.gProgram", 823)) ;
      {
      routine_compileProject (GALGAS_lstring::constructor_new (var_projectFilePath, constinArgument_inSourceFile.mAttribute_location  COMMA_SOURCE_FILE ("galgas_prgm.gProgram", 824)), constinArgument_inSourceFile.mAttribute_string, inCompiler  COMMA_SOURCE_FILE ("galgas_prgm.gProgram", 824)) ;
      }
    }
  }
}


//---------------------------------------------------------------------------------------------------------------------*
//                                                                                                                     *
//                                                   Routine 'after'                                                   *
//                                                                                                                     *
//---------------------------------------------------------------------------------------------------------------------*

void routine_after (C_Compiler * /* inCompiler */
                    COMMA_UNUSED_LOCATION_ARGS) {
  {
  }
}


//---------------------------------------------------------------------------------------------------------------------*
//                                                                                                                     *
//                      M A I N    F O R    L I B P M                                                                  *
//                                                                                                                     *
//---------------------------------------------------------------------------------------------------------------------*

int mainForLIBPM (int inArgc, const char * inArgv []) {
//--- Analyze Command Line Options
  TC_UniqueArray <C_String> sourceFilesArray ;
  F_Analyze_CLI_Options (inArgc, inArgv,
                         kVersionString,
                         sourceFilesArray,
                         kSourceFileExtensions,
                         kSourceFileHelpMessages,
                         print_tool_help_message) ;
//---
  bool verboseOptionOn = true ;
  int16_t returnCode = 0 ; // No error
//--- Set Execution mode
  C_String executionModeOptionErrorMessage ;
  setExecutionMode (executionModeOptionErrorMessage) ;
  if (executionModeOptionErrorMessage.length () > 0) {
    co << executionModeOptionErrorMessage ;
    returnCode = 1 ;
  }else{
  //--- Common lexique object
    C_Compiler * commonLexique = NULL ;
    macroMyNew (commonLexique, C_Compiler (NULL, "", "" COMMA_HERE)) ;
    try{
      routine_before (commonLexique COMMA_HERE) ;
      verboseOptionOn = gOption_galgas_5F_builtin_5F_options_verbose_5F_output.mValue ;
      for (int32_t i=0 ; i<sourceFilesArray.count () ; i++) {
        setCurrentCompiledFilePath (sourceFilesArray (i COMMA_HERE)) ;
        if (gOption_galgas_5F_builtin_5F_options_trace.mValue) {
          enableTraceWithPath (sourceFilesArray (i COMMA_HERE)) ;
        }
        const C_String fileExtension = sourceFilesArray (i COMMA_HERE).pathExtension () ;
        const GALGAS_string sfp = GALGAS_string (sourceFilesArray (i COMMA_HERE)) ;
        const GALGAS_location location = commonLexique->here () ;
        const GALGAS_lstring sourceFilePath (sfp, location) ;
        int16_t r = 0 ;
        if (fileExtension == "gTemplate") {
          if (executionModeIsIndexing ()) {
            cGrammar_projectLL_31_grammar::performIndexing (commonLexique, sourceFilesArray (i COMMA_HERE)) ;
          }else{
            routine_programRule_5F__30_ (sourceFilePath, commonLexique COMMA_HERE) ;
          }
        }else if (fileExtension == "gOption") {
          if (executionModeIsIndexing ()) {
            cGrammar_optionLL_31_grammar::performIndexing (commonLexique, sourceFilesArray (i COMMA_HERE)) ;
          }else{
            routine_programRule_5F__31_ (sourceFilePath, commonLexique COMMA_HERE) ;
          }
        }else if (fileExtension == "gLexique") {
          if (executionModeIsIndexing ()) {
            cGrammar_lexiqueLL_31_grammar::performIndexing (commonLexique, sourceFilesArray (i COMMA_HERE)) ;
          }else{
            routine_programRule_5F__32_ (sourceFilePath, commonLexique COMMA_HERE) ;
          }
        }else if (fileExtension == "gSemantics") {
          if (executionModeIsIndexing ()) {
            cGrammar_semanticsSLRgrammar::performIndexing (commonLexique, sourceFilesArray (i COMMA_HERE)) ;
          }else{
            routine_programRule_5F__33_ (sourceFilePath, commonLexique COMMA_HERE) ;
          }
        }else if (fileExtension == "gSyntax") {
          if (executionModeIsIndexing ()) {
            cGrammar_syntaxSLRgrammar::performIndexing (commonLexique, sourceFilesArray (i COMMA_HERE)) ;
          }else{
            routine_programRule_5F__34_ (sourceFilePath, commonLexique COMMA_HERE) ;
          }
        }else if (fileExtension == "gGrammar") {
          if (executionModeIsIndexing ()) {
            cGrammar_grammarLL_31_grammar::performIndexing (commonLexique, sourceFilesArray (i COMMA_HERE)) ;
          }else{
            routine_programRule_5F__35_ (sourceFilePath, commonLexique COMMA_HERE) ;
          }
        }else if (fileExtension == "gGui") {
          if (executionModeIsIndexing ()) {
            cGrammar_guiGrammar::performIndexing (commonLexique, sourceFilesArray (i COMMA_HERE)) ;
          }else{
            routine_programRule_5F__36_ (sourceFilePath, commonLexique COMMA_HERE) ;
          }
        }else if (fileExtension == "gProgram") {
          if (executionModeIsIndexing ()) {
            cGrammar_programSLRgrammar::performIndexing (commonLexique, sourceFilesArray (i COMMA_HERE)) ;
          }else{
            routine_programRule_5F__37_ (sourceFilePath, commonLexique COMMA_HERE) ;
          }
        }else if (fileExtension == "gProject") {
          if (executionModeIsIndexing ()) {
            cGrammar_projectLL_31_grammar::performIndexing (commonLexique, sourceFilesArray (i COMMA_HERE)) ;
          }else{
            routine_programRule_5F__38_ (sourceFilePath, commonLexique COMMA_HERE) ;
          }
        }else if (fileExtension == "galgasProject") {
          if (! executionModeIsIndexing ()) {
            routine_programRule_5F__39_ (sourceFilePath, commonLexique COMMA_HERE) ;
          }
        }else if (fileExtension == "galgas") {
          if (executionModeIsIndexing ()) {
            cGrammar_galgas_33_Grammar::performIndexing (commonLexique, sourceFilesArray (i COMMA_HERE)) ;
          }else{
            routine_programRule_5F__31__30_ (sourceFilePath, commonLexique COMMA_HERE) ;
          }
        }else{
          printf ("*** Error: unhandled extension for file '%s' ***\n", sourceFilesArray (i COMMA_HERE).cString (HERE)) ;
          r = 1 ;
        }
        if (r != 0) {
          returnCode = r ;
        }
        closeTrace () ;
      }
    //--- Error or warnings ?
      if (totalErrorCount () > 0) {
        returnCode = 1 ; // Error code
      }else if (totalWarningCount () > 0) {
        if (gOption_galgas_5F_builtin_5F_options_treat_5F_warnings_5F_as_5F_error.mValue) {
          returnCode = 1 ; // Error code
          if (verboseOptionOn) {
            printf ("** Note: warnings are treated as errors. **\n") ;
          }
        }
      }
    //--- Epilogue
      routine_after (commonLexique COMMA_HERE) ;
    //--- Display error and warnings count
      if (gOption_galgas_5F_builtin_5F_options_verbose_5F_output.mValue || (totalWarningCount () > 0) || (totalErrorCount () > 0)) {
        C_String message ;
        if (totalWarningCount () == 0) {
          message << "No warning" ;
        }else if (totalWarningCount () == 1) {
          message << "1 warning" ;
        }else{
          message << cStringWithSigned (totalWarningCount ()) << " warnings" ;
        }
        message << ", " ;
        if (totalErrorCount () == 0) {
          message << "no error" ;
        }else if (totalErrorCount () == 1) {
          message << "1 error" ;
        }else{
          message << cStringWithSigned (totalErrorCount ()) << " errors" ;
        }
        message << ".\n" ;
        ggs_printMessage (message COMMA_HERE) ;
      }
    }catch (const ::std:: exception & e) {
      F_default_display_exception (e) ;
      returnCode = 1 ; // Error code
    }catch (...) {
      printf ("**** Unknow exception ****\n") ;
      throw ;
    }
    macroDetachSharedObject (commonLexique) ;
  }
  return returnCode ;
}

//--- START OF USER ZONE 2


//--- END OF USER ZONE 2


