//---------------------------------------------------------------------------*
//                                                                           *
//                  File 'grammarComputationsWithBDDs.cpp'                   *
//                 Generated by version GALGAS_BETA_VERSION                  *
//                     november 7th, 2009, at 14h54'8"                       *
//                                                                           *
//---------------------------------------------------------------------------*

//--- START OF USER ZONE 1


//--- END OF USER ZONE 1

//---------------------------------------------------------------------------*

#include "version_libpm.h"
#if LIBPM_VERSION != THE_LIBPM_VERSION
  #error "This file has been compiled with a version of GALGAS different than the version of libpm"
#endif

//---------------------------------------------------------------------------*

#include <typeinfo>
#include "utilities/MF_MemoryControl.h"
#include "files/C_TextFileWrite.h"
#include "galgas/C_galgas_CLI_Options.h"
#include "grammarComputationsWithBDDs.h"

//---------------------------------------------------------------------------*

#ifndef DO_NOT_GENERATE_CHECKINGS
  #define SOURCE_FILE_AT_LINE(line) "grammarComputationsWithBDDs.gSemantics", line
  #define COMMA_SOURCE_FILE_AT_LINE(line) , SOURCE_FILE_AT_LINE(line)
#else
  #define SOURCE_FILE_AT_LINE(line) 
  #define COMMA_SOURCE_FILE_AT_LINE(line) 
#endif


//--- START OF USER ZONE 2


//--- END OF USER ZONE 2

//---------------------------------------------------------------------------*
//                                                                           *
//                     Class for 'grammarDomain' Domain                      *
//                                                                           *
//---------------------------------------------------------------------------*

GGS_grammarDomain::GGS_grammarDomain (void) :
AC_galgas_domain (),
mDomain_V (),
mBDDVariableCountForDomain_V (0),
mBDDForRelation_nonterminalsWithEmptyProduction (),
mBDDForRelation_nonterminalsWithOneElementProduction (),
mBDDForRelation_nonterminalsWithTwoElementProduction () {
}

//---------------------------------------------------------------------------*

GGS_grammarDomain::~GGS_grammarDomain (void) {
}

//---------------------------------------------------------------------------*

GGS_grammarDomain GGS_grammarDomain::
constructor_domainWithNames (C_Compiler & /* inLexique */,
                             const GGS_stringlist & inDomain_V
                             COMMA_UNUSED_LOCATION_ARGS) {
  GGS_grammarDomain result ;
  result.mIsBuilt = true ;
  result.mDomain_V = inDomain_V ;
  result.mBDDVariableCountForDomain_V = AC_galgas_domain::bitCountForDomainSize (inDomain_V.count ()) ;
  return result ;
}

//---------------------------------------------------------------------------*

void GGS_grammarDomain::
modifier_addToNonterminalsWithEmptyProduction (C_Compiler & /* inLexique */,
                                    const GGS_uint & inValue_0
                                    COMMA_UNUSED_LOCATION_ARGS) {
  if (isBuilt () && inValue_0.isBuilt ()) {
    PMUInt16 idx = 0 ;
    const C_BDD value_0 = C_BDD::varCompareConst (idx, mBDDVariableCountForDomain_V, C_BDD::kEqual, inValue_0.uintValue ()) ;
    idx = (PMUInt16) (idx + mBDDVariableCountForDomain_V) ;
    mBDDForRelation_nonterminalsWithEmptyProduction |= value_0 ;
  }
}

//---------------------------------------------------------------------------*

void GGS_grammarDomain::
modifier_resetNonterminalsWithEmptyProduction (C_Compiler & /* inLexique */
                                    COMMA_UNUSED_LOCATION_ARGS) {
  mBDDForRelation_nonterminalsWithEmptyProduction.setToFalse () ;
}

//---------------------------------------------------------------------------*

GGS_stringlist GGS_grammarDomain::
reader_nonterminalsWithEmptyProductionStringValueList (C_Compiler & inLexique
                                    COMMA_LOCATION_ARGS) const {
  GGS_stringlist result ;
  if (isBuilt ()) {
    TC_UniqueArray <PMUInt64> valuesArray ;
    mBDDForRelation_nonterminalsWithEmptyProduction.buildValueArray (valuesArray, mBDDVariableCountForDomain_V) ;
    result = GGS_stringlist::constructor_emptyList () ;
    for (PMSInt32 i=0 ; i<valuesArray.count () ; i++) {
      const PMUInt64 v = valuesArray (i COMMA_HERE) ;
      result.addAssign_operation (mDomain_V.reader_mValueAtIndex (inLexique, GGS_uint64 (true, v).reader_uint (inLexique COMMA_THERE) COMMA_THERE)) ;
    }
  }
  return result ;
}

//---------------------------------------------------------------------------*

void GGS_grammarDomain::
modifier_addToNonterminalsWithOneElementProduction (C_Compiler & /* inLexique */,
                                    const GGS_uint & inValue_0,
                                    const GGS_uint & inValue_1
                                    COMMA_UNUSED_LOCATION_ARGS) {
  if (isBuilt () && inValue_0.isBuilt () && inValue_1.isBuilt ()) {
    PMUInt16 idx = 0 ;
    const C_BDD value_0 = C_BDD::varCompareConst (idx, mBDDVariableCountForDomain_V, C_BDD::kEqual, inValue_0.uintValue ()) ;
    idx = (PMUInt16) (idx + mBDDVariableCountForDomain_V) ;
    const C_BDD value_1 = C_BDD::varCompareConst (idx, mBDDVariableCountForDomain_V, C_BDD::kEqual, inValue_1.uintValue ()) ;
    idx = (PMUInt16) (idx + mBDDVariableCountForDomain_V) ;
    mBDDForRelation_nonterminalsWithOneElementProduction |= value_0 & value_1 ;
  }
}

//---------------------------------------------------------------------------*

void GGS_grammarDomain::
modifier_resetNonterminalsWithOneElementProduction (C_Compiler & /* inLexique */
                                    COMMA_UNUSED_LOCATION_ARGS) {
  mBDDForRelation_nonterminalsWithOneElementProduction.setToFalse () ;
}

//---------------------------------------------------------------------------*

GGS_string2list GGS_grammarDomain::
reader_nonterminalsWithOneElementProductionStringValueList (C_Compiler & inLexique
                                    COMMA_LOCATION_ARGS) const {
  GGS_string2list result ;
  if (isBuilt ()) {
    const PMUInt16 variableCount = (PMUInt16) (mBDDVariableCountForDomain_V + mBDDVariableCountForDomain_V) ;
    TC_UniqueArray <PMUInt64> valuesArray ;
    mBDDForRelation_nonterminalsWithOneElementProduction.buildValueArray (valuesArray, variableCount) ;
    result = GGS_string2list::constructor_emptyList () ;
    const PMUInt64 mask0 = (1ULL << mBDDVariableCountForDomain_V) - 1ULL ;
    const PMUInt64 mask1 = ((1ULL << mBDDVariableCountForDomain_V) - 1ULL) << mBDDVariableCountForDomain_V ;
    for (PMSInt32 i=0 ; i<valuesArray.count () ; i++) {
      const PMUInt64 v = valuesArray (i COMMA_HERE) ;
      const PMUInt64 v0 = v & mask0 ;
      const PMUInt64 v1 = (v & mask1) >> mBDDVariableCountForDomain_V ;
      const GGS_string s0 = mDomain_V.reader_mValueAtIndex (inLexique, GGS_uint (true, (PMUInt32) v0) COMMA_THERE) ;
      const GGS_string s1 = mDomain_V.reader_mValueAtIndex (inLexique, GGS_uint (true, (PMUInt32) v1) COMMA_THERE) ;
      result.addAssign_operation (s0, s1) ;
    }
  }
  return result ;
}

//---------------------------------------------------------------------------*

void GGS_grammarDomain::
modifier_addToNonterminalsWithTwoElementProduction (C_Compiler & /* inLexique */,
                                    const GGS_uint & inValue_0,
                                    const GGS_uint & inValue_1,
                                    const GGS_uint & inValue_2
                                    COMMA_UNUSED_LOCATION_ARGS) {
  if (isBuilt () && inValue_0.isBuilt () && inValue_1.isBuilt () && inValue_2.isBuilt ()) {
    PMUInt16 idx = 0 ;
    const C_BDD value_0 = C_BDD::varCompareConst (idx, mBDDVariableCountForDomain_V, C_BDD::kEqual, inValue_0.uintValue ()) ;
    idx = (PMUInt16) (idx + mBDDVariableCountForDomain_V) ;
    const C_BDD value_1 = C_BDD::varCompareConst (idx, mBDDVariableCountForDomain_V, C_BDD::kEqual, inValue_1.uintValue ()) ;
    idx = (PMUInt16) (idx + mBDDVariableCountForDomain_V) ;
    const C_BDD value_2 = C_BDD::varCompareConst (idx, mBDDVariableCountForDomain_V, C_BDD::kEqual, inValue_2.uintValue ()) ;
    idx = (PMUInt16) (idx + mBDDVariableCountForDomain_V) ;
    mBDDForRelation_nonterminalsWithTwoElementProduction |= value_0 & value_1 & value_2 ;
  }
}

//---------------------------------------------------------------------------*

void GGS_grammarDomain::
modifier_resetNonterminalsWithTwoElementProduction (C_Compiler & /* inLexique */
                                    COMMA_UNUSED_LOCATION_ARGS) {
  mBDDForRelation_nonterminalsWithTwoElementProduction.setToFalse () ;
}

//---------------------------------------------------------------------------*

GGS_string3list GGS_grammarDomain::
reader_nonterminalsWithTwoElementProductionStringValueList (C_Compiler & inLexique
                                    COMMA_LOCATION_ARGS) const {
  GGS_string3list result ;
  if (isBuilt ()) {
    const PMUInt32 variable01Count = (PMUInt32) (mBDDVariableCountForDomain_V + mBDDVariableCountForDomain_V) ;
    const PMUInt16 variableCount = (PMUInt16) (variable01Count + mBDDVariableCountForDomain_V) ;
    TC_UniqueArray <PMUInt64> valuesArray ;
    mBDDForRelation_nonterminalsWithTwoElementProduction.buildValueArray (valuesArray, variableCount) ;
    result = GGS_string3list::constructor_emptyList () ;
    const PMUInt64 mask0 = (1ULL << mBDDVariableCountForDomain_V) - 1ULL ;
    const PMUInt64 mask1 = ((1ULL << mBDDVariableCountForDomain_V) - 1ULL) << mBDDVariableCountForDomain_V ;
    const PMUInt64 mask2 = ((1ULL << mBDDVariableCountForDomain_V) - 1ULL) << variable01Count ;
    for (PMSInt32 i=0 ; i<valuesArray.count () ; i++) {
      const PMUInt64 v = valuesArray (i COMMA_HERE) ;
      const PMUInt64 v0 = v & mask0 ;
      const PMUInt64 v1 = (v & mask1) >> mBDDVariableCountForDomain_V ;
      const PMUInt64 v2 = (v & mask2) >> variable01Count ;
      const GGS_string s0 = mDomain_V.reader_mValueAtIndex (inLexique, GGS_uint (true, (PMUInt32) v0) COMMA_THERE) ;
      const GGS_string s1 = mDomain_V.reader_mValueAtIndex (inLexique, GGS_uint (true, (PMUInt32) v1) COMMA_THERE) ;
      const GGS_string s2 = mDomain_V.reader_mValueAtIndex (inLexique, GGS_uint (true, (PMUInt32) v2) COMMA_THERE) ;
      result.addAssign_operation (s0, s1, s2) ;
    }
  }
  return result ;
}

//---------------------------------------------------------------------------*
//                                                                           *
//                         class 'e_vocabularyMap'                           *
//                                                                           *
//---------------------------------------------------------------------------*

e_vocabularyMap::e_vocabularyMap (void) :
mIndex () {
}

//---------------------------------------------------------------------------*
//                                                                           *
//                        class map '@vocabularyMap'                         *
//                                                                           *
//---------------------------------------------------------------------------*

elementOf_GGS_vocabularyMap::
elementOf_GGS_vocabularyMap (const GGS_lstring & inKey,
              const PMSInt32 inIndex,
              const e_vocabularyMap & inInfo) :
AC_galgas_map_element (inKey, inIndex),
mInfo (inInfo) {
}

//---------------------------------------------------------------------------*

void elementOf_GGS_vocabularyMap::
appendForMapDescription (C_Compiler & inLexique,
                         const PMSInt32 inElementIndex,
                         C_String & ioString,
                         const PMSInt32 inIndentation
                         COMMA_LOCATION_ARGS) const {
  ioString << "\n" ;
  ioString.writeStringMultiple ("| ", inIndentation) ;
  ioString << "|-key " ;
  ioString.appendSigned (inElementIndex) ;
  ioString << ":" << mKey.reader_description  (inLexique COMMA_THERE, inIndentation + 1) ;
  ioString << "\n" ;
  ioString.writeStringMultiple ("| ", inIndentation) ;
  ioString << "|-value " ;
  ioString.appendSigned (inElementIndex) ;
  ioString << ":" << mInfo.mIndex.reader_description  (inLexique COMMA_THERE, inIndentation + 1) ;
}

//---------------------------------------------------------------------------*

bool elementOf_GGS_vocabularyMap::
isEqualToMapElement (const AC_galgas_map_element * inOperand) const {
  const elementOf_GGS_vocabularyMap * ptr = dynamic_cast <const elementOf_GGS_vocabularyMap *> (inOperand) ;
  macroValidPointer (ptr) ;
  return (mInfo.mIndex.operator_isEqual (ptr->mInfo.mIndex)).boolValue () ;
}

//---------------------------------------------------------------------------*

AC_galgas_map_element * GGS_vocabularyMap::
new_element (const GGS_lstring & inKey, void * inInfo) {
  MF_Assert (reinterpret_cast <e_vocabularyMap *> (inInfo) != NULL, "Dynamic cast error", 0, 0) ;
  AC_galgas_map_element * p = NULL ;
  e_vocabularyMap * info = (e_vocabularyMap *) inInfo ;
  macroMyNew (p, cElement (inKey, nextIndex (), * info)) ;
  return p ;
}

//---------------------------------------------------------------------------*

void GGS_vocabularyMap::
assignInfo (AC_galgas_map_element * inPtr, void * inInfo) {
  MF_Assert (reinterpret_cast <cElement *> (inPtr) != NULL, "Dynamic cast error", 0, 0) ;
  MF_Assert (reinterpret_cast <e_vocabularyMap *> (inInfo) != NULL, "Dynamic cast error", 0, 0) ;
  cElement * p = (cElement *) inPtr ;
  e_vocabularyMap * info = (e_vocabularyMap *) inInfo ;
  p->mInfo = * info ;
}

//---------------------------------------------------------------------------*

GGS_vocabularyMap GGS_vocabularyMap::
constructor_emptyMap (C_Compiler & /* inLexique */ COMMA_UNUSED_LOCATION_ARGS) {
  GGS_vocabularyMap result ;
  macroMyNew (result.mSharedMapRoot, cMapRoot) ;
  return result ;
}

//---------------------------------------------------------------------------*

void GGS_vocabularyMap::
enterIndex (const GGS_lstring & inKey,
            AC_galgas_index_core & outIndex) {
  e_vocabularyMap info  ;
  internalEnterIndex (inKey,
                      (void *) & info,
                      outIndex) ;
}

//---------------------------------------------------------------------------*

GGS_bool GGS_vocabularyMap::
operator_isEqual (const GGS_vocabularyMap & inOperand) const {
  return GGS_bool (isBuilt () && inOperand.isBuilt (), isEqualToMap (inOperand)) ;
}

//---------------------------------------------------------------------------*

GGS_bool GGS_vocabularyMap::
operator_isNotEqual (const GGS_vocabularyMap & inOperand) const {
  return GGS_bool (isBuilt () && inOperand.isBuilt (), ! isEqualToMap (inOperand)) ;
}

//---------------------------------------------------------------------------*

void GGS_vocabularyMap::
internalInsertForDuplication (AC_galgas_map_element * inPtr) {
  MF_Assert (reinterpret_cast <cElement *> (inPtr) != NULL, "Dynamic cast error", 0, 0) ;
  cElement * p = (cElement *) inPtr ;
  PMSInt32 attributeIndex = -1 ; // Unused here
  GGS_location existingKeyLocation ; // Unused here
  internalInsert (p->mKey, (void *) & p->mInfo, attributeIndex, existingKeyLocation) ;
}

//---------------------------------------------------------------------------*

void GGS_vocabularyMap::
insertElement (C_Compiler & inLexique,
                const utf32 * inErrorMessage,
                const GGS_lstring & inKey,
                const GGS_uint & inParameter0,
                GGS_luint * outIndex
                COMMA_LOCATION_ARGS) {
  PMSInt32 elementID = - 1 ;
  if (isBuilt ()
   && inParameter0.isBuilt ()
   && inKey.isBuilt ()) {
    insulateMap () ;
    e_vocabularyMap info  ;
    info.mIndex = inParameter0 ;
    GGS_location existingKeyLocation ;
    internalInsert (inKey, (void *) & info, elementID, existingKeyLocation) ;
    if (elementID < 0) {
      emitInsertMapSemanticErrorMessage (inLexique, inKey, inErrorMessage, existingKeyLocation COMMA_THERE) ;
    }
  }
  if (outIndex != NULL) {
    * outIndex = GGS_luint (GGS_uint (elementID >= 0, (PMUInt32) elementID), inKey) ;
  }
}

//---------------------------------------------------------------------------*

void GGS_vocabularyMap::
searchElement (C_Compiler & inLexique,
               const utf32 * inErrorMessage,
               const GGS_lstring & inKey,
               GGS_uint   & outParameter0,
               GGS_luint * outIndex
               COMMA_LOCATION_ARGS) const {
  cElement * node = NULL  ;
  if (isBuilt () && inKey.isBuilt ()) {
    AC_galgas_map_element * p = internal_search (inKey.string ()) ;
    MF_Assert ((p == NULL) || (reinterpret_cast <cElement *> (p) != NULL), "Dynamic cast error", 0, 0) ;
    node = (cElement *) p ;
    if (node == NULL) {
      emitMapSemanticErrorMessage (inLexique, inKey, inErrorMessage COMMA_THERE) ;
    }
  }
  if (node == NULL) {
    outParameter0.drop () ;
    if (outIndex != NULL) {
      outIndex->drop () ;
     }
  }else{
    outParameter0 = node->mInfo.mIndex ;
    if (outIndex != NULL) {
      * outIndex = GGS_luint (GGS_uint (true, (PMUInt32) node->mID), inKey) ;
    }
  }
}

//---------------------------------------------------------------------------*

const utf32 GGS_vocabularyMap::kSearchMessage_searchKey [] = {
  TO_UNICODE ('t'),
  TO_UNICODE ('h'),
  TO_UNICODE ('e'),
  TO_UNICODE (' '),
  TO_UNICODE ('\''),
  TO_UNICODE ('@'),
  TO_UNICODE ('%'),
  TO_UNICODE ('K'),
  TO_UNICODE ('\''),
  TO_UNICODE (' '),
  TO_UNICODE ('s'),
  TO_UNICODE ('y'),
  TO_UNICODE ('m'),
  TO_UNICODE ('b'),
  TO_UNICODE ('o'),
  TO_UNICODE ('l'),
  TO_UNICODE (' '),
  TO_UNICODE ('i'),
  TO_UNICODE ('s'),
  TO_UNICODE (' '),
  TO_UNICODE ('n'),
  TO_UNICODE ('o'),
  TO_UNICODE ('t'),
  TO_UNICODE (' '),
  TO_UNICODE ('d'),
  TO_UNICODE ('e'),
  TO_UNICODE ('c'),
  TO_UNICODE ('l'),
  TO_UNICODE ('a'),
  TO_UNICODE ('r'),
  TO_UNICODE ('e'),
  TO_UNICODE ('d'),
  TO_UNICODE (0)
} ;

//---------------------------------------------------------------------------*

void GGS_vocabularyMap::
method_searchKey (C_Compiler & inLexique,
                                const GGS_lstring & inKey,
                                GGS_uint   & outParameter0 COMMA_LOCATION_ARGS) const {
  searchElement (inLexique,
                  kSearchMessage_searchKey,
                  inKey,
                  outParameter0,
                  NULL
                  COMMA_THERE) ;
}

//---------------------------------------------------------------------------*

const utf32 GGS_vocabularyMap::kInsertMessage_insertKey [] = {
  TO_UNICODE ('t'),
  TO_UNICODE ('h'),
  TO_UNICODE ('e'),
  TO_UNICODE (' '),
  TO_UNICODE ('\''),
  TO_UNICODE ('@'),
  TO_UNICODE ('%'),
  TO_UNICODE ('K'),
  TO_UNICODE ('\''),
  TO_UNICODE (' '),
  TO_UNICODE ('s'),
  TO_UNICODE ('y'),
  TO_UNICODE ('m'),
  TO_UNICODE ('b'),
  TO_UNICODE ('o'),
  TO_UNICODE ('l'),
  TO_UNICODE (' '),
  TO_UNICODE ('h'),
  TO_UNICODE ('a'),
  TO_UNICODE ('s'),
  TO_UNICODE (' '),
  TO_UNICODE ('b'),
  TO_UNICODE ('e'),
  TO_UNICODE ('e'),
  TO_UNICODE ('n'),
  TO_UNICODE (' '),
  TO_UNICODE ('a'),
  TO_UNICODE ('l'),
  TO_UNICODE ('r'),
  TO_UNICODE ('e'),
  TO_UNICODE ('a'),
  TO_UNICODE ('d'),
  TO_UNICODE ('y'),
  TO_UNICODE (' '),
  TO_UNICODE ('d'),
  TO_UNICODE ('e'),
  TO_UNICODE ('c'),
  TO_UNICODE ('l'),
  TO_UNICODE ('a'),
  TO_UNICODE ('r'),
  TO_UNICODE ('e'),
  TO_UNICODE ('d'),
  TO_UNICODE (' '),
  TO_UNICODE ('i'),
  TO_UNICODE ('n'),
  TO_UNICODE (' '),
  TO_UNICODE ('%'),
  TO_UNICODE ('L'),
  TO_UNICODE (0)
} ;

//---------------------------------------------------------------------------*

void GGS_vocabularyMap::
modifier_insertKey (C_Compiler & inLexique,
                                const GGS_lstring & inKey,
                                const GGS_uint & inParameter0 COMMA_LOCATION_ARGS) {
  insertElement (inLexique,
                 kInsertMessage_insertKey,
                 inKey,
                 inParameter0,
                 NULL
                 COMMA_THERE) ;
}

//---------------------------------------------------------------------------*

GGS_vocabularyMap GGS_vocabularyMap::
constructor_mapWithMapToOverride (C_Compiler & /* inLexique */,
                                  const GGS_vocabularyMap & inMapToOverride
                                  COMMA_UNUSED_LOCATION_ARGS) {
  GGS_vocabularyMap result ; // Not Built
  if (inMapToOverride.mSharedMapRoot != NULL) {
    macroValidPointer (inMapToOverride.mSharedMapRoot) ;
    macroMyNew (result.mSharedMapRoot, cMapRoot) ;
    result.mSharedMapRoot->mNextMap = inMapToOverride.mSharedMapRoot ;
    inMapToOverride.mSharedMapRoot->mReferenceCount ++ ;
    result.mSharedMapRoot->mSequenceNumber = inMapToOverride.mSharedMapRoot->mSequenceNumber ;
  }
  return result ;
}

//---------------------------------------------------------------------------*

GGS_vocabularyMap GGS_vocabularyMap::
reader_overriddenMap (C_Compiler & /* inLexique */
                      COMMA_UNUSED_LOCATION_ARGS) const {
  GGS_vocabularyMap result ; // Not Built
  if (mSharedMapRoot != NULL) {
    macroValidPointer (mSharedMapRoot) ;
    result.mSharedMapRoot = mSharedMapRoot->mNextMap ;
    if (result.mSharedMapRoot != NULL) {
      macroValidPointer (result.mSharedMapRoot) ;
      result.mSharedMapRoot->mReferenceCount ++ ;
    }else{
      macroMyNew (result.mSharedMapRoot, cMapRoot) ;
    }
  }
  return result ;
}

//---------------------------------------------------------------------------*

GGS_string GGS_vocabularyMap::
reader_description (C_Compiler & inLexique
                    COMMA_LOCATION_ARGS,
                    const PMSInt32 inIndentation) const {
  C_String s ;
  s << "<map @vocabularyMap " ;
  if (isBuilt ()) {
    s.appendSigned (count ()) ;
    s << " object" << ((count () > 1) ? "s " : " ") ;
    cElement * p = firstObject () ;
    PMSInt32 elementID = 0 ;
    while (p != NULL) {
      macroValidPointer (p) ;
      p->appendForMapDescription (inLexique, elementID, s, inIndentation COMMA_THERE) ;
      p = p->nextObject () ;
      elementID ++ ;
    }
  }else{
    s << "not built" ;
  }
  s << "\n" ;
  s.writeStringMultiple ("| ", inIndentation) ;
  s << ">" ;
  return GGS_string (true, s) ;
}

//---------------------------------------------------------------------------*

/* const */ GGS_uint  & GGS_vocabularyMap::cEnumerator::_mIndex (LOCATION_ARGS) const {
  return ((cElement *) mObjectArray (mCurrentIndex COMMA_THERE))->mInfo.mIndex ;
}

//---------------------------------------------------------------------------*
//                                                                           *
//                    Element of list '@derivationList'                      *
//                                                                           *
//---------------------------------------------------------------------------*

elementOf_GGS_derivationList::
elementOf_GGS_derivationList (const GGS_uint & argument_0,
                                const GGS_uint & argument_1,
                                const GGS_uintlist & argument_2
                                COMMA_LOCATION_ARGS) :
AC_galgas_list::cListElement (THERE),
mLeftTerminalIndex (argument_0),
mProductionIndex (argument_1),
mDerivation (argument_2) {
}

//---------------------------------------------------------------------------*

bool elementOf_GGS_derivationList::
isEqualToObject (const cListElement * inOperand) const {
  bool equal = inOperand == this ;
  if (! equal) {
    const elementOf_GGS_derivationList * ptr = dynamic_cast <const elementOf_GGS_derivationList *> (inOperand) ;
    macroValidPointer (ptr) ;
    equal = mLeftTerminalIndex.operator_isEqual (ptr->mLeftTerminalIndex).boolValue ()
         && mProductionIndex.operator_isEqual (ptr->mProductionIndex).boolValue ()
         && mDerivation.operator_isEqual (ptr->mDerivation).boolValue () ;
  }
  return equal ;
}

//---------------------------------------------------------------------------*

void elementOf_GGS_derivationList::
appendForDescription (C_Compiler & inLexique,
                          C_String & ioString,
                          const PMSInt32 inIndentation
                          COMMA_LOCATION_ARGS) const {
  ioString << "\n" ;
  ioString.writeStringMultiple ("| ", inIndentation) ;
  ioString << "|-" ;
  ioString << mLeftTerminalIndex.reader_description  (inLexique COMMA_THERE, inIndentation) ;
  ioString << "\n" ;
  ioString.writeStringMultiple ("| ", inIndentation) ;
  ioString << "|-" ;
  ioString << mProductionIndex.reader_description  (inLexique COMMA_THERE, inIndentation) ;
  ioString << "\n" ;
  ioString.writeStringMultiple ("| ", inIndentation) ;
  ioString << "|-" ;
  ioString << mDerivation.reader_description  (inLexique COMMA_THERE, inIndentation) ;
}

//---------------------------------------------------------------------------*
//                                                                           *
//                          List '@derivationList'                           *
//                                                                           *
//---------------------------------------------------------------------------*

void GGS_derivationList::
_internalAppendValues (const GGS_uint & argument_0,
                    const GGS_uint & argument_1,
                    const GGS_uintlist & argument_2
                    COMMA_LOCATION_ARGS) {
  cElement * nouvelElement = (cElement *) NULL ;
  macroMyNew (nouvelElement, cElement (argument_0,
                                argument_1,
                                argument_2
                                COMMA_THERE)) ;
  _internalAppendItem (nouvelElement) ;
}

//---------------------------------------------------------------------------*

void GGS_derivationList::
_internalPrependValues (const GGS_uint & argument_0,
                    const GGS_uint & argument_1,
                    const GGS_uintlist & argument_2
                    COMMA_LOCATION_ARGS) {
  cElement * nouvelElement = (cElement *) NULL ;
  macroMyNew (nouvelElement, cElement (argument_0,
                                argument_1,
                                argument_2
                                COMMA_THERE)) ;
  _internalPrependItem (nouvelElement) ;
}

//---------------------------------------------------------------------------*

void GGS_derivationList::
addAssign_operation (const GGS_uint & argument_0,
                                const GGS_uint & argument_1,
                                const GGS_uintlist & argument_2) {
  if (isBuilt ()&& argument_0.isBuilt ()&& argument_1.isBuilt ()&& argument_2.isBuilt ()) {
    _insulateList () ;
    _internalAppendValues (argument_0,
                                argument_1,
                                argument_2
                                COMMA_HERE) ;
  }
}

//---------------------------------------------------------------------------*

GGS_derivationList GGS_derivationList::
operator_concat (const GGS_derivationList & inOperand) const {
  GGS_derivationList result = * this ;
  result.dotAssign_operation (inOperand) ;
  return result ;
}

//---------------------------------------------------------------------------*

void GGS_derivationList::
dotAssign_operation (const GGS_derivationList inOperand) {
  if (isBuilt () && inOperand.isBuilt ()) {
    if (count () == 0) {
      * this = inOperand ;
    }else{
      if (inOperand.count () > 0) {
        _insulateList () ;
        elementOf_GGS_derivationList * p = inOperand.firstObject () ;
        while (p != NULL) {
          macroValidPointer (p) ;
          GGS_uint  p_0 = p->mLeftTerminalIndex ;
          GGS_uint  p_1 = p->mProductionIndex ;
          GGS_uintlist  p_2 = p->mDerivation ;
          _internalAppendValues (p_0, p_1, p_2 COMMA_HERE) ;
          p = p->nextObject () ;
        }
      }
    }
  }
}

//---------------------------------------------------------------------------*

void GGS_derivationList::
modifier_prependValue (C_Compiler & /* inLexique */,
                     const GGS_uint & argument_0,
                     const GGS_uint & argument_1,
                     const GGS_uintlist & argument_2
                     COMMA_UNUSED_LOCATION_ARGS) {
  if (isBuilt ()) {
    _insulateList () ;
    _internalPrependValues (argument_0,
                                argument_1,
                                argument_2
                                COMMA_HERE) ;
  }
}

//---------------------------------------------------------------------------*

void GGS_derivationList::
_insulateList (void) {
  if (_shared ()) {
    cElement * ptr = firstObject () ;
    alloc () ;
    while (ptr != NULL) {
      macroValidPointer (ptr) ;
      _internalAppendValues (ptr->mLeftTerminalIndex,
                                ptr->mProductionIndex,
                                ptr->mDerivation
                                COMMA_HERE) ;
      ptr = ptr->nextObject () ;
    }
  }
}

//---------------------------------------------------------------------------*

GGS_derivationList  GGS_derivationList::
constructor_emptyList (void) {
  GGS_derivationList result ;
  result.alloc () ;
  return result ;
}

//---------------------------------------------------------------------------*

GGS_derivationList  GGS_derivationList::
constructor_listWithValue (const GGS_uint & argument_0,
                                const GGS_uint & argument_1,
                                const GGS_uintlist & argument_2) {
  GGS_derivationList result ;
  result.alloc () ;
  result.addAssign_operation (argument_0, argument_1, argument_2) ;
  return result ;
}

//---------------------------------------------------------------------------*

void GGS_derivationList::
internalSubListWithRange (GGS_derivationList & ioList,
                          const PMSInt32 inFirstIndex,
                          const PMSInt32 inCount) const {
  ioList.alloc () ;
  if (inCount > 0) {
    cElement * ptr = firstObject () ;
    for (PMSInt32 i=0 ; i<inFirstIndex ; i++) {
      macroValidPointer (ptr) ;
      ptr = ptr->nextObject () ;
    }
    for (PMSInt32 i=0 ; i<inCount ; i++) {
      macroValidPointer (ptr) ;
      ioList.addAssign_operation (ptr->mLeftTerminalIndex, ptr->mProductionIndex, ptr->mDerivation) ;
      ptr = ptr->nextObject () ;
    }
  }
}

//---------------------------------------------------------------------------*

GGS_derivationList GGS_derivationList::
reader_subListWithRange (C_Compiler & inLexique,
                         const GGS_uint & inFirstIndex,
                         const GGS_uint & inCount
                         COMMA_LOCATION_ARGS) const {
  GGS_derivationList result ;
  if (isBuilt () && inFirstIndex.isBuilt () && inCount.isBuilt ()) {
    const PMSInt32 firstIndex = (PMSInt32) inFirstIndex.uintValue () ;
    const PMSInt32 rangeCount = (PMSInt32) inCount.uintValue () ;
    if ((firstIndex + rangeCount) > count ()) {
      inLexique.onTheFlyRunTimeError ("'subListWithRange' method invoked with upper bound greater than list object count" COMMA_THERE) ;
    }else{
      internalSubListWithRange (result, firstIndex, rangeCount) ;
    }
  }
  return result ;
}

//---------------------------------------------------------------------------*

GGS_derivationList GGS_derivationList::
reader_subListFromIndex (C_Compiler & inLexique,
                         const GGS_uint & inIndex
                         COMMA_LOCATION_ARGS) const {
  GGS_derivationList result ;
  if (isBuilt () && inIndex.isBuilt ()) {
    const PMSInt32 startIndex = (PMSInt32) inIndex.uintValue () ;
    if (startIndex > count ()) {
      inLexique.onTheFlyRunTimeError ("'subListFromIndex' method invoked with start index greater than list object count" COMMA_THERE) ;
    }else{
      internalSubListWithRange (result, startIndex, count () - startIndex) ;
    }
  }
  return result ;
}

//---------------------------------------------------------------------------*

GGS_string GGS_derivationList::
reader_description (C_Compiler & inLexique
                    COMMA_LOCATION_ARGS,
                    const PMSInt32 inIndentation) const {
  return _description (inLexique, "@derivationList", inIndentation COMMA_THERE) ;
}

//---------------------------------------------------------------------------*

void GGS_derivationList::
method_first (C_Compiler & inLexique,
              GGS_uint & _out_0,
              GGS_uint & _out_1,
              GGS_uintlist & _out_2
              COMMA_LOCATION_ARGS) const {
  cElement * ptr = NULL ;
  if (isBuilt ()) {
    ptr = firstObject () ;
    if (ptr == NULL) {
      inLexique.onTheFlyRunTimeError ("'first' method invoked on an empty list" COMMA_THERE) ;
    }
  }
  if (ptr != NULL) {
    _out_0 = ptr->mLeftTerminalIndex ;
    _out_1 = ptr->mProductionIndex ;
    _out_2 = ptr->mDerivation ;
  }else{
    _out_0.drop () ;
    _out_1.drop () ;
    _out_2.drop () ;
  }
}

//---------------------------------------------------------------------------*

void GGS_derivationList::
method_last (C_Compiler & inLexique,
             GGS_uint & _out_0,
             GGS_uint & _out_1,
             GGS_uintlist & _out_2
             COMMA_LOCATION_ARGS) const {
  cElement * ptr = NULL ;
  if (isBuilt ()) {
    ptr = lastObject () ;
    if (ptr == NULL) {
      inLexique.onTheFlyRunTimeError ("'last' method invoked on an empty list" COMMA_THERE) ;
    }
  }
  if (ptr != NULL) {
    _out_0 = ptr->mLeftTerminalIndex ;
    _out_1 = ptr->mProductionIndex ;
    _out_2 = ptr->mDerivation ;
  }else{
    _out_0.drop () ;
    _out_1.drop () ;
    _out_2.drop () ;
  }
}

//---------------------------------------------------------------------------*

void GGS_derivationList::
modifier_popFirst (C_Compiler & inLexique,
                 GGS_uint & _out_0,
                 GGS_uint & _out_1,
                 GGS_uintlist & _out_2
                 COMMA_LOCATION_ARGS) {
  cElement * ptr = NULL ;
  if (isBuilt ()) {
    ptr = firstObject () ;
    if (ptr == NULL) {
      inLexique.onTheFlyRunTimeError ("'popFirst' modifier invoked on an empty list" COMMA_THERE) ;
    }
  }
  if (ptr != NULL) {
    _out_0 = ptr->mLeftTerminalIndex ;
    _out_1 = ptr->mProductionIndex ;
    _out_2 = ptr->mDerivation ;
    _insulateList () ;
    _internalRemoveFirst () ;
  }else{
    _out_0.drop () ;
    _out_1.drop () ;
    _out_2.drop () ;
  }
}

//---------------------------------------------------------------------------*

void GGS_derivationList::
modifier_popLast (C_Compiler & inLexique,
                GGS_uint & _out_0,
                GGS_uint & _out_1,
                GGS_uintlist & _out_2
                COMMA_LOCATION_ARGS) {
  cElement * ptr = NULL ;
  if (isBuilt ()) {
    ptr = lastObject () ;
    if (ptr == NULL) {
      inLexique.onTheFlyRunTimeError ("'popLast' modifier invoked on an empty list" COMMA_THERE) ;
    }
  }
  if (ptr != NULL) {
    _out_0 = ptr->mLeftTerminalIndex ;
    _out_1 = ptr->mProductionIndex ;
    _out_2 = ptr->mDerivation ;
    _insulateList () ;
    _internalRemoveLast () ;
  }else{
    _out_0.drop () ;
    _out_1.drop () ;
    _out_2.drop () ;
  }
}

//---------------------------------------------------------------------------*

GGS_uint  GGS_derivationList::
reader_mLeftTerminalIndexAtIndex (C_Compiler & inLexique, const GGS_uint & inIndex COMMA_LOCATION_ARGS) const {
  GGS_uint  result ;
  if (isBuilt () && inIndex.isBuilt ()) {
    cElement * object = (cElement *) objectAtIndex (inLexique, inIndex.uintValue () COMMA_THERE) ;
    if (object != NULL) {
      result = object->mLeftTerminalIndex ;
    }
  }
  return result ;
}

//---------------------------------------------------------------------------*

GGS_uint  GGS_derivationList::
reader_mProductionIndexAtIndex (C_Compiler & inLexique, const GGS_uint & inIndex COMMA_LOCATION_ARGS) const {
  GGS_uint  result ;
  if (isBuilt () && inIndex.isBuilt ()) {
    cElement * object = (cElement *) objectAtIndex (inLexique, inIndex.uintValue () COMMA_THERE) ;
    if (object != NULL) {
      result = object->mProductionIndex ;
    }
  }
  return result ;
}

//---------------------------------------------------------------------------*

GGS_uintlist  GGS_derivationList::
reader_mDerivationAtIndex (C_Compiler & inLexique, const GGS_uint & inIndex COMMA_LOCATION_ARGS) const {
  GGS_uintlist  result ;
  if (isBuilt () && inIndex.isBuilt ()) {
    cElement * object = (cElement *) objectAtIndex (inLexique, inIndex.uintValue () COMMA_THERE) ;
    if (object != NULL) {
      result = object->mDerivation ;
    }
  }
  return result ;
}

//---------------------------------------------------------------------------*

void GGS_derivationList::
modifier_setMLeftTerminalIndexAtIndex (C_Compiler & inLexique,
                              const GGS_uint  & inObject,
                              const GGS_uint & inIndex
                              COMMA_LOCATION_ARGS) const {
  if (isBuilt () && inIndex.isBuilt ()) {
    cElement * object = (cElement *) objectAtIndex (inLexique, inIndex.uintValue () COMMA_THERE) ;
    if (object != NULL) {
      object->mLeftTerminalIndex = inObject ;
    }
  }
}

//---------------------------------------------------------------------------*

void GGS_derivationList::
modifier_setMProductionIndexAtIndex (C_Compiler & inLexique,
                              const GGS_uint  & inObject,
                              const GGS_uint & inIndex
                              COMMA_LOCATION_ARGS) const {
  if (isBuilt () && inIndex.isBuilt ()) {
    cElement * object = (cElement *) objectAtIndex (inLexique, inIndex.uintValue () COMMA_THERE) ;
    if (object != NULL) {
      object->mProductionIndex = inObject ;
    }
  }
}

//---------------------------------------------------------------------------*

void GGS_derivationList::
modifier_setMDerivationAtIndex (C_Compiler & inLexique,
                              const GGS_uintlist  & inObject,
                              const GGS_uint & inIndex
                              COMMA_LOCATION_ARGS) const {
  if (isBuilt () && inIndex.isBuilt ()) {
    cElement * object = (cElement *) objectAtIndex (inLexique, inIndex.uintValue () COMMA_THERE) ;
    if (object != NULL) {
      object->mDerivation = inObject ;
    }
  }
}

//---------------------------------------------------------------------------*

/* const */ GGS_uint  & GGS_derivationList::cEnumerator::_mLeftTerminalIndex (LOCATION_ARGS) const {
  macroValidPointerThere (mCurrentEnumeratedObject) ;
  return ((/* const */ cElement *) mCurrentEnumeratedObject)->mLeftTerminalIndex ;
}

//---------------------------------------------------------------------------*

/* const */ GGS_uint  & GGS_derivationList::cEnumerator::_mProductionIndex (LOCATION_ARGS) const {
  macroValidPointerThere (mCurrentEnumeratedObject) ;
  return ((/* const */ cElement *) mCurrentEnumeratedObject)->mProductionIndex ;
}

//---------------------------------------------------------------------------*

/* const */ GGS_uintlist  & GGS_derivationList::cEnumerator::_mDerivation (LOCATION_ARGS) const {
  macroValidPointerThere (mCurrentEnumeratedObject) ;
  return ((/* const */ cElement *) mCurrentEnumeratedObject)->mDerivation ;
}

//---------------------------------------------------------------------------*

GGS_productionListMap::cElement::cElement (LOCATION_ARGS) :
cPtrListMapObject (THERE),
mListObject (GGS_derivationList::constructor_emptyList ()) {
}

//---------------------------------------------------------------------------*

cPtrObject * GGS_productionListMap::cElement::_clone (LOCATION_ARGS) {
  cElement * result = NULL ;
  macroMyNew (result, cElement (THERE)) ;
  result->mListObject = mListObject ;
  return result ;
}

//---------------------------------------------------------------------------*

bool GGS_productionListMap::cElement::isEqual (const cPtrListMapObject * inOperand) const {
  const GGS_bool equal = mListObject.operator_isEqual (((cElement *) inOperand)->mListObject) ;
  return equal.boolValue () ;
}

//---------------------------------------------------------------------------*

C_String GGS_productionListMap::cElement::
_description (C_Compiler & inLexique,
              const PMSInt32 inIndentation
              COMMA_LOCATION_ARGS) const {
  const GGS_string s = mListObject.reader_description (inLexique COMMA_THERE, inIndentation) ;
  return s.string () ;
}

//---------------------------------------------------------------------------*

GGS_productionListMap GGS_productionListMap::
constructor_emptyMap (void) {
  GGS_productionListMap result ;
  result.alloc (HERE) ;
  return result ;
}

//---------------------------------------------------------------------------*

const char * GGS_productionListMap::
_typeNameForDescriptionReader (void) const {
  return "@productionListMap" ;
}

//---------------------------------------------------------------------------*

GGS_productionListMap GGS_productionListMap::
operator_concat (const GGS_productionListMap & inOperand) const {
  GGS_productionListMap result = * this ;
  result.dotAssign_operation (inOperand) ;
  return result ;
}

//---------------------------------------------------------------------------*

void GGS_productionListMap::
dotAssign_operation (const GGS_productionListMap inOperand) {
  if (isBuilt () && inOperand.isBuilt ()) {
    if (count (HERE) == 0) {
      * this = inOperand ;
    }else if (inOperand.count (HERE) > 0) {
      cPtrDictionary * dictPtr = macroPtr (inOperand, cPtrDictionary)  ;
      cPtrDictionaryNode * nodeSortedArray = dictPtr->nodeSortedArray () ;
      const PMSInt32 objectCount = dictPtr->count () ;
      for (PMSInt32 i=0 ; i<objectCount ; i++) {
        const GGS_string key = nodeSortedArray [i].key () ;
        const PM_C_Object object = nodeSortedArray [i].mObject ;
        cElement * elementPtr = macroPtr (object, cElement) ;
        bool wasInserted = false ;
        cPtrDictionaryNode * nodePtr = findOrAddNodeForKey (key, wasInserted) ;
        if (wasInserted) {
           cElement * p = NULL ;
           macroMyNew (p, cElement (HERE)) ;
           nodePtr->mObject.setPointer (p) ;
        }
        GGS_derivationList & listPtr = macroPtr (nodePtr->mObject, cElement)->mListObject ;
        listPtr.dotAssign_operation (elementPtr->mListObject) ;
      }
    }
  }
}

//---------------------------------------------------------------------------*

void GGS_productionListMap::
addAssign_operation (const GGS_string & inKey,
                      const GGS_uint & inAttribute0,
                      const GGS_uint & inAttribute1,
                      const GGS_uintlist & inAttribute2) {
  if (isBuilt () && inKey.isBuilt () && inAttribute0.isBuilt () && inAttribute1.isBuilt () && inAttribute2.isBuilt ()) {
    bool wasInserted = false ;
    cPtrDictionaryNode * nodePtr = findOrAddNodeForKey (inKey, wasInserted) ;
    MF_Assert (nodePtr != NULL, "NULL pointer (was inserted %d)", wasInserted, 0) ;
    if (wasInserted) {
       cElement * p = NULL ;
       macroMyNew (p, cElement (HERE)) ;
       nodePtr->mObject.setPointer (p) ;
    }
    GGS_derivationList & listPtr = macroPtr (nodePtr->mObject, cElement)->mListObject ;
    listPtr.addAssign_operation (inAttribute0, inAttribute1, inAttribute2) ;
  }
}

//---------------------------------------------------------------------------*

GGS_derivationList GGS_productionListMap::
reader_listForKey (C_Compiler & /* inLexique */,
                   const GGS_string & inKey
                   COMMA_UNUSED_LOCATION_ARGS) const {
  GGS_derivationList result ;
  if (isBuilt () && inKey.isBuilt ()) {
    cPtrDictionaryNode * nodePtr = dictionaryNodeForKey (inKey.string ()) ; 
    if (nodePtr == NULL) {
      result = GGS_derivationList::constructor_emptyList () ;
    }else{
      result = macroPtr (nodePtr->mObject, cElement)->mListObject ;
    }
  }
  return result ;
}

//---------------------------------------------------------------------------*

GGS_stringset GGS_productionListMap::
reader_allKeys (C_Compiler & /* inLexique */
                COMMA_UNUSED_LOCATION_ARGS) const {

  GGS_stringset result ;
  result.setPointer (_pointer ()) ;
  return result ;
}

//---------------------------------------------------------------------------*

GGS_stringlist GGS_productionListMap::
reader_keyList (C_Compiler & /* inLexique */
                COMMA_UNUSED_LOCATION_ARGS) const {

  GGS_stringlist result ;
  if (isBuilt ()) {
    result = GGS_stringlist::constructor_emptyList () ;
    cPtrDictionary * dictPtr = macroPtr (*this, cPtrDictionary)  ;
    cPtrDictionaryNode * nodeSortedArray = dictPtr->nodeSortedArray () ;
    const PMSInt32 objectCount = dictPtr->count () ;
    for (PMSInt32 i=0 ; i<objectCount ; i++) {
      const GGS_string key = nodeSortedArray [i].key () ;
      result.addAssign_operation (key) ;
    }
  }
  return result ;
}

//---------------------------------------------------------------------------*

GGS_productionListMap::cEnumerator::
cEnumerator (const GGS_productionListMap & inListMap,
             const bool inAscending) :
cAbstractDictionaryEnumerator (inListMap, inAscending) {
}

//---------------------------------------------------------------------------*

const GGS_derivationList & GGS_productionListMap::cEnumerator::
_object (LOCATION_ARGS) const {
  cPtrDictionary * dictPtr = macroPtr (mEnumeratedDictionary, cPtrDictionary)  ;
  MF_AssertThere (currentIndex () >= 0, "Access with negative index %d", currentIndex (), 0) ;
  MF_AssertThere (currentIndex () < dictPtr->count (), "Access with index %d >= count %d", currentIndex (), dictPtr->count ()) ;
  cPtrDictionaryNode * nodeSortedArray = dictPtr->nodeSortedArray () ;
  PM_C_Object listObject = nodeSortedArray [currentIndex ()].mObject ;
  cElement * objectPtr = macroPtr (listObject, cElement) ;
  return objectPtr->mListObject ;
}

//---------------------------------------------------------------------------*
//                                                                           *
//         Implementation of wrapper 'grammarComputationTemplates'           *
//                                                                           *
//---------------------------------------------------------------------------*

//---------------------------------------------------------------------------*

//--- All files of '' directory

static const cRegularFileWrapper * gWrapperAllFiles_grammarComputationTemplates_0 [1] = {
  NULL
} ;

//---------------------------------------------------------------------------*

//--- All sub-directories of '' directory

static const cDirectoryWrapper * gWrapperAllDirectories_grammarComputationTemplates_0 [1] = {
  NULL
} ;

//---------------------------------------------------------------------------*

//--- Directory ''

const cDirectoryWrapper gWrapperDirectory_0_grammarComputationTemplates = {
  "",
  0,
  gWrapperAllFiles_grammarComputationTemplates_0,
  0,
  gWrapperAllDirectories_grammarComputationTemplates_0
} ;

//---------------------------------------------------------------------------*
//                                                                           *
//       'html' template of 'grammarComputationTemplates' filewrapper        *
//                                                                           *
//---------------------------------------------------------------------------*

GGS_string
template_filewrapper_grammarComputationTemplates_html (C_Compiler & inLexique,
                                const GGS_stringlist & var_cas_ALL_VOCABULARY_FOR_BDD,
                                const GGS_uint & var_cas_TERMINAL_COUNT,
                                const GGS_uint & var_cas_NON_TERMINAL_COUNT,
                                const GGS_uint & var_cas_ADDITIONAL_NON_TERMINAL_COUNT_FOR_BDD,
                                const GGS_stringlist & var_cas_NON_TERMINAL_WITH_EMPTY_PRODUCTION_LIST,
                                const GGS_string2list & var_cas_NON_TERMINAL_WITH_ONE_ELEMENT_PRODUCTION_LIST,
                                const GGS_string3list & var_cas_NON_TERMINAL_WITH_TWO_ELEMENT_PRODUCTION_LIST,
                                const GGS_stringlist & var_cas_USELESS_NON_TERMINAL_SYMBOL_LIST) {
  C_String result ;
  const bool isBuilt = var_cas_ALL_VOCABULARY_FOR_BDD.isBuilt ()
    && var_cas_TERMINAL_COUNT.isBuilt ()
    && var_cas_NON_TERMINAL_COUNT.isBuilt ()
    && var_cas_ADDITIONAL_NON_TERMINAL_COUNT_FOR_BDD.isBuilt ()
    && var_cas_NON_TERMINAL_WITH_EMPTY_PRODUCTION_LIST.isBuilt ()
    && var_cas_NON_TERMINAL_WITH_ONE_ELEMENT_PRODUCTION_LIST.isBuilt ()
    && var_cas_NON_TERMINAL_WITH_TWO_ELEMENT_PRODUCTION_LIST.isBuilt ()
    && var_cas_USELESS_NON_TERMINAL_SYMBOL_LIST.isBuilt () ;
  if (isBuilt) {
    result << "<p><a name=\"pureBDD\"></a></p>\n"
      "<table class=\"title\"><tr><td>Transformation into BDDs</td></tr></table>\n"
      "<p></p>\n"
      "\n"
      "<p>For information :\n"
      "  <ul><li>" ;
    result << var_cas_TERMINAL_COUNT.reader_string (inLexique COMMA_SOURCE_FILE_AT_LINE (6)) ;
    result << " terminal symbols, numbered from 0 to " ;
    result << var_cas_TERMINAL_COUNT.substract_operation (inLexique, GGS_uint (1U) COMMA_SOURCE_FILE_AT_LINE (6)).reader_string (inLexique COMMA_SOURCE_FILE_AT_LINE (6)) ;
    result << " ;</li>\n"
      "    <li> the 'end of source file' symbol '$$' is numbered " ;
    result << var_cas_TERMINAL_COUNT.substract_operation (inLexique, GGS_uint (1U) COMMA_SOURCE_FILE_AT_LINE (7)).reader_string (inLexique COMMA_SOURCE_FILE_AT_LINE (7)) ;
    result << " ;</li>\n"
      "    <li>" ;
    result << var_cas_NON_TERMINAL_COUNT.reader_string (inLexique COMMA_SOURCE_FILE_AT_LINE (8)) ;
    result << " nonterminal symbols in the pure BNF grammar, numbered from " ;
    result << var_cas_TERMINAL_COUNT.reader_string (inLexique COMMA_SOURCE_FILE_AT_LINE (8)) ;
    result << " to " ;
    result << var_cas_NON_TERMINAL_COUNT.add_operation (inLexique, var_cas_TERMINAL_COUNT COMMA_SOURCE_FILE_AT_LINE (8)).substract_operation (inLexique, GGS_uint (1U) COMMA_SOURCE_FILE_AT_LINE (8)).reader_string (inLexique COMMA_SOURCE_FILE_AT_LINE (8)) ;
    result << " ;</li>\n"
      "    <li> the actual start symbol '&lt;&gt;' is numbered " ;
    result << var_cas_NON_TERMINAL_COUNT.add_operation (inLexique, var_cas_TERMINAL_COUNT COMMA_SOURCE_FILE_AT_LINE (9)).substract_operation (inLexique, GGS_uint (1U) COMMA_SOURCE_FILE_AT_LINE (9)).reader_string (inLexique COMMA_SOURCE_FILE_AT_LINE (9)) ;
    result << " ;</li>\n"
      "    <li> " ;
    result << var_cas_ADDITIONAL_NON_TERMINAL_COUNT_FOR_BDD.reader_string (inLexique COMMA_SOURCE_FILE_AT_LINE (10)) ;
    result << " additional non terminal symbols needed by BDD transformation, numbered from " ;
    result << var_cas_NON_TERMINAL_COUNT.add_operation (inLexique, var_cas_TERMINAL_COUNT COMMA_SOURCE_FILE_AT_LINE (10)).substract_operation (inLexique, GGS_uint (1U) COMMA_SOURCE_FILE_AT_LINE (10)).reader_string (inLexique COMMA_SOURCE_FILE_AT_LINE (10)) ;
    result << " to " ;
    result << var_cas_NON_TERMINAL_COUNT.add_operation (inLexique, var_cas_TERMINAL_COUNT COMMA_SOURCE_FILE_AT_LINE (10)).add_operation (inLexique, var_cas_ADDITIONAL_NON_TERMINAL_COUNT_FOR_BDD COMMA_SOURCE_FILE_AT_LINE (10)).substract_operation (inLexique, GGS_uint (1U) COMMA_SOURCE_FILE_AT_LINE (10)).reader_string (inLexique COMMA_SOURCE_FILE_AT_LINE (10)) ;
    result << " ;</li>\n"
      "    <li>whole vocabulary : " ;
    result << var_cas_NON_TERMINAL_COUNT.add_operation (inLexique, var_cas_TERMINAL_COUNT COMMA_SOURCE_FILE_AT_LINE (11)).add_operation (inLexique, var_cas_ADDITIONAL_NON_TERMINAL_COUNT_FOR_BDD COMMA_SOURCE_FILE_AT_LINE (11)).reader_string (inLexique COMMA_SOURCE_FILE_AT_LINE (11)) ;
    result << " elements, " ;
    result << var_cas_ALL_VOCABULARY_FOR_BDD.reader_length (inLexique COMMA_SOURCE_FILE_AT_LINE (11)).reader_significantBitCount (inLexique COMMA_SOURCE_FILE_AT_LINE (11)).reader_string (inLexique COMMA_SOURCE_FILE_AT_LINE (11)) ;
    result << " bits for BDDs.</li>\n"
      "  </ul>\n"
      "</p>\n"
      "\n"
      "<p>Vocabulary:</p>\n"
      "<table class=\"result\">\n" ;
    GGS_stringlist::cEnumerator enumerator_1233 (var_cas_ALL_VOCABULARY_FOR_BDD, true) ;
    const GGS_stringlist::cElement * operand_1233 = NULL ;
    GGS_uint var_cas_IDX (true, 0) ;
    while (((operand_1233 = enumerator_1233.nextObject ()))) {
      macroValidPointer (operand_1233) ;
      result << "<tr class=\"result_line\"><td class=\"result_line\">" ;
      result << var_cas_IDX.reader_string (inLexique COMMA_SOURCE_FILE_AT_LINE (20)) ;
      result << "</td><td class=\"result_line\"><code>" ;
      result << operand_1233->mValue.reader_HTMLRepresentation (inLexique COMMA_SOURCE_FILE_AT_LINE (21)) ;
      result << "</code></td></tr>" ;
      var_cas_IDX.increment_operation (inLexique COMMA_HERE) ;
    }
    result << "\n"
      "</table>\n"
      "\n"
      "<p>" ;
    result << var_cas_NON_TERMINAL_WITH_EMPTY_PRODUCTION_LIST.reader_length (inLexique COMMA_SOURCE_FILE_AT_LINE (27)).reader_string (inLexique COMMA_SOURCE_FILE_AT_LINE (27)) ;
    result << " non terminal " ;
    if ((var_cas_NON_TERMINAL_WITH_ONE_ELEMENT_PRODUCTION_LIST.reader_length (inLexique COMMA_SOURCE_FILE_AT_LINE (27))).operator_strictSup (GGS_uint (1U)).boolValue ()) {
      result << "symbols have" ;
    }else {
      result << "symbol has" ;
    }
    result << " an empty production:</p>\n"
      "<table class=\"result\">\n" ;
    GGS_stringlist::cEnumerator enumerator_1728 (var_cas_NON_TERMINAL_WITH_EMPTY_PRODUCTION_LIST, true) ;
    const GGS_stringlist::cElement * operand_1728 = NULL ;
    while (((operand_1728 = enumerator_1728.nextObject ()))) {
      macroValidPointer (operand_1728) ;
      result << "<tr class=\"result_line\"><td class=\"result_line\"><code>" ;
      result << operand_1728->mValue.reader_HTMLRepresentation (inLexique COMMA_SOURCE_FILE_AT_LINE (32)) ;
      result << "</code></td></tr>" ;
    }
    result << "\n"
      "</table>\n"
      "\n"
      "<p>\n" ;
    if ((var_cas_NON_TERMINAL_WITH_ONE_ELEMENT_PRODUCTION_LIST.reader_length (inLexique COMMA_SOURCE_FILE_AT_LINE (40))).operator_strictSup (GGS_uint (1U)).boolValue ()) {
      result << var_cas_NON_TERMINAL_WITH_ONE_ELEMENT_PRODUCTION_LIST.reader_length (inLexique COMMA_SOURCE_FILE_AT_LINE (41)).reader_string (inLexique COMMA_SOURCE_FILE_AT_LINE (41)) ;
      result << " rules with a one element derivation:" ;
    }else {
      result << var_cas_NON_TERMINAL_WITH_ONE_ELEMENT_PRODUCTION_LIST.reader_length (inLexique COMMA_SOURCE_FILE_AT_LINE (43)).reader_string (inLexique COMMA_SOURCE_FILE_AT_LINE (43)) ;
      result << " rule with a one element derivation:" ;
    }
    result << "\n"
      "</p>\n"
      "<table class=\"result\">\n" ;
    GGS_string2list::cEnumerator enumerator_2259 (var_cas_NON_TERMINAL_WITH_ONE_ELEMENT_PRODUCTION_LIST, true) ;
    const GGS_string2list::cElement * operand_2259 = NULL ;
    while (((operand_2259 = enumerator_2259.nextObject ()))) {
      macroValidPointer (operand_2259) ;
      result << "<tr class=\"result_line\"><td class=\"result_line\"><code>" ;
      result << operand_2259->mValue0.reader_HTMLRepresentation (inLexique COMMA_SOURCE_FILE_AT_LINE (50)) ;
      result << " ::= " ;
      result << operand_2259->mValue1.reader_HTMLRepresentation (inLexique COMMA_SOURCE_FILE_AT_LINE (50)) ;
      result << "</code></td></tr>" ;
    }
    result << "\n"
      "</table>\n"
      "\n"
      "\n"
      "<p>\n" ;
    if ((var_cas_NON_TERMINAL_WITH_TWO_ELEMENT_PRODUCTION_LIST.reader_length (inLexique COMMA_SOURCE_FILE_AT_LINE (57))).operator_strictSup (GGS_uint (1U)).boolValue ()) {
      result << var_cas_NON_TERMINAL_WITH_TWO_ELEMENT_PRODUCTION_LIST.reader_length (inLexique COMMA_SOURCE_FILE_AT_LINE (58)).reader_string (inLexique COMMA_SOURCE_FILE_AT_LINE (58)) ;
      result << " rules with a two element derivation:" ;
    }else {
      result << var_cas_NON_TERMINAL_WITH_TWO_ELEMENT_PRODUCTION_LIST.reader_length (inLexique COMMA_SOURCE_FILE_AT_LINE (60)).reader_string (inLexique COMMA_SOURCE_FILE_AT_LINE (60)) ;
      result << " rule with a two element derivation:" ;
    }
    result << "\n"
      "</p>\n"
      "<table class=\"result\">\n" ;
    GGS_string3list::cEnumerator enumerator_2817 (var_cas_NON_TERMINAL_WITH_TWO_ELEMENT_PRODUCTION_LIST, true) ;
    const GGS_string3list::cElement * operand_2817 = NULL ;
    while (((operand_2817 = enumerator_2817.nextObject ()))) {
      macroValidPointer (operand_2817) ;
      result << "<tr class=\"result_line\"><td class=\"result_line\"><code>" ;
      result << operand_2817->mValue0.reader_HTMLRepresentation (inLexique COMMA_SOURCE_FILE_AT_LINE (67)) ;
      result << " ::= " ;
      result << operand_2817->mValue1.reader_HTMLRepresentation (inLexique COMMA_SOURCE_FILE_AT_LINE (67)) ;
      result << " " ;
      result << operand_2817->mValue2.reader_HTMLRepresentation (inLexique COMMA_SOURCE_FILE_AT_LINE (67)) ;
      result << "</code></td></tr>" ;
    }
    result << "\n"
      "</table>\n"
      "\n" ;
  }
  return GGS_string (isBuilt, result) ;
}

//---------------------------------------------------------------------------*
//                                                                           *
//              Implementation of routine "newGrammarAnalyzer"               *
//                                                                           *
//---------------------------------------------------------------------------*

void routine_newGrammarAnalyzer (C_Compiler & inLexique,
                                GGS_lstring   /* var_cas_inGrammarName */,
                                GGS_uint   /* var_cas_inStartSymbolIndex */,
                                GGS_string  /* var_cas_inLexiqueName */,
                                GGS_stringlist   var_cas_inVocabularyListForDisplaying,
                                const GGS_vocabularyMap   var_cas_inNonterminalMap,
                                const GGS_vocabularyMap   var_cas_inTerminalMap,
                                const GGS_productionListMap  var_cas_inProductionListMap,
                                const GGS_uintlist   /* var_cas_inUnusedNonterminalSymbolList */,
                                GGS_string & var_cas_outHTMLFileHeader,
                                GGS_string & var_cas_outHTMLFileContents COMMA_UNUSED_LOCATION_ARGS) {
  #ifdef DEBUG_TRACE_ENABLED
    printf ("ENTER routine_newGrammarAnalyzer at %s:%d\n", __FILE__, __LINE__) ;
  #endif
  var_cas_outHTMLFileHeader = GGS_string ("") ;
  var_cas_outHTMLFileContents = GGS_string ("") ;
  GGS_stringlist  var_cas_vocabularyListForDisplaying = var_cas_inVocabularyListForDisplaying ;
  GGS_uint  var_cas_additionalNonTerminalSymbolsForPureBDDrules = GGS_uint (0U) ;
  {
    GGS_productionListMap::cEnumerator enumerator_4008 (var_cas_inProductionListMap, true) ;
    while (enumerator_4008.hasCurrentObject ()) {
      {
        GGS_derivationList::cEnumerator enumerator_4030 (enumerator_4008._object (HERE), true) ;
        const GGS_derivationList::cElement * operand_4030 = NULL ;
        while (((operand_4030 = enumerator_4030.nextObject ()))) {
          macroValidPointer (operand_4030) ;
          const GGS_bool cond_4210 = (operand_4030->mDerivation.reader_length (inLexique COMMA_SOURCE_FILE_AT_LINE (91))).operator_strictSup (GGS_uint (2U)) ;
          if (cond_4210.isBuiltAndTrue ()) {
            var_cas_additionalNonTerminalSymbolsForPureBDDrules = var_cas_additionalNonTerminalSymbolsForPureBDDrules.add_operation (inLexique, operand_4030->mDerivation.reader_length (inLexique COMMA_SOURCE_FILE_AT_LINE (92)) COMMA_SOURCE_FILE_AT_LINE (92)).substract_operation (inLexique, GGS_uint (2U) COMMA_SOURCE_FILE_AT_LINE (92)) ;
          }
        }
      }
      enumerator_4008.next () ;
    }
  }
  GGS_uint  var_cas_ntIndex = GGS_uint (0U) ;
  GGS_uint _variant_4481 = var_cas_additionalNonTerminalSymbolsForPureBDDrules ;
  GGS_bool _condition_4481 (_variant_4481.isBuilt (), true) ;
  while (_condition_4481.isBuiltAndTrue ()) {
    _condition_4481 = (var_cas_ntIndex).operator_strictInf (var_cas_additionalNonTerminalSymbolsForPureBDDrules) ;
    if (_condition_4481.isBuiltAndTrue ()) {
      if (_variant_4481.uintValue () == 0) {
        inLexique.onTheFlyRunTimeError ("loop variant error" COMMA_SOURCE_FILE_AT_LINE (101)) ;
        _condition_4481 = GGS_bool (false) ;
      }else{
        _variant_4481.decrement_operation (inLexique COMMA_HERE) ;
        var_cas_vocabularyListForDisplaying.addAssign_operation (((GGS_string ("<")).operator_concat (var_cas_ntIndex.reader_string (inLexique COMMA_SOURCE_FILE_AT_LINE (99)))).operator_concat (GGS_string (">"))) ;
        var_cas_ntIndex.increment_operation (inLexique COMMA_SOURCE_FILE_AT_LINE (100)) ;
      }
    }
  }
  GGS_grammarDomain var_cas_grammarComputations = GGS_grammarDomain::constructor_domainWithNames (inLexique, var_cas_vocabularyListForDisplaying COMMA_HERE) ;
  GGS_uint  var_cas_addedNonTerminalIndex = var_cas_inTerminalMap.reader_count (inLexique COMMA_SOURCE_FILE_AT_LINE (107)).add_operation (inLexique, var_cas_inNonterminalMap.reader_count (inLexique COMMA_SOURCE_FILE_AT_LINE (107)) COMMA_SOURCE_FILE_AT_LINE (107)) ;
  {
    GGS_productionListMap::cEnumerator enumerator_4931 (var_cas_inProductionListMap, true) ;
    while (enumerator_4931.hasCurrentObject ()) {
      GGS_uint  var_cas_nonterminalIndex ;
      const GGS_vocabularyMap  temp_4995 = var_cas_inNonterminalMap ;
      if (temp_4995.isBuilt ()) {
        temp_4995 (HERE)->method_searchKey (inLexique, GGS_lstring ::constructor_new (inLexique, enumerator_4931._key (HERE), GGS_location (inLexique) COMMA_HERE), var_cas_nonterminalIndex COMMA_SOURCE_FILE_AT_LINE (110)) ;
      }
      {
        GGS_derivationList::cEnumerator enumerator_5062 (enumerator_4931._object (HERE), true) ;
        const GGS_derivationList::cElement * operand_5062 = NULL ;
        while (((operand_5062 = enumerator_5062.nextObject ()))) {
          macroValidPointer (operand_5062) ;
          const GGS_bool cond_5225 = (operand_5062->mDerivation.reader_length (inLexique COMMA_SOURCE_FILE_AT_LINE (112))).operator_isEqual (GGS_uint (0U)) ;
          if (cond_5225.isBuiltAndTrue ()) {
            var_cas_grammarComputations.modifier_addToNonterminalsWithEmptyProduction (inLexique, var_cas_nonterminalIndex COMMA_SOURCE_FILE_AT_LINE (113)) ;
          }else if (cond_5225.isBuiltAndFalse ()) {
            const GGS_bool cond_5463 = (operand_5062->mDerivation.reader_length (inLexique COMMA_SOURCE_FILE_AT_LINE (114))).operator_isEqual (GGS_uint (1U)) ;
            if (cond_5463.isBuiltAndTrue ()) {
              const GGS_uint  var_cas_derivation0 = operand_5062->mDerivation.reader_mValueAtIndex (inLexique, GGS_uint (0U) COMMA_SOURCE_FILE_AT_LINE (115)) ;
              var_cas_grammarComputations.modifier_addToNonterminalsWithOneElementProduction (inLexique, var_cas_nonterminalIndex, var_cas_derivation0 COMMA_SOURCE_FILE_AT_LINE (116)) ;
            }else if (cond_5463.isBuiltAndFalse ()) {
              const GGS_bool cond_5820 = (operand_5062->mDerivation.reader_length (inLexique COMMA_SOURCE_FILE_AT_LINE (117))).operator_isEqual (GGS_uint (2U)) ;
              if (cond_5820.isBuiltAndTrue ()) {
                const GGS_uint  var_cas_derivation0 = operand_5062->mDerivation.reader_mValueAtIndex (inLexique, GGS_uint (0U) COMMA_SOURCE_FILE_AT_LINE (118)) ;
                const GGS_uint  var_cas_derivation1 = operand_5062->mDerivation.reader_mValueAtIndex (inLexique, GGS_uint (1U) COMMA_SOURCE_FILE_AT_LINE (119)) ;
                var_cas_grammarComputations.modifier_addToNonterminalsWithTwoElementProduction (inLexique, var_cas_nonterminalIndex, var_cas_derivation0, var_cas_derivation1 COMMA_SOURCE_FILE_AT_LINE (120)) ;
              }else if (cond_5820.isBuiltAndFalse ()) {
                GGS_uint  var_cas_currentLeftNonTerminal = var_cas_nonterminalIndex ;
                {
                    GGS_uint var_cas_idx (true, 0) ;
                  GGS_uintlist::cEnumerator enumerator_5907 (operand_5062->mDerivation, true) ;
                  const GGS_uintlist::cElement * operand_5907 = NULL ;
                  while (((operand_5907 = enumerator_5907.nextObject ()))) {
                    macroValidPointer (operand_5907) ;
                    const GGS_bool cond_6355 = (var_cas_idx).operator_strictInf (operand_5062->mDerivation.reader_length (inLexique COMMA_SOURCE_FILE_AT_LINE (128)).substract_operation (inLexique, GGS_uint (2U) COMMA_SOURCE_FILE_AT_LINE (128))) ;
                    if (cond_6355.isBuiltAndTrue ()) {
                      const GGS_uint  var_cas_derivation = operand_5062->mDerivation.reader_mValueAtIndex (inLexique, var_cas_idx COMMA_SOURCE_FILE_AT_LINE (129)) ;
                      var_cas_grammarComputations.modifier_addToNonterminalsWithTwoElementProduction (inLexique, var_cas_currentLeftNonTerminal, var_cas_derivation, var_cas_addedNonTerminalIndex COMMA_SOURCE_FILE_AT_LINE (130)) ;
                      var_cas_currentLeftNonTerminal = var_cas_addedNonTerminalIndex ;
                      var_cas_addedNonTerminalIndex.increment_operation (inLexique COMMA_SOURCE_FILE_AT_LINE (136)) ;
                    }else if (cond_6355.isBuiltAndFalse ()) {
                      const GGS_bool cond_6744 = (var_cas_idx).operator_isEqual (operand_5062->mDerivation.reader_length (inLexique COMMA_SOURCE_FILE_AT_LINE (137)).substract_operation (inLexique, GGS_uint (2U) COMMA_SOURCE_FILE_AT_LINE (137))) ;
                      if (cond_6744.isBuiltAndTrue ()) {
                        const GGS_uint  var_cas_derivation0 = operand_5062->mDerivation.reader_mValueAtIndex (inLexique, var_cas_idx COMMA_SOURCE_FILE_AT_LINE (138)) ;
                        const GGS_uint  var_cas_derivation1 = operand_5062->mDerivation.reader_mValueAtIndex (inLexique, var_cas_idx.add_operation (inLexique, GGS_uint (1U) COMMA_SOURCE_FILE_AT_LINE (139)) COMMA_SOURCE_FILE_AT_LINE (139)) ;
                        var_cas_grammarComputations.modifier_addToNonterminalsWithTwoElementProduction (inLexique, var_cas_currentLeftNonTerminal, var_cas_derivation0, var_cas_derivation1 COMMA_SOURCE_FILE_AT_LINE (140)) ;
                      }
                    }
                    var_cas_idx.mValue ++ ;
                  }
                }
              }
            }
          }
        }
      }
      enumerator_4931.next () ;
    }
  }
  const GGS_bool cond_7460 = gOption_galgas_5F_cli_5F_options_outputHTMLgrammarFile.value () ;
  if (cond_7460.isBuiltAndTrue ()) {
    var_cas_outHTMLFileContents = template_filewrapper_grammarComputationTemplates_html (inLexique, var_cas_vocabularyListForDisplaying, var_cas_inTerminalMap.reader_count (inLexique COMMA_SOURCE_FILE_AT_LINE (154)), var_cas_inNonterminalMap.reader_count (inLexique COMMA_SOURCE_FILE_AT_LINE (155)), var_cas_additionalNonTerminalSymbolsForPureBDDrules, var_cas_grammarComputations.reader_nonterminalsWithEmptyProductionStringValueList (inLexique COMMA_SOURCE_FILE_AT_LINE (157)), var_cas_grammarComputations.reader_nonterminalsWithOneElementProductionStringValueList (inLexique COMMA_SOURCE_FILE_AT_LINE (158)), var_cas_grammarComputations.reader_nonterminalsWithTwoElementProductionStringValueList (inLexique COMMA_SOURCE_FILE_AT_LINE (159)), GGS_stringlist ::constructor_emptyList ()) ;
  }
  #ifdef DEBUG_TRACE_ENABLED
    printf ("LEAVE routine_newGrammarAnalyzer\n") ;
  #endif
}

//---------------------------------------------------------------------------*

