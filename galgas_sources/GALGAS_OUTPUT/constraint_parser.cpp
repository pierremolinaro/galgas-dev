//---------------------------------------------------------------------------*
//                                                                           *
//                       File 'constraint_parser.cpp'                        *
//         Generated by version GALGAS_BETA_VERSION (LL(1) grammar)          *
//                    february 18th, 2007, at 18h10'18"                      *
//                                                                           *
//---------------------------------------------------------------------------*

//--- START OF USER ZONE 1


//--- END OF USER ZONE 1

//---------------------------------------------------------------------------*

#include "version_libpm.h"
#if LIBPM_VERSION != THE_LIBPM_VERSION
  #error "This file has been compiled with a version of GALGAS different than the version of libpm"
#endif

//---------------------------------------------------------------------------*

#include <typeinfo>
#include "utilities/MF_MemoryControl.h"
#include "files/C_TextFileWrite.h"
#include "constraint_parser.h"

//---------------------------------------------------------------------------*

#ifndef DO_NOT_GENERATE_CHECKINGS
  static const char gGGSsourceFile [] = "constraint_parser.ggs" ;
  #define SOURCE_FILE_AT_LINE(line) , gGGSsourceFile, line
#else
  #define SOURCE_FILE_AT_LINE(line) 
#endif


//--- START OF USER ZONE 2


//--- END OF USER ZONE 2

//---------------------------------------------------------------------------*
//                                                                           *
//           Implementation of production rule 'galgas_component'            *
//                                                                           *
//---------------------------------------------------------------------------*

void constraint_parser::
constraint_parser::
pr_galgas_component_constraint_parser_108_6_ (galgas_scanner & _inLexique,
                                GGS_M_lexiqueComponents  &/* var_cas_ioLexiqueMapForUse */,
                                GGS_M_semanticsComponents  &/* var_cas_ioSemanticsComponentsMap */,
                                GGS_M_syntaxComponents  &/* var_cas_ioSyntaxComponentsMap */,
                                GGS_M_grammarComponents  &/* var_cas_ioGrammarComponentsMap */,
                                GGS_M_optionComponents  &/* var_cas_ioOptionsComponentsMap */,
                                GGS_M_metamodelsComponents  &var_cas_ioMetamodelComponentMap,
                                GGS_M_constraintComponents  &var_cas_ioConstraintComponentMap) {
  nt_parse_constraint_document_ (_inLexique, var_cas_ioMetamodelComponentMap, var_cas_ioConstraintComponentMap) ;
}

//---------------------------------------------------------------------------*

void constraint_parser::
constraint_parser::
pr_galgas_component_constraint_parser_108_6_importLexique (galgas_scanner & _inLexique,
                                GGS_M_lexiqueComponents  &/* var_cas_ioLexiqueMapForUse */) {
  nt_parse_constraint_document_parse (_inLexique) ;
}

//---------------------------------------------------------------------------*

void constraint_parser::
constraint_parser::
pr_galgas_component_constraint_parser_108_6_importSyntax (galgas_scanner & _inLexique,
                                GGS_M_syntaxComponents  &/* var_cas_ioSyntaxComponentsMap */,
                                GGS_M_metamodelsComponents  &var_cas_ioMetamodelComponentMap) {
  GGS_M_constraintComponents  var_cas_constraintComponentMap ;
  var_cas_constraintComponentMap = GGS_M_constraintComponents::constructor_emptyMap (_inLexique COMMA_HERE) ;
  nt_parse_constraint_document_ (_inLexique, var_cas_ioMetamodelComponentMap, var_cas_constraintComponentMap) ;
}

//---------------------------------------------------------------------------*

void constraint_parser::
constraint_parser::
pr_galgas_component_constraint_parser_108_6_importSemantics (galgas_scanner & _inLexique,
                                GGS_M_semanticsComponents  &/* var_cas_ioSemanticsComponentsMap */,
                                GGS_M_metamodelsComponents  &var_cas_ioMetamodelComponentMap,
                                GGS_M_constraintComponents  &var_cas_ioConstraintComponentMap) {
  nt_parse_constraint_document_ (_inLexique, var_cas_ioMetamodelComponentMap, var_cas_ioConstraintComponentMap) ;
}

//---------------------------------------------------------------------------*

void constraint_parser::
constraint_parser::
pr_galgas_component_constraint_parser_108_6_importGrammarForSemantics (galgas_scanner & _inLexique,
                                GGS_M_grammarComponents  &/* var_cas_ioGrammarComponentsMap */,
                                GGS_M_metamodelsComponents  &var_cas_ioMetamodelComponentMap,
                                GGS_M_constraintComponents  &var_cas_ioConstraintComponentMap) {
  nt_parse_constraint_document_ (_inLexique, var_cas_ioMetamodelComponentMap, var_cas_ioConstraintComponentMap) ;
}

//---------------------------------------------------------------------------*

void constraint_parser::
constraint_parser::
pr_galgas_component_constraint_parser_108_6_importOptions (galgas_scanner & _inLexique,
                                GGS_M_optionComponents  &/* var_cas_ioOptionsComponentsMap */) {
  nt_parse_constraint_document_parse (_inLexique) ;
}

//---------------------------------------------------------------------------*
//                                                                           *
//             Implementation of routine "checkCallInstruction"              *
//                                                                           *
//---------------------------------------------------------------------------*

void routine_checkCallInstruction (C_Lexique & _inLexique,
                                const GGS_entityToImplementMap  & var_cas_inConstrainedEntityMap,
                                const GGS_lstring  & var_cas_inTestedReferenceName,
                                const GGS_callInstructionSharedPropertySignatureMap  & var_cas_inCallInstructionSharedPropertySignatureMap,
                                const GGS_lstring  & var_cas_inTestedPropertyName,
                                const GGS_entityPropertyMap  & var_cas_inAllAvailablePropertiesMap,
                                const GGS_location  & var_cas_inEndOfInstructionList COMMA_UNUSED_LOCATION_ARGS) {
  #ifdef DEBUG_TRACE_ENABLED
    printf ("ENTER routine_checkCallInstruction at %s:%d\n", __FILE__, __LINE__) ;
  #endif
  if ((var_cas_inConstrainedEntityMap.reader_hasKey (_inLexique, var_cas_inTestedReferenceName.reader_string (_inLexique SOURCE_FILE_AT_LINE (168)) SOURCE_FILE_AT_LINE (168))).isBuiltAndTrue ()) {
    if ((var_cas_inCallInstructionSharedPropertySignatureMap.reader_hasKey (_inLexique, var_cas_inTestedPropertyName.reader_string (_inLexique SOURCE_FILE_AT_LINE (169)) SOURCE_FILE_AT_LINE (169))).isBuiltAndTrue ()) {
      GGS_entityPropertyMap  var_cas_allContraintsPropertyMap ;
      GGS_entityPropertyMap  automatic_var_0 ;
      GGS_bool automatic_var_1 ;
      GGS_entityPropertyMap  automatic_var_2 ;
      GGS_lstring  automatic_var_3 ;
      GGS_entityPropertyMap  automatic_var_4 ;
      GGS_stringset  automatic_var_5 ;
      GGS_entityPropertyMap  automatic_var_6 ;
      if (var_cas_inConstrainedEntityMap._isBuilt ()) {
        var_cas_inConstrainedEntityMap (HERE)->method_searchKey (_inLexique, var_cas_inTestedReferenceName, automatic_var_0, automatic_var_1, automatic_var_2, automatic_var_3, automatic_var_4, automatic_var_5, var_cas_allContraintsPropertyMap, automatic_var_6 SOURCE_FILE_AT_LINE (173)) ;
      }
      GGS_metamodelPropertyList  var_cas_formalParameterTypeList ;
      var_cas_formalParameterTypeList = GGS_metamodelPropertyList::constructor_emptyList (_inLexique COMMA_HERE) ;
      GGS_entityPropertyMap::element_type * operand_6996 = var_cas_allContraintsPropertyMap.firstObject () ;
      while ((operand_6996 != NULL)) {
        macroValidPointer (operand_6996) ;
        if (operand_6996->mInfo.mProperty._isBuilt ()) {
          cPtr_metamodelSharedMapProperty * operand_7070 = dynamic_cast <cPtr_metamodelSharedMapProperty *> (operand_6996->mInfo.mProperty.getPtr ()) ;
          if (operand_7070 != NULL) {
            macroValidPointer (operand_7070) ; 
            var_cas_formalParameterTypeList._addAssign_operation (operand_6996->mInfo.mProperty) ;
          }else{ // Else part
          }
        }
        operand_6996 = operand_6996->nextObject () ;
      }
      GGS_L_lstringList  var_cas_effectiveArgumentList ;
      GGS_location  var_cas_endOfCallInstruction ;
      if (var_cas_inCallInstructionSharedPropertySignatureMap._isBuilt ()) {
        var_cas_inCallInstructionSharedPropertySignatureMap (HERE)->method_searchKey (_inLexique, var_cas_inTestedPropertyName, var_cas_effectiveArgumentList, var_cas_endOfCallInstruction SOURCE_FILE_AT_LINE (186)) ;
      }
      GGS_metamodelPropertyList  var_cas_effectiveArgumentTypeList ;
      var_cas_effectiveArgumentTypeList = GGS_metamodelPropertyList::constructor_emptyList (_inLexique COMMA_HERE) ;
      GGS_L_lstringList::element_type * operand_7679 = var_cas_effectiveArgumentList.firstObject () ;
      while ((operand_7679 != NULL)) {
        macroValidPointer (operand_7679) ;
        GGS_metamodelProperty  var_cas_property ;
        if (var_cas_inAllAvailablePropertiesMap._isBuilt ()) {
          var_cas_inAllAvailablePropertiesMap (HERE)->method_searchKey (_inLexique, operand_7679->mString, var_cas_property SOURCE_FILE_AT_LINE (190)) ;
        }
        var_cas_effectiveArgumentTypeList._addAssign_operation (var_cas_property) ;
        operand_7679 = operand_7679->nextObject () ;
      }
      if (((var_cas_formalParameterTypeList.reader_length (_inLexique SOURCE_FILE_AT_LINE (194))) != (var_cas_effectiveArgumentTypeList.reader_length (_inLexique SOURCE_FILE_AT_LINE (194)))).isBuiltAndTrue ()) {
        var_cas_endOfCallInstruction.reader_location (_inLexique COMMA_HERE).signalGGSSemanticError (_inLexique, ((((((GGS_string (true, "the call instruction names ")) + (var_cas_effectiveArgumentTypeList.reader_length (_inLexique SOURCE_FILE_AT_LINE (196)).reader_string (_inLexique SOURCE_FILE_AT_LINE (196))))) + (GGS_string (true, " argument(s) instead of ")))) + (var_cas_formalParameterTypeList.reader_length (_inLexique SOURCE_FILE_AT_LINE (197)).reader_string (_inLexique SOURCE_FILE_AT_LINE (197)))) SOURCE_FILE_AT_LINE (198)) ;
      }else{
        GGS_uint  var_cas_argumentIndex ;
        var_cas_argumentIndex = GGS_uint (true, 0U) ;
        GGS_metamodelPropertyList::element_type * operand_8306 = var_cas_formalParameterTypeList.firstObject () ;
        GGS_metamodelPropertyList::element_type * operand_8370 = var_cas_effectiveArgumentTypeList.firstObject () ;
        while ((operand_8306 != NULL)
            && (operand_8370 != NULL)) {
          macroValidPointer (operand_8306) ;
          macroValidPointer (operand_8370) ;
          var_cas_argumentIndex._increment_operation (_inLexique SOURCE_FILE_AT_LINE (201)) ;
          if (operand_8306->mProperty._isBuilt () && operand_8370->mProperty._isBuilt ()) {
            cPtr_metamodelProperty * ptr_8473 = operand_8306->mProperty (HERE) ;
            cPtr_metamodelProperty * ptr_8495 = operand_8370->mProperty (HERE) ;
            cPtr_metamodelSharedMapProperty * operand_8473 = dynamic_cast <cPtr_metamodelSharedMapProperty *> (ptr_8473) ;
            cPtr_metamodelMapProperty * operand_8495 = dynamic_cast <cPtr_metamodelMapProperty *> (ptr_8495) ;
            if ((operand_8473 != NULL) && (operand_8495 != NULL)) {
              if (((operand_8473->mMapTypeName.reader_string (_inLexique SOURCE_FILE_AT_LINE (204))) != (operand_8495->mMapTypeName.reader_string (_inLexique SOURCE_FILE_AT_LINE (204)))).isBuiltAndTrue ()) {
                var_cas_endOfCallInstruction.reader_location (_inLexique COMMA_HERE).signalGGSSemanticError (_inLexique, ((((((((((((GGS_string (true, "for argument ")) + (var_cas_argumentIndex.reader_string (_inLexique SOURCE_FILE_AT_LINE (205))))) + (GGS_string (true, ", the effective argument map type (")))) + (operand_8495->mMapTypeName.reader_string (_inLexique SOURCE_FILE_AT_LINE (206))))) + (GGS_string (true, ") is incompatible with formal parameter map type (")))) + (operand_8473->mMapTypeName.reader_string (_inLexique SOURCE_FILE_AT_LINE (207))))) + (GGS_string (true, ")"))) SOURCE_FILE_AT_LINE (209)) ;
              }
            }else{
              cPtr_metamodelSharedMapProperty * operand_8473 = dynamic_cast <cPtr_metamodelSharedMapProperty *> (ptr_8473) ;
              cPtr_metamodelSharedMapProperty * operand_8495 = dynamic_cast <cPtr_metamodelSharedMapProperty *> (ptr_8495) ;
              if ((operand_8473 != NULL) && (operand_8495 != NULL)) {
                if (((operand_8473->mMapTypeName.reader_string (_inLexique SOURCE_FILE_AT_LINE (211))) != (operand_8495->mMapTypeName.reader_string (_inLexique SOURCE_FILE_AT_LINE (211)))).isBuiltAndTrue ()) {
                  var_cas_endOfCallInstruction.reader_location (_inLexique COMMA_HERE).signalGGSSemanticError (_inLexique, ((((((((((((GGS_string (true, "for argument ")) + (var_cas_argumentIndex.reader_string (_inLexique SOURCE_FILE_AT_LINE (212))))) + (GGS_string (true, ", the effective argument map type (")))) + (operand_8495->mMapTypeName.reader_string (_inLexique SOURCE_FILE_AT_LINE (213))))) + (GGS_string (true, ") is incompatible with formal parameter map type (")))) + (operand_8473->mMapTypeName.reader_string (_inLexique SOURCE_FILE_AT_LINE (214))))) + (GGS_string (true, ")"))) SOURCE_FILE_AT_LINE (216)) ;
                }
              }else{
                var_cas_endOfCallInstruction.reader_location (_inLexique COMMA_HERE).signalGGSSemanticError (_inLexique, ((((((((((((GGS_string (true, "for argument ")) + (var_cas_argumentIndex.reader_string (_inLexique SOURCE_FILE_AT_LINE (218))))) + (GGS_string (true, ", the effective argument type (")))) + (operand_8370->mProperty.reader_messageProperty (_inLexique SOURCE_FILE_AT_LINE (219))))) + (GGS_string (true, ") is incompatible with formal parameter type (")))) + (operand_8306->mProperty.reader_messageProperty (_inLexique SOURCE_FILE_AT_LINE (220))))) + (GGS_string (true, ")"))) SOURCE_FILE_AT_LINE (222)) ;
              }
            }
          }
          operand_8306 = operand_8306->nextObject () ;
          operand_8370 = operand_8370->nextObject () ;
        }
      }
    }else{
      var_cas_inEndOfInstructionList.reader_location (_inLexique COMMA_HERE).signalGGSSemanticError (_inLexique, ((((GGS_string (true, "the instruction list should have a 'call ")) + (var_cas_inTestedPropertyName.reader_string (_inLexique SOURCE_FILE_AT_LINE (227))))) + (GGS_string (true, "' instruction"))) SOURCE_FILE_AT_LINE (228)) ;
    }
  }else if ((var_cas_inCallInstructionSharedPropertySignatureMap.reader_hasKey (_inLexique, var_cas_inTestedPropertyName.reader_string (_inLexique SOURCE_FILE_AT_LINE (229)) SOURCE_FILE_AT_LINE (229))).isBuiltAndTrue ()) {
    var_cas_inEndOfInstructionList.reader_location (_inLexique COMMA_HERE).signalGGSSemanticError (_inLexique, ((((GGS_string (true, "the instruction list should not have a 'call ")) + (var_cas_inTestedPropertyName.reader_string (_inLexique SOURCE_FILE_AT_LINE (230))))) + (GGS_string (true, "' instruction"))) SOURCE_FILE_AT_LINE (231)) ;
  }
  #ifdef DEBUG_TRACE_ENABLED
    printf ("LEAVE routine_checkCallInstruction\n") ;
  #endif
}

//---------------------------------------------------------------------------*
//                                                                           *
//      Implementation of production rule 'parse_constraint_document'        *
//                                                                           *
//---------------------------------------------------------------------------*

void constraint_parser::
constraint_parser::
pr_parse_constraint_document_constraint_parser_236_6_ (galgas_scanner & _inLexique,
                                GGS_M_metamodelsComponents  &/* var_cas_ioMetamodelComponentMap */,
                                GGS_M_constraintComponents  &var_cas_ioConstraintComponentMap) {
  _inLexique.acceptTerminal (ACCEPT_TERMINAL (galgas_scanner::galgas_scanner_1_constraint) COMMA_HERE) ;
  GGS_lstring  var_cas_constraintName ;
  _inLexique._assignFromAttribute_tokenString (var_cas_constraintName) ;
  _inLexique.acceptTerminal (ACCEPT_TERMINAL (galgas_scanner::galgas_scanner_1_identifier) COMMA_HERE) ;
  _inLexique.acceptTerminal (ACCEPT_TERMINAL (galgas_scanner::galgas_scanner_1__3A) COMMA_HERE) ;
  _inLexique.acceptTerminal (ACCEPT_TERMINAL (galgas_scanner::galgas_scanner_1_import) COMMA_HERE) ;
  _inLexique.acceptTerminal (ACCEPT_TERMINAL (galgas_scanner::galgas_scanner_1_metamodel) COMMA_HERE) ;
  GGS_lstring  var_cas_metamodelName ;
  _inLexique._assignFromAttribute_tokenString (var_cas_metamodelName) ;
  _inLexique.acceptTerminal (ACCEPT_TERMINAL (galgas_scanner::galgas_scanner_1_identifier) COMMA_HERE) ;
  _inLexique.acceptTerminal (ACCEPT_TERMINAL (galgas_scanner::galgas_scanner_1_in) COMMA_HERE) ;
  GGS_lstring  var_cas_fileName ;
  _inLexique._assignFromAttribute_tokenString (var_cas_fileName) ;
  _inLexique.acceptTerminal (ACCEPT_TERMINAL (galgas_scanner::galgas_scanner_1_literal_5Fstring) COMMA_HERE) ;
  _inLexique.acceptTerminal (ACCEPT_TERMINAL (galgas_scanner::galgas_scanner_1__3B) COMMA_HERE) ;
  GGS_M_semanticsComponents  var_cas_unusedSemanticsMapForUse ;
  var_cas_unusedSemanticsMapForUse = GGS_M_semanticsComponents::constructor_emptyMap (_inLexique COMMA_HERE) ;
  GGS_M_metamodelsComponents  var_cas_metamodelComponentMap ;
  var_cas_metamodelComponentMap = GGS_M_metamodelsComponents::constructor_emptyMap (_inLexique COMMA_HERE) ;
  nt_parse_semantics_component_for_importing_ (_inLexique, var_cas_fileName, var_cas_unusedSemanticsMapForUse, var_cas_metamodelComponentMap, var_cas_ioConstraintComponentMap) ;
  GGS_lstring  var_cas_rootEntity ;
  GGS_entityToImplementMap  var_cas_originalMetamodelEntityMap ;
  GGS_stringset  automatic_var_7 ;
  if (var_cas_metamodelComponentMap._isBuilt ()) {
    var_cas_metamodelComponentMap (HERE)->method_searchKey (_inLexique, var_cas_metamodelName, var_cas_rootEntity, var_cas_originalMetamodelEntityMap, automatic_var_7 SOURCE_FILE_AT_LINE (265)) ;
  }
  GGS_entityToImplementMap  var_cas_metamodelEntityMap ;
  GGS_stringset  var_cas_overriddenClassSet ;
  nt_constraint_class_override_declarations_ (_inLexique, var_cas_rootEntity, var_cas_originalMetamodelEntityMap, var_cas_metamodelEntityMap, var_cas_overriddenClassSet) ;
  GGS_mapEntityMap  var_cas_mapEntityMap ;
  var_cas_mapEntityMap = GGS_mapEntityMap::constructor_emptyMap (_inLexique COMMA_HERE) ;
  { bool syntaxRepeat = true ;
    while (syntaxRepeat) {
      switch (select_repeat_constraint_parser_0 (_inLexique)) {
        case 2 : {
          nt_constraint_map_declaration_ (_inLexique, var_cas_overriddenClassSet, var_cas_metamodelEntityMap, var_cas_mapEntityMap) ;
          } break ;
        default :
          syntaxRepeat = false ;
          break ;
      }
    }
  }
  GGS_entityToImplementMap  var_cas_constrainedEntityMap ;
  var_cas_constrainedEntityMap = GGS_entityToImplementMap::constructor_emptyMap (_inLexique COMMA_HERE) ;
  GGS_constraintInstructionListMap  var_cas_constraintInstructionListMap ;
  var_cas_constraintInstructionListMap = GGS_constraintInstructionListMap::constructor_emptyMap (_inLexique COMMA_HERE) ;
  { bool syntaxRepeat = true ;
    while (syntaxRepeat) {
        nt_constraints_on_entity_declaration_ (_inLexique, var_cas_constraintName, var_cas_overriddenClassSet, var_cas_metamodelEntityMap, var_cas_mapEntityMap, var_cas_constrainedEntityMap, var_cas_constraintInstructionListMap) ;
      switch (select_repeat_constraint_parser_1 (_inLexique)) {
        case 2 : {
          } break ;
        default :
          syntaxRepeat = false ;
          break ;
      }
    }
  }
  _inLexique.acceptTerminal (ACCEPT_TERMINAL (galgas_scanner::galgas_scanner_1_end) COMMA_HERE) ;
  GGS_stringset::element_type * operand_12447 = var_cas_overriddenClassSet.firstObject () ;
  while ((operand_12447 != NULL)) {
    macroValidPointer (operand_12447) ;
    if (((! (var_cas_constrainedEntityMap.reader_hasKey (_inLexique, operand_12447->mKey SOURCE_FILE_AT_LINE (307))))).isBuiltAndTrue ()) {
      GGS_location (_inLexique).reader_location (_inLexique COMMA_HERE).signalGGSSemanticError (_inLexique, ((((GGS_string (true, "the '%")) + (operand_12447->mKey))) + (GGS_string (true, "' is declared as overridden, but is not defined"))) SOURCE_FILE_AT_LINE (309)) ;
    }
    operand_12447 = operand_12447->nextObject () ;
  }
  if (((! (var_cas_constrainedEntityMap.reader_hasKey (_inLexique, var_cas_rootEntity.reader_string (_inLexique SOURCE_FILE_AT_LINE (312)) SOURCE_FILE_AT_LINE (312))))).isBuiltAndTrue ()) {
    GGS_location (_inLexique).reader_location (_inLexique COMMA_HERE).signalGGSSemanticError (_inLexique, ((((GGS_string (true, "the @")) + (var_cas_rootEntity.reader_string (_inLexique SOURCE_FILE_AT_LINE (313))))) + (GGS_string (true, " root entity should be defined"))) SOURCE_FILE_AT_LINE (314)) ;
  }
  GGS_representativeEntityMap  var_cas_representativeEntityMap ;
  var_cas_representativeEntityMap = GGS_representativeEntityMap::constructor_emptyMap (_inLexique COMMA_HERE) ;
  GGS_entityToImplementMap::element_type * operand_12971 = var_cas_metamodelEntityMap.firstObject () ;
  while ((operand_12971 != NULL)) {
    macroValidPointer (operand_12971) ;
    GGS_lstring  var_cas_representativeTypeName ;
    ::routine_computeRepresentativeEntityName (_inLexique,  var_cas_metamodelEntityMap,  var_cas_constrainedEntityMap,  operand_12971->mKey,  var_cas_representativeTypeName SOURCE_FILE_AT_LINE (319)) ;
    GGS_stringset  var_cas_superEntitySet ;
    var_cas_superEntitySet = operand_12971->mInfo.mSuperEntitySet ;
    var_cas_superEntitySet._addAssign_operation (operand_12971->mKey.reader_string (_inLexique SOURCE_FILE_AT_LINE (326))) ;
    var_cas_representativeEntityMap.modifier_insertKey (_inLexique, operand_12971->mKey, var_cas_representativeTypeName, var_cas_superEntitySet SOURCE_FILE_AT_LINE (327)) ;
    operand_12971 = operand_12971->nextObject () ;
  }
  GGS_stringset  var_cas_multiReferencedEntities ;
  var_cas_multiReferencedEntities = GGS_stringset::constructor_emptySet (_inLexique COMMA_HERE) ;
  GGS_entityToImplementMap::element_type * operand_13671 = var_cas_constrainedEntityMap.firstObject () ;
  while ((operand_13671 != NULL)) {
    macroValidPointer (operand_13671) ;
    GGS_entityPropertyMap::element_type * operand_15715 = operand_13671->mInfo.mAllMetamodelPropertyMap.firstObject () ;
    while ((operand_15715 != NULL)) {
      macroValidPointer (operand_15715) ;
      if (operand_15715->mInfo.mProperty._isBuilt ()) {
        cPtr_metamodelMultipleReferenceProperty * operand_16230 = dynamic_cast <cPtr_metamodelMultipleReferenceProperty *> (operand_15715->mInfo.mProperty.getPtr ()) ;
        if (operand_16230 != NULL) {
          macroValidPointer (operand_16230) ; 
          GGS_lstring  var_cas_representativeTypeName ;
          ::routine_computeRepresentativeEntityName (_inLexique,  var_cas_metamodelEntityMap,  var_cas_constrainedEntityMap,  operand_16230->mReferenceEntityName,  var_cas_representativeTypeName SOURCE_FILE_AT_LINE (396)) ;
          if (((var_cas_representativeTypeName.reader_string (_inLexique SOURCE_FILE_AT_LINE (402))) != (GGS_string (true, ""))).isBuiltAndTrue ()) {
            var_cas_multiReferencedEntities._addAssign_operation (var_cas_representativeTypeName.reader_string (_inLexique SOURCE_FILE_AT_LINE (403))) ;
          }
        }else{ // Else part
        }
      }
      operand_15715 = operand_15715->nextObject () ;
    }
    operand_13671 = operand_13671->nextObject () ;
  }
  GGS_entityToImplementMap::element_type * operand_17986 = var_cas_constrainedEntityMap.firstObject () ;
  while ((operand_17986 != NULL)) {
    macroValidPointer (operand_17986) ;
    GGS_callInstructionSharedPropertySignatureMap  var_cas_callInstructionSharedPropertySignatureMap ;
    GGS_location  var_cas_endOfInstructionList ;
    GGS_typeInstructionList  automatic_var_8 ;
    if (var_cas_constraintInstructionListMap._isBuilt ()) {
      var_cas_constraintInstructionListMap (HERE)->method_searchKey (_inLexique, operand_17986->mKey, automatic_var_8, var_cas_callInstructionSharedPropertySignatureMap, var_cas_endOfInstructionList SOURCE_FILE_AT_LINE (456)) ;
    }
    GGS_entityPropertyMap::element_type * operand_18485 = operand_17986->mInfo.mCurrentMetamodelPropertyMap.firstObject () ;
    while ((operand_18485 != NULL)) {
      macroValidPointer (operand_18485) ;
      if (operand_18485->mInfo.mProperty._isBuilt ()) {
        cPtr_metamodelSingleReferenceProperty * operand_18578 = dynamic_cast <cPtr_metamodelSingleReferenceProperty *> (operand_18485->mInfo.mProperty.getPtr ()) ;
        if (operand_18578 != NULL) {
          macroValidPointer (operand_18578) ; 
          ::routine_checkCallInstruction (_inLexique,  var_cas_constrainedEntityMap,  operand_18578->mReferenceEntityName,  var_cas_callInstructionSharedPropertySignatureMap,  operand_18485->mKey,  operand_17986->mInfo.mAllAvailablePropertyMap,  var_cas_endOfInstructionList SOURCE_FILE_AT_LINE (460)) ;
        }else{
          cPtr_metamodelMultipleReferenceProperty * operand_18918 = dynamic_cast <cPtr_metamodelMultipleReferenceProperty *> (operand_18485->mInfo.mProperty.getPtr ()) ;
          if (operand_18918 != NULL) {
            macroValidPointer (operand_18918) ; 
            ::routine_checkCallInstruction (_inLexique,  var_cas_constrainedEntityMap,  operand_18918->mReferenceEntityName,  var_cas_callInstructionSharedPropertySignatureMap,  operand_18485->mKey,  operand_17986->mInfo.mAllAvailablePropertyMap,  var_cas_endOfInstructionList SOURCE_FILE_AT_LINE (469)) ;
          }else{ // Else part
          }
        }
      }
      operand_18485 = operand_18485->nextObject () ;
    }
    operand_17986 = operand_17986->nextObject () ;
  }
  if (var_cas_metamodelEntityMap._isBuilt () &&
      var_cas_mapEntityMap._isBuilt () &&
      var_cas_metamodelName._isBuilt () &&
      var_cas_constraintName._isBuilt () &&
      var_cas_constrainedEntityMap._isBuilt () &&
      var_cas_multiReferencedEntities._isBuilt () &&
      var_cas_rootEntity._isBuilt () &&
      var_cas_representativeEntityMap._isBuilt () &&
      var_cas_constraintInstructionListMap._isBuilt ()) {
    ::routine_generate_constraints (_inLexique,  var_cas_metamodelEntityMap,  var_cas_mapEntityMap,  var_cas_metamodelName,  var_cas_constraintName,  var_cas_constrainedEntityMap,  var_cas_multiReferencedEntities,  var_cas_rootEntity,  var_cas_representativeEntityMap,  var_cas_constraintInstructionListMap SOURCE_FILE_AT_LINE (482)) ;
  }
  _inLexique.acceptTerminal (ACCEPT_TERMINAL (galgas_scanner::galgas_scanner_1_constraint) COMMA_HERE) ;
  _inLexique.acceptTerminal (ACCEPT_TERMINAL (galgas_scanner::galgas_scanner_1__3B) COMMA_HERE) ;
}

//---------------------------------------------------------------------------*

void constraint_parser::
pr_parse_constraint_document_constraint_parser_236_6_parse (galgas_scanner & _inLexique) {
  _inLexique.acceptTerminal (ACCEPT_TERMINAL (galgas_scanner::galgas_scanner_1_constraint) COMMA_HERE) ;
  _inLexique.acceptTerminal (ACCEPT_TERMINAL (galgas_scanner::galgas_scanner_1_identifier) COMMA_HERE) ;
  _inLexique.acceptTerminal (ACCEPT_TERMINAL (galgas_scanner::galgas_scanner_1__3A) COMMA_HERE) ;
  _inLexique.acceptTerminal (ACCEPT_TERMINAL (galgas_scanner::galgas_scanner_1_import) COMMA_HERE) ;
  _inLexique.acceptTerminal (ACCEPT_TERMINAL (galgas_scanner::galgas_scanner_1_metamodel) COMMA_HERE) ;
  _inLexique.acceptTerminal (ACCEPT_TERMINAL (galgas_scanner::galgas_scanner_1_identifier) COMMA_HERE) ;
  _inLexique.acceptTerminal (ACCEPT_TERMINAL (galgas_scanner::galgas_scanner_1_in) COMMA_HERE) ;
  _inLexique.acceptTerminal (ACCEPT_TERMINAL (galgas_scanner::galgas_scanner_1_literal_5Fstring) COMMA_HERE) ;
  _inLexique.acceptTerminal (ACCEPT_TERMINAL (galgas_scanner::galgas_scanner_1__3B) COMMA_HERE) ;
  nt_parse_semantics_component_for_importing_parse (_inLexique) ;
  nt_constraint_class_override_declarations_parse (_inLexique) ;
  { bool syntaxRepeat = true ;
    while (syntaxRepeat) {
      switch (select_repeat_constraint_parser_0 (_inLexique)) {
        case 2 : {
          nt_constraint_map_declaration_parse (_inLexique) ;
          } break ;
        default :
          syntaxRepeat = false ;
          break ;
      }
    }
  }
  { bool syntaxRepeat = true ;
    while (syntaxRepeat) {
        nt_constraints_on_entity_declaration_parse (_inLexique) ;
      switch (select_repeat_constraint_parser_1 (_inLexique)) {
        case 2 : {
          } break ;
        default :
          syntaxRepeat = false ;
          break ;
      }
    }
  }
  _inLexique.acceptTerminal (ACCEPT_TERMINAL (galgas_scanner::galgas_scanner_1_end) COMMA_HERE) ;
  _inLexique.acceptTerminal (ACCEPT_TERMINAL (galgas_scanner::galgas_scanner_1_constraint) COMMA_HERE) ;
  _inLexique.acceptTerminal (ACCEPT_TERMINAL (galgas_scanner::galgas_scanner_1__3B) COMMA_HERE) ;
}

//---------------------------------------------------------------------------*
//                                                                           *
//      Implementation of production rule 'constraint_map_declaration'       *
//                                                                           *
//---------------------------------------------------------------------------*

void constraint_parser::
constraint_parser::
pr_constraint_map_declaration_constraint_parser_499_6_ (galgas_scanner & _inLexique,
                                const GGS_stringset  &var_cas_inOverriddenClassSet,
                                GGS_entityToImplementMap  var_cas_inMetamodelEntityMap,
                                GGS_mapEntityMap  &var_cas_ioMapEntityMap) {
  _inLexique.acceptTerminal (ACCEPT_TERMINAL (galgas_scanner::galgas_scanner_1_map) COMMA_HERE) ;
  GGS_lstring  var_cas_mapIdentifier ;
  _inLexique._assignFromAttribute_tokenString (var_cas_mapIdentifier) ;
  _inLexique.acceptTerminal (ACCEPT_TERMINAL (galgas_scanner::galgas_scanner_1_mda_5Ftype_5Fname) COMMA_HERE) ;
  if ((var_cas_inMetamodelEntityMap.reader_hasKey (_inLexique, var_cas_mapIdentifier.reader_string (_inLexique SOURCE_FILE_AT_LINE (507)) SOURCE_FILE_AT_LINE (507))).isBuiltAndTrue ()) {
    var_cas_mapIdentifier.reader_location (_inLexique COMMA_HERE).signalGGSSemanticError (_inLexique, GGS_string (true, "An entity has been declared with this name") SOURCE_FILE_AT_LINE (509)) ;
  }
  _inLexique.acceptTerminal (ACCEPT_TERMINAL (galgas_scanner::galgas_scanner_1_of) COMMA_HERE) ;
  GGS_lstring  var_cas_mapElementIdentifier ;
  _inLexique._assignFromAttribute_tokenString (var_cas_mapElementIdentifier) ;
  _inLexique.acceptTerminal (ACCEPT_TERMINAL (galgas_scanner::galgas_scanner_1_mda_5Ftype_5Fname) COMMA_HERE) ;
  GGS_bool var_cas_isElementTypeOverridden ;
  var_cas_isElementTypeOverridden = var_cas_inOverriddenClassSet.reader_hasKey (_inLexique, var_cas_mapElementIdentifier.reader_string (_inLexique SOURCE_FILE_AT_LINE (513)) SOURCE_FILE_AT_LINE (513)) ;
  _inLexique.acceptTerminal (ACCEPT_TERMINAL (galgas_scanner::galgas_scanner_1__7B) COMMA_HERE) ;
  _inLexique.acceptTerminal (ACCEPT_TERMINAL (galgas_scanner::galgas_scanner_1_insert) COMMA_HERE) ;
  _inLexique.acceptTerminal (ACCEPT_TERMINAL (galgas_scanner::galgas_scanner_1_error) COMMA_HERE) ;
  _inLexique.acceptTerminal (ACCEPT_TERMINAL (galgas_scanner::galgas_scanner_1_message) COMMA_HERE) ;
  GGS_lstring  var_cas_insertErrorMessage ;
  _inLexique._assignFromAttribute_tokenString (var_cas_insertErrorMessage) ;
  _inLexique.acceptTerminal (ACCEPT_TERMINAL (galgas_scanner::galgas_scanner_1_literal_5Fstring) COMMA_HERE) ;
  if (var_cas_insertErrorMessage._isBuilt ()) {
    ::routine_check_KL_escapeCharacters (_inLexique,  var_cas_insertErrorMessage SOURCE_FILE_AT_LINE (520)) ;
  }
  _inLexique.acceptTerminal (ACCEPT_TERMINAL (galgas_scanner::galgas_scanner_1__3B) COMMA_HERE) ;
  _inLexique.acceptTerminal (ACCEPT_TERMINAL (galgas_scanner::galgas_scanner_1_search) COMMA_HERE) ;
  _inLexique.acceptTerminal (ACCEPT_TERMINAL (galgas_scanner::galgas_scanner_1_error) COMMA_HERE) ;
  _inLexique.acceptTerminal (ACCEPT_TERMINAL (galgas_scanner::galgas_scanner_1_message) COMMA_HERE) ;
  GGS_lstring  var_cas_searchErrorMessage ;
  _inLexique._assignFromAttribute_tokenString (var_cas_searchErrorMessage) ;
  _inLexique.acceptTerminal (ACCEPT_TERMINAL (galgas_scanner::galgas_scanner_1_literal_5Fstring) COMMA_HERE) ;
  if (var_cas_searchErrorMessage._isBuilt ()) {
    ::routine_check_K_escapeCharacters (_inLexique,  var_cas_searchErrorMessage SOURCE_FILE_AT_LINE (527)) ;
  }
  _inLexique.acceptTerminal (ACCEPT_TERMINAL (galgas_scanner::galgas_scanner_1__3B) COMMA_HERE) ;
  _inLexique.acceptTerminal (ACCEPT_TERMINAL (galgas_scanner::galgas_scanner_1__7D) COMMA_HERE) ;
  var_cas_ioMapEntityMap.modifier_insertKey (_inLexique, var_cas_mapIdentifier, var_cas_mapElementIdentifier, var_cas_insertErrorMessage, var_cas_searchErrorMessage, var_cas_isElementTypeOverridden SOURCE_FILE_AT_LINE (530)) ;
}

//---------------------------------------------------------------------------*

void constraint_parser::
pr_constraint_map_declaration_constraint_parser_499_6_parse (galgas_scanner & _inLexique) {
  _inLexique.acceptTerminal (ACCEPT_TERMINAL (galgas_scanner::galgas_scanner_1_map) COMMA_HERE) ;
  _inLexique.acceptTerminal (ACCEPT_TERMINAL (galgas_scanner::galgas_scanner_1_mda_5Ftype_5Fname) COMMA_HERE) ;
  _inLexique.acceptTerminal (ACCEPT_TERMINAL (galgas_scanner::galgas_scanner_1_of) COMMA_HERE) ;
  _inLexique.acceptTerminal (ACCEPT_TERMINAL (galgas_scanner::galgas_scanner_1_mda_5Ftype_5Fname) COMMA_HERE) ;
  _inLexique.acceptTerminal (ACCEPT_TERMINAL (galgas_scanner::galgas_scanner_1__7B) COMMA_HERE) ;
  _inLexique.acceptTerminal (ACCEPT_TERMINAL (galgas_scanner::galgas_scanner_1_insert) COMMA_HERE) ;
  _inLexique.acceptTerminal (ACCEPT_TERMINAL (galgas_scanner::galgas_scanner_1_error) COMMA_HERE) ;
  _inLexique.acceptTerminal (ACCEPT_TERMINAL (galgas_scanner::galgas_scanner_1_message) COMMA_HERE) ;
  _inLexique.acceptTerminal (ACCEPT_TERMINAL (galgas_scanner::galgas_scanner_1_literal_5Fstring) COMMA_HERE) ;
  _inLexique.acceptTerminal (ACCEPT_TERMINAL (galgas_scanner::galgas_scanner_1__3B) COMMA_HERE) ;
  _inLexique.acceptTerminal (ACCEPT_TERMINAL (galgas_scanner::galgas_scanner_1_search) COMMA_HERE) ;
  _inLexique.acceptTerminal (ACCEPT_TERMINAL (galgas_scanner::galgas_scanner_1_error) COMMA_HERE) ;
  _inLexique.acceptTerminal (ACCEPT_TERMINAL (galgas_scanner::galgas_scanner_1_message) COMMA_HERE) ;
  _inLexique.acceptTerminal (ACCEPT_TERMINAL (galgas_scanner::galgas_scanner_1_literal_5Fstring) COMMA_HERE) ;
  _inLexique.acceptTerminal (ACCEPT_TERMINAL (galgas_scanner::galgas_scanner_1__3B) COMMA_HERE) ;
  _inLexique.acceptTerminal (ACCEPT_TERMINAL (galgas_scanner::galgas_scanner_1__7D) COMMA_HERE) ;
}

//---------------------------------------------------------------------------*
//                                                                           *
//  Implementation of production rule 'constraints_on_entity_declaration'    *
//                                                                           *
//---------------------------------------------------------------------------*

void constraint_parser::
constraint_parser::
pr_constraints_on_entity_declaration_constraint_parser_541_6_ (galgas_scanner & _inLexique,
                                const GGS_lstring  &var_cas_inConstraintName,
                                const GGS_stringset  &var_cas_inOverriddenClassSet,
                                GGS_entityToImplementMap  var_cas_inEntityMap,
                                GGS_mapEntityMap  &var_cas_ioMapEntityMap,
                                GGS_entityToImplementMap  &var_cas_ioConstrainedEntityMap,
                                GGS_constraintInstructionListMap  &var_cas_ioConstraintInstructionListMap) {
  _inLexique.acceptTerminal (ACCEPT_TERMINAL (galgas_scanner::galgas_scanner_1_class) COMMA_HERE) ;
  GGS_lstring  var_cas_entityName ;
  _inLexique._assignFromAttribute_tokenString (var_cas_entityName) ;
  _inLexique.acceptTerminal (ACCEPT_TERMINAL (galgas_scanner::galgas_scanner_1_mda_5Ftype_5Fname) COMMA_HERE) ;
  GGS_lstring  var_cas_superEntity ;
  GGS_entityPropertyMap  var_cas_allMetamodelPropertyMap ;
  GGS_stringset  var_cas_superClassSet ;
  GGS_entityPropertyMap  var_cas_currentMetamodelPropertyMap ;
  GGS_entityPropertyMap  var_cas_allConstraintPropertyMap ;
  GGS_entityPropertyMap  var_cas_allAvailablePropertyMap ;
  GGS_bool automatic_var_9 ;
  GGS_entityPropertyMap  automatic_var_10 ;
  if (var_cas_inEntityMap._isBuilt ()) {
    var_cas_inEntityMap (HERE)->method_searchKey (_inLexique, var_cas_entityName, var_cas_allMetamodelPropertyMap, automatic_var_9, var_cas_currentMetamodelPropertyMap, var_cas_superEntity, automatic_var_10, var_cas_superClassSet, var_cas_allConstraintPropertyMap, var_cas_allAvailablePropertyMap SOURCE_FILE_AT_LINE (560)) ;
  }
  if (((var_cas_superEntity.reader_string (_inLexique SOURCE_FILE_AT_LINE (574))) == (GGS_string (true, ""))).isBuiltAndTrue ()) {
  }else if ((var_cas_ioConstrainedEntityMap.reader_hasKey (_inLexique, var_cas_superEntity.reader_string (_inLexique SOURCE_FILE_AT_LINE (576)) SOURCE_FILE_AT_LINE (576))).isBuiltAndTrue ()) {
    GGS_entityPropertyMap  var_cas_inheritedConstraintPropertyMap ;
    GGS_entityPropertyMap  automatic_var_11 ;
    GGS_bool automatic_var_12 ;
    GGS_entityPropertyMap  automatic_var_13 ;
    GGS_lstring  automatic_var_14 ;
    GGS_stringset  automatic_var_15 ;
    GGS_entityPropertyMap  automatic_var_16 ;
    if (var_cas_ioConstrainedEntityMap._isBuilt ()) {
      var_cas_ioConstrainedEntityMap (HERE)->method_searchKey (_inLexique, var_cas_superEntity, automatic_var_11, automatic_var_12, automatic_var_13, automatic_var_14, var_cas_inheritedConstraintPropertyMap, automatic_var_15, var_cas_allConstraintPropertyMap, automatic_var_16 SOURCE_FILE_AT_LINE (578)) ;
    }
    GGS_entityPropertyMap::element_type * operand_22481 = var_cas_inheritedConstraintPropertyMap.firstObject () ;
    while ((operand_22481 != NULL)) {
      macroValidPointer (operand_22481) ;
      var_cas_allAvailablePropertyMap.modifier_insertKey (_inLexique, operand_22481->mKey, operand_22481->mInfo.mProperty SOURCE_FILE_AT_LINE (590)) ;
      operand_22481 = operand_22481->nextObject () ;
    }
  }else{
    var_cas_entityName.reader_location (_inLexique COMMA_HERE).signalGGSSemanticError (_inLexique, ((((GGS_string (true, "constraints for super entity ('@")) + (var_cas_superEntity.reader_string (_inLexique SOURCE_FILE_AT_LINE (594))))) + (GGS_string (true, "') should be previously defined"))) SOURCE_FILE_AT_LINE (595)) ;
  }
  GGS_entityPropertyMap  var_cas_currentConstraintPropertyMap ;
  var_cas_currentConstraintPropertyMap = GGS_entityPropertyMap::constructor_emptyMap (_inLexique COMMA_HERE) ;
  switch (select_constraint_parser_2 (_inLexique)) {
    case 1 : {
      } break ;
    case 2 : {
      _inLexique.acceptTerminal (ACCEPT_TERMINAL (galgas_scanner::galgas_scanner_1__28) COMMA_HERE) ;
      if (((var_cas_superEntity.reader_string (_inLexique SOURCE_FILE_AT_LINE (601))) != (GGS_string (true, ""))).isBuiltAndTrue ()) {
        GGS_location (_inLexique).reader_location (_inLexique COMMA_HERE).signalGGSSemanticError (_inLexique, ((((GGS_string (true, "as the '@")) + (var_cas_entityName.reader_string (_inLexique SOURCE_FILE_AT_LINE (602))))) + (GGS_string (true, "' entity has a super entity, you cannot define any shared property"))) SOURCE_FILE_AT_LINE (604)) ;
      }
      { bool syntaxRepeat = true ;
        while (syntaxRepeat) {
            GGS_lstring  var_cas_typeName ;
            _inLexique._assignFromAttribute_tokenString (var_cas_typeName) ;
            _inLexique.acceptTerminal (ACCEPT_TERMINAL (galgas_scanner::galgas_scanner_1_mda_5Ftype_5Fname) COMMA_HERE) ;
            GGS_lstring  var_cas_elementTypeName ;
            GGS_lstring  automatic_var_17 ;
            GGS_lstring  automatic_var_18 ;
            GGS_bool automatic_var_19 ;
            if (var_cas_ioMapEntityMap._isBuilt ()) {
              var_cas_ioMapEntityMap (HERE)->method_searchKey (_inLexique, var_cas_typeName, var_cas_elementTypeName, automatic_var_17, automatic_var_18, automatic_var_19 SOURCE_FILE_AT_LINE (609)) ;
            }
            GGS_metamodelProperty  var_cas_property ;
            var_cas_property = GGS_metamodelSharedMapProperty::constructor_new (_inLexique, var_cas_typeName, var_cas_elementTypeName COMMA_HERE) ;
            GGS_lstring  var_cas_propertyName ;
            _inLexique._assignFromAttribute_tokenString (var_cas_propertyName) ;
            _inLexique.acceptTerminal (ACCEPT_TERMINAL (galgas_scanner::galgas_scanner_1_identifier) COMMA_HERE) ;
            var_cas_currentConstraintPropertyMap.modifier_insertKey (_inLexique, var_cas_propertyName, var_cas_property SOURCE_FILE_AT_LINE (613)) ;
            var_cas_allConstraintPropertyMap.modifier_insertKey (_inLexique, var_cas_propertyName, var_cas_property SOURCE_FILE_AT_LINE (614)) ;
            var_cas_allAvailablePropertyMap.modifier_insertKey (_inLexique, var_cas_propertyName, var_cas_property SOURCE_FILE_AT_LINE (615)) ;
          switch (select_repeat_constraint_parser_3 (_inLexique)) {
            case 2 : {
              _inLexique.acceptTerminal (ACCEPT_TERMINAL (galgas_scanner::galgas_scanner_1__2C) COMMA_HERE) ;
              } break ;
            default :
              syntaxRepeat = false ;
              break ;
          }
        }
      }
      _inLexique.acceptTerminal (ACCEPT_TERMINAL (galgas_scanner::galgas_scanner_1__29) COMMA_HERE) ;
      } break ;
    default :
      break ;
  }
  GGS_indexMap  var_cas_currentIndexMap ;
  var_cas_currentIndexMap = GGS_indexMap::constructor_emptyMap (_inLexique COMMA_HERE) ;
  _inLexique.acceptTerminal (ACCEPT_TERMINAL (galgas_scanner::galgas_scanner_1__7B) COMMA_HERE) ;
  { bool syntaxRepeat = true ;
    while (syntaxRepeat) {
      switch (select_repeat_constraint_parser_4 (_inLexique)) {
        case 2 : {
          GGS_lstring  var_cas_typeName ;
          _inLexique._assignFromAttribute_tokenString (var_cas_typeName) ;
          _inLexique.acceptTerminal (ACCEPT_TERMINAL (galgas_scanner::galgas_scanner_1_mda_5Ftype_5Fname) COMMA_HERE) ;
          GGS_lstring  var_cas_elementTypeName ;
          GGS_lstring  automatic_var_20 ;
          GGS_lstring  automatic_var_21 ;
          GGS_bool automatic_var_22 ;
          if (var_cas_ioMapEntityMap._isBuilt ()) {
            var_cas_ioMapEntityMap (HERE)->method_searchKey (_inLexique, var_cas_typeName, var_cas_elementTypeName, automatic_var_20, automatic_var_21, automatic_var_22 SOURCE_FILE_AT_LINE (629)) ;
          }
          GGS_metamodelProperty  var_cas_property ;
          var_cas_property = GGS_metamodelMapProperty::constructor_new (_inLexique, var_cas_typeName, var_cas_elementTypeName COMMA_HERE) ;
          GGS_lstring  var_cas_propertyName ;
          _inLexique._assignFromAttribute_tokenString (var_cas_propertyName) ;
          _inLexique.acceptTerminal (ACCEPT_TERMINAL (galgas_scanner::galgas_scanner_1_identifier) COMMA_HERE) ;
          var_cas_currentConstraintPropertyMap.modifier_insertKey (_inLexique, var_cas_propertyName, var_cas_property SOURCE_FILE_AT_LINE (633)) ;
          var_cas_allConstraintPropertyMap.modifier_insertKey (_inLexique, var_cas_propertyName, var_cas_property SOURCE_FILE_AT_LINE (634)) ;
          var_cas_allAvailablePropertyMap.modifier_insertKey (_inLexique, var_cas_propertyName, var_cas_property SOURCE_FILE_AT_LINE (635)) ;
          _inLexique.acceptTerminal (ACCEPT_TERMINAL (galgas_scanner::galgas_scanner_1__3B) COMMA_HERE) ;
          } break ;
        case 3 : {
          _inLexique.acceptTerminal (ACCEPT_TERMINAL (galgas_scanner::galgas_scanner_1_mapindex) COMMA_HERE) ;
          GGS_lstring  var_cas_mapIndexName ;
          _inLexique._assignFromAttribute_tokenString (var_cas_mapIndexName) ;
          _inLexique.acceptTerminal (ACCEPT_TERMINAL (galgas_scanner::galgas_scanner_1_identifier) COMMA_HERE) ;
          _inLexique.acceptTerminal (ACCEPT_TERMINAL (galgas_scanner::galgas_scanner_1_on) COMMA_HERE) ;
          GGS_lstring  var_cas_mapAttributeName ;
          _inLexique._assignFromAttribute_tokenString (var_cas_mapAttributeName) ;
          _inLexique.acceptTerminal (ACCEPT_TERMINAL (galgas_scanner::galgas_scanner_1_identifier) COMMA_HERE) ;
          GGS_metamodelProperty  var_cas_propertyOfMapAttributeName ;
          if (var_cas_allConstraintPropertyMap._isBuilt ()) {
            var_cas_allConstraintPropertyMap (HERE)->method_searchKey (_inLexique, var_cas_mapAttributeName, var_cas_propertyOfMapAttributeName SOURCE_FILE_AT_LINE (645)) ;
          }
          GGS_metamodelProperty  var_cas_property ;
          if (var_cas_propertyOfMapAttributeName._isBuilt ()) {
            cPtr_metamodelMapProperty * operand_24796 = dynamic_cast <cPtr_metamodelMapProperty *> (var_cas_propertyOfMapAttributeName.getPtr ()) ;
            if (operand_24796 != NULL) {
              macroValidPointer (operand_24796) ; 
              var_cas_property = GGS_mapIndexProperty::constructor_new (_inLexique, operand_24796->mMapTypeName, var_cas_mapAttributeName COMMA_HERE) ;
            }else{
              cPtr_metamodelSharedMapProperty * operand_24936 = dynamic_cast <cPtr_metamodelSharedMapProperty *> (var_cas_propertyOfMapAttributeName.getPtr ()) ;
              if (operand_24936 != NULL) {
                macroValidPointer (operand_24936) ; 
                var_cas_property = GGS_mapIndexProperty::constructor_new (_inLexique, operand_24936->mMapTypeName, var_cas_mapAttributeName COMMA_HERE) ;
              }else{ // Else part
                var_cas_mapAttributeName.reader_location (_inLexique COMMA_HERE).signalGGSSemanticError (_inLexique, GGS_string (true, "this property should be a map") SOURCE_FILE_AT_LINE (654)) ;
                var_cas_property._drop_operation () ;
              }
            }
          }
          var_cas_currentConstraintPropertyMap.modifier_insertKey (_inLexique, var_cas_mapIndexName, var_cas_property SOURCE_FILE_AT_LINE (655)) ;
          var_cas_allConstraintPropertyMap.modifier_insertKey (_inLexique, var_cas_mapIndexName, var_cas_property SOURCE_FILE_AT_LINE (656)) ;
          var_cas_allAvailablePropertyMap.modifier_insertKey (_inLexique, var_cas_mapIndexName, var_cas_property SOURCE_FILE_AT_LINE (657)) ;
          _inLexique.acceptTerminal (ACCEPT_TERMINAL (galgas_scanner::galgas_scanner_1__3B) COMMA_HERE) ;
          } break ;
        default :
          syntaxRepeat = false ;
          break ;
      }
    }
  }
  _inLexique.acceptTerminal (ACCEPT_TERMINAL (galgas_scanner::galgas_scanner_1__7D) COMMA_HERE) ;
  _inLexique.acceptTerminal (ACCEPT_TERMINAL (galgas_scanner::galgas_scanner_1__7B) COMMA_HERE) ;
  GGS_typeVariablesMap  var_cas_variablesMap ;
  var_cas_variablesMap = GGS_typeVariablesMap::constructor_emptyMap (_inLexique COMMA_HERE) ;
  GGS_entityPropertyMap::element_type * operand_25577 = var_cas_allAvailablePropertyMap.firstObject () ;
  while ((operand_25577 != NULL)) {
    macroValidPointer (operand_25577) ;
    if (operand_25577->mInfo.mProperty._isBuilt ()) {
      cPtr_mapIndexProperty * operand_25661 = dynamic_cast <cPtr_mapIndexProperty *> (operand_25577->mInfo.mProperty.getPtr ()) ;
      if (operand_25661 != NULL) {
        macroValidPointer (operand_25661) ; 
        GGS_AC_galgasType  var_cas_t ;
        var_cas_t = GGS_typeGalgas_mapIndexInInstruction::constructor_new (_inLexique, operand_25661->mMapName.reader_string (_inLexique SOURCE_FILE_AT_LINE (667)) COMMA_HERE) ;
        GGS_typeCplusPlusName  var_cas_cppName ;
        var_cas_cppName = GGS_typeDirectName::constructor_new (_inLexique, operand_25577->mKey COMMA_HERE) ;
        var_cas_variablesMap.modifier_insertOutProperty (_inLexique, operand_25577->mKey, var_cas_t, var_cas_cppName SOURCE_FILE_AT_LINE (669)) ;
      }else{
        cPtr_metamodelAttributeProperty * operand_25973 = dynamic_cast <cPtr_metamodelAttributeProperty *> (operand_25577->mInfo.mProperty.getPtr ()) ;
        if (operand_25973 != NULL) {
          macroValidPointer (operand_25973) ; 
          GGS_typeCplusPlusName  var_cas_cppName ;
          var_cas_cppName = GGS_typeDirectName::constructor_new (_inLexique, operand_25577->mKey COMMA_HERE) ;
          var_cas_variablesMap.modifier_insertUsedConstInArgument (_inLexique, operand_25577->mKey, operand_25973->mAttributeType, var_cas_cppName SOURCE_FILE_AT_LINE (672)) ;
        }else{ // Else part
        }
      }
    }
    operand_25577 = operand_25577->nextObject () ;
  }
  GGS_entityPropertyMap::element_type * operand_26375 = var_cas_allConstraintPropertyMap.firstObject () ;
  while ((operand_26375 != NULL)) {
    macroValidPointer (operand_26375) ;
    if (operand_26375->mInfo.mProperty._isBuilt ()) {
      cPtr_metamodelSharedMapProperty * operand_26471 = dynamic_cast <cPtr_metamodelSharedMapProperty *> (operand_26375->mInfo.mProperty.getPtr ()) ;
      if (operand_26471 != NULL) {
        macroValidPointer (operand_26471) ; 
        GGS_string var_cas_overrideConstraint ;
        if ((var_cas_inOverriddenClassSet.reader_hasKey (_inLexique, operand_26471->mMapElementName.reader_string (_inLexique SOURCE_FILE_AT_LINE (683)) SOURCE_FILE_AT_LINE (683))).isBuiltAndTrue ()) {
          var_cas_overrideConstraint = var_cas_inConstraintName.reader_string (_inLexique SOURCE_FILE_AT_LINE (684)) ;
        }else{
          var_cas_overrideConstraint = GGS_string (true, "") ;
        }
        GGS_AC_galgasType  var_cas_t ;
        var_cas_t = GGS_typeGalgas_mapEntityInInstruction::constructor_new (_inLexique, operand_26471->mMapTypeName.reader_string (_inLexique SOURCE_FILE_AT_LINE (688)), operand_26471->mMapElementName.reader_string (_inLexique SOURCE_FILE_AT_LINE (688)), var_cas_overrideConstraint COMMA_HERE) ;
        GGS_typeCplusPlusName  var_cas_cppName ;
        var_cas_cppName = GGS_typeDirectName::constructor_new (_inLexique, GGS_lstring::constructor_new (_inLexique, ((((GGS_string (true, "(* ")) + (operand_26375->mKey.reader_string (_inLexique SOURCE_FILE_AT_LINE (689))))) + (GGS_string (true, ")"))), GGS_location (_inLexique) COMMA_HERE) COMMA_HERE) ;
        var_cas_variablesMap.modifier_insertUsedInOutArgument (_inLexique, operand_26375->mKey, var_cas_t, var_cas_cppName SOURCE_FILE_AT_LINE (690)) ;
      }else{ // Else part
      }
    }
    operand_26375 = operand_26375->nextObject () ;
  }
  GGS_typeCplusPlusName  var_cas_cppName ;
  var_cas_cppName = GGS_typeDirectName::constructor_new (_inLexique, GGS_lstring::constructor_new (_inLexique, GGS_string (true, "this"), GGS_location (_inLexique) COMMA_HERE) COMMA_HERE) ;
  GGS_AC_galgasType  var_cas_t ;
  var_cas_t = GGS_typeGalgas_entityInInstruction::constructor_new (_inLexique, var_cas_entityName.reader_string (_inLexique SOURCE_FILE_AT_LINE (696)), var_cas_inConstraintName.reader_string (_inLexique SOURCE_FILE_AT_LINE (696)) COMMA_HERE) ;
  var_cas_variablesMap.modifier_insertUsedConstInArgument (_inLexique, GGS_lstring::constructor_new (_inLexique, GGS_string (true, "self"), GGS_location (_inLexique) COMMA_HERE), var_cas_t, var_cas_cppName SOURCE_FILE_AT_LINE (697)) ;
  GGS_M_semanticsEntitiesForUse  var_cas_componentSemanticsEntitiesMap ;
  var_cas_componentSemanticsEntitiesMap = GGS_M_semanticsEntitiesForUse::constructor_emptyMap (_inLexique COMMA_HERE) ;
  GGS_M_optionComponents  var_cas_optionsComponentsMapForUse ;
  var_cas_optionsComponentsMapForUse = GGS_M_optionComponents::constructor_emptyMap (_inLexique COMMA_HERE) ;
  GGS_typeInstructionList  var_cas_instructionsList ;
  var_cas_instructionsList = GGS_typeInstructionList::constructor_emptyList (_inLexique COMMA_HERE) ;
  GGS_stringset  var_cas_constraintPropertyDefinitionSet ;
  var_cas_constraintPropertyDefinitionSet = GGS_stringset::constructor_emptySet (_inLexique COMMA_HERE) ;
  GGS_callInstructionSharedPropertySignatureMap  var_cas_callInstructionSharedPropertySignatureMap ;
  var_cas_callInstructionSharedPropertySignatureMap = GGS_callInstructionSharedPropertySignatureMap::constructor_emptyMap (_inLexique COMMA_HERE) ;
  GGS_typeTableEnAvant  var_cas_tableEnAvant ;
  var_cas_tableEnAvant = GGS_typeTableEnAvant::constructor_emptyMap (_inLexique COMMA_HERE) ;
  nt_semantic_instructions_list_ (_inLexique, var_cas_tableEnAvant, var_cas_componentSemanticsEntitiesMap, var_cas_optionsComponentsMapForUse, var_cas_variablesMap, var_cas_instructionsList, var_cas_allAvailablePropertyMap, var_cas_constraintPropertyDefinitionSet, var_cas_callInstructionSharedPropertySignatureMap) ;
  _inLexique.acceptTerminal (ACCEPT_TERMINAL (galgas_scanner::galgas_scanner_1__7D) COMMA_HERE) ;
  var_cas_ioConstraintInstructionListMap.modifier_insertKey (_inLexique, var_cas_entityName, var_cas_instructionsList, var_cas_callInstructionSharedPropertySignatureMap, GGS_location (_inLexique) SOURCE_FILE_AT_LINE (716)) ;
  var_cas_ioConstrainedEntityMap.modifier_insertKey (_inLexique, var_cas_entityName, var_cas_allMetamodelPropertyMap, GGS_bool (true, false), var_cas_currentMetamodelPropertyMap, var_cas_superEntity, var_cas_currentConstraintPropertyMap, var_cas_superClassSet, var_cas_allConstraintPropertyMap, var_cas_allAvailablePropertyMap SOURCE_FILE_AT_LINE (723)) ;
}

//---------------------------------------------------------------------------*

void constraint_parser::
pr_constraints_on_entity_declaration_constraint_parser_541_6_parse (galgas_scanner & _inLexique) {
  _inLexique.acceptTerminal (ACCEPT_TERMINAL (galgas_scanner::galgas_scanner_1_class) COMMA_HERE) ;
  _inLexique.acceptTerminal (ACCEPT_TERMINAL (galgas_scanner::galgas_scanner_1_mda_5Ftype_5Fname) COMMA_HERE) ;
  switch (select_constraint_parser_2 (_inLexique)) {
    case 1 : {
      } break ;
    case 2 : {
      _inLexique.acceptTerminal (ACCEPT_TERMINAL (galgas_scanner::galgas_scanner_1__28) COMMA_HERE) ;
      { bool syntaxRepeat = true ;
        while (syntaxRepeat) {
            _inLexique.acceptTerminal (ACCEPT_TERMINAL (galgas_scanner::galgas_scanner_1_mda_5Ftype_5Fname) COMMA_HERE) ;
            _inLexique.acceptTerminal (ACCEPT_TERMINAL (galgas_scanner::galgas_scanner_1_identifier) COMMA_HERE) ;
          switch (select_repeat_constraint_parser_3 (_inLexique)) {
            case 2 : {
              _inLexique.acceptTerminal (ACCEPT_TERMINAL (galgas_scanner::galgas_scanner_1__2C) COMMA_HERE) ;
              } break ;
            default :
              syntaxRepeat = false ;
              break ;
          }
        }
      }
      _inLexique.acceptTerminal (ACCEPT_TERMINAL (galgas_scanner::galgas_scanner_1__29) COMMA_HERE) ;
      } break ;
    default :
      break ;
  }
  _inLexique.acceptTerminal (ACCEPT_TERMINAL (galgas_scanner::galgas_scanner_1__7B) COMMA_HERE) ;
  { bool syntaxRepeat = true ;
    while (syntaxRepeat) {
      switch (select_repeat_constraint_parser_4 (_inLexique)) {
        case 2 : {
          _inLexique.acceptTerminal (ACCEPT_TERMINAL (galgas_scanner::galgas_scanner_1_mda_5Ftype_5Fname) COMMA_HERE) ;
          _inLexique.acceptTerminal (ACCEPT_TERMINAL (galgas_scanner::galgas_scanner_1_identifier) COMMA_HERE) ;
          _inLexique.acceptTerminal (ACCEPT_TERMINAL (galgas_scanner::galgas_scanner_1__3B) COMMA_HERE) ;
          } break ;
        case 3 : {
          _inLexique.acceptTerminal (ACCEPT_TERMINAL (galgas_scanner::galgas_scanner_1_mapindex) COMMA_HERE) ;
          _inLexique.acceptTerminal (ACCEPT_TERMINAL (galgas_scanner::galgas_scanner_1_identifier) COMMA_HERE) ;
          _inLexique.acceptTerminal (ACCEPT_TERMINAL (galgas_scanner::galgas_scanner_1_on) COMMA_HERE) ;
          _inLexique.acceptTerminal (ACCEPT_TERMINAL (galgas_scanner::galgas_scanner_1_identifier) COMMA_HERE) ;
          _inLexique.acceptTerminal (ACCEPT_TERMINAL (galgas_scanner::galgas_scanner_1__3B) COMMA_HERE) ;
          } break ;
        default :
          syntaxRepeat = false ;
          break ;
      }
    }
  }
  _inLexique.acceptTerminal (ACCEPT_TERMINAL (galgas_scanner::galgas_scanner_1__7D) COMMA_HERE) ;
  _inLexique.acceptTerminal (ACCEPT_TERMINAL (galgas_scanner::galgas_scanner_1__7B) COMMA_HERE) ;
  nt_semantic_instructions_list_parse (_inLexique) ;
  _inLexique.acceptTerminal (ACCEPT_TERMINAL (galgas_scanner::galgas_scanner_1__7D) COMMA_HERE) ;
}

//---------------------------------------------------------------------------*
//                                                                           *
//           Implementation of routine "buildUsefullPropertyMap"             *
//                                                                           *
//---------------------------------------------------------------------------*

void routine_buildUsefullPropertyMap (C_Lexique & _inLexique,
                                const GGS_entityPropertyMap  & var_cas_inInputPropertyMap,
                                const GGS_stringset  & var_cas_inUsefullClassSet,
                                GGS_entityPropertyMap  & var_cas_outOutputPropertyMap COMMA_UNUSED_LOCATION_ARGS) {
  #ifdef DEBUG_TRACE_ENABLED
    printf ("ENTER routine_buildUsefullPropertyMap at %s:%d\n", __FILE__, __LINE__) ;
  #endif
  var_cas_outOutputPropertyMap = GGS_entityPropertyMap::constructor_emptyMap (_inLexique COMMA_HERE) ;
  GGS_entityPropertyMap::element_type * operand_28934 = var_cas_inInputPropertyMap.firstObject () ;
  while ((operand_28934 != NULL)) {
    macroValidPointer (operand_28934) ;
    if (operand_28934->mInfo.mProperty._isBuilt ()) {
      cPtr_metamodelSingleReferenceProperty * operand_29022 = dynamic_cast <cPtr_metamodelSingleReferenceProperty *> (operand_28934->mInfo.mProperty.getPtr ()) ;
      if (operand_29022 != NULL) {
        macroValidPointer (operand_29022) ; 
        if ((var_cas_inUsefullClassSet.reader_hasKey (_inLexique, operand_29022->mReferenceEntityName.reader_string (_inLexique SOURCE_FILE_AT_LINE (747)) SOURCE_FILE_AT_LINE (747))).isBuiltAndTrue ()) {
          var_cas_outOutputPropertyMap.modifier_insertKey (_inLexique, operand_28934->mKey, operand_28934->mInfo.mProperty SOURCE_FILE_AT_LINE (748)) ;
        }
      }else{
        cPtr_metamodelMultipleReferenceProperty * operand_29255 = dynamic_cast <cPtr_metamodelMultipleReferenceProperty *> (operand_28934->mInfo.mProperty.getPtr ()) ;
        if (operand_29255 != NULL) {
          macroValidPointer (operand_29255) ; 
          if ((var_cas_inUsefullClassSet.reader_hasKey (_inLexique, operand_29255->mReferenceEntityName.reader_string (_inLexique SOURCE_FILE_AT_LINE (751)) SOURCE_FILE_AT_LINE (751))).isBuiltAndTrue ()) {
            var_cas_outOutputPropertyMap.modifier_insertKey (_inLexique, operand_28934->mKey, operand_28934->mInfo.mProperty SOURCE_FILE_AT_LINE (752)) ;
          }
        }else{ // Else part
          var_cas_outOutputPropertyMap.modifier_insertKey (_inLexique, operand_28934->mKey, operand_28934->mInfo.mProperty SOURCE_FILE_AT_LINE (755)) ;
        }
      }
    }
    operand_28934 = operand_28934->nextObject () ;
  }
  #ifdef DEBUG_TRACE_ENABLED
    printf ("LEAVE routine_buildUsefullPropertyMap\n") ;
  #endif
}

//---------------------------------------------------------------------------*
//                                                                           *
//Implementation of production rule 'constraint_class_override_declarations' *
//                                                                           *
//---------------------------------------------------------------------------*

void constraint_parser::
constraint_parser::
pr_constraint_class_override_declarations_constraint_parser_762_6_ (galgas_scanner & _inLexique,
                                GGS_lstring  var_cas_inRootClass,
                                GGS_entityToImplementMap  var_cas_inOriginalMetamodelEntityMap,
                                GGS_entityToImplementMap  &var_cas_outMetamodelEntityMap,
                                GGS_stringset  &var_cas_outOverriddenClassSet) {
  var_cas_outOverriddenClassSet = GGS_stringset::constructor_emptySet (_inLexique COMMA_HERE) ;
  { bool syntaxRepeat = true ;
    while (syntaxRepeat) {
        _inLexique.acceptTerminal (ACCEPT_TERMINAL (galgas_scanner::galgas_scanner_1_override) COMMA_HERE) ;
        GGS_lstring  var_cas_metamodelClass ;
        _inLexique._assignFromAttribute_tokenString (var_cas_metamodelClass) ;
        _inLexique.acceptTerminal (ACCEPT_TERMINAL (galgas_scanner::galgas_scanner_1_mda_5Ftype_5Fname) COMMA_HERE) ;
        GGS_entityPropertyMap  automatic_var_23 ;
        GGS_bool automatic_var_24 ;
        GGS_entityPropertyMap  automatic_var_25 ;
        GGS_lstring  automatic_var_26 ;
        GGS_entityPropertyMap  automatic_var_27 ;
        GGS_stringset  automatic_var_28 ;
        GGS_entityPropertyMap  automatic_var_29 ;
        GGS_entityPropertyMap  automatic_var_30 ;
        if (var_cas_inOriginalMetamodelEntityMap._isBuilt ()) {
          var_cas_inOriginalMetamodelEntityMap (HERE)->method_searchKey (_inLexique, var_cas_metamodelClass, automatic_var_23, automatic_var_24, automatic_var_25, automatic_var_26, automatic_var_27, automatic_var_28, automatic_var_29, automatic_var_30 SOURCE_FILE_AT_LINE (774)) ;
        }
        if ((var_cas_outOverriddenClassSet.reader_hasKey (_inLexique, var_cas_metamodelClass.reader_string (_inLexique SOURCE_FILE_AT_LINE (775)) SOURCE_FILE_AT_LINE (775))).isBuiltAndTrue ()) {
          var_cas_metamodelClass.reader_location (_inLexique COMMA_HERE).signalGGSSemanticError (_inLexique, GGS_string (true, "this class is already declared as overridden") SOURCE_FILE_AT_LINE (777)) ;
        }else{
          var_cas_outOverriddenClassSet._addAssign_operation (var_cas_metamodelClass.reader_string (_inLexique SOURCE_FILE_AT_LINE (778))) ;
        }
        _inLexique.acceptTerminal (ACCEPT_TERMINAL (galgas_scanner::galgas_scanner_1__3B) COMMA_HERE) ;
      switch (select_repeat_constraint_parser_5 (_inLexique)) {
        case 2 : {
          } break ;
        default :
          syntaxRepeat = false ;
          break ;
      }
    }
  }
  if (((! (var_cas_outOverriddenClassSet.reader_hasKey (_inLexique, var_cas_inRootClass.reader_string (_inLexique SOURCE_FILE_AT_LINE (784)) SOURCE_FILE_AT_LINE (784))))).isBuiltAndTrue ()) {
    GGS_location (_inLexique).reader_location (_inLexique COMMA_HERE).signalGGSSemanticError (_inLexique, ((((GGS_string (true, "the '%")) + (var_cas_inRootClass.reader_string (_inLexique SOURCE_FILE_AT_LINE (785))))) + (GGS_string (true, "' root class should be declared as overridden"))) SOURCE_FILE_AT_LINE (786)) ;
  }
  GGS_stringset  var_cas_usefulClassSet ;
  var_cas_usefulClassSet = GGS_stringset::constructor_setWithString (_inLexique, var_cas_inRootClass.reader_string (_inLexique SOURCE_FILE_AT_LINE (788)) COMMA_HERE) ;
  GGS_bool var_cas_continue ;
  var_cas_continue = GGS_bool (true, true) ;
  GGS_uint _variant_32701 = var_cas_inOriginalMetamodelEntityMap.reader_count (_inLexique SOURCE_FILE_AT_LINE (790))._add_operation (_inLexique, GGS_uint (true, 1U) SOURCE_FILE_AT_LINE (790)) ;
  GGS_bool _condition_32701 (_variant_32701._isBuilt (), true) ;
  while (_condition_32701.isBuiltAndTrue ()) {
    _condition_32701 = var_cas_continue ;
    if (_condition_32701.isBuiltAndTrue ()) {
      if (_variant_32701.uintValue () == 0) {
        _inLexique.onTheFlyRunTimeError ("loop variant error" SOURCE_FILE_AT_LINE (835)) ;
        _condition_32701 = GGS_bool (true, false) ;
      }else{
        _variant_32701._decrement_operation (_inLexique COMMA_HERE) ;
        var_cas_continue = GGS_bool (true, false) ;
        GGS_stringset::element_type * operand_30899 = var_cas_outOverriddenClassSet.firstObject () ;
        while ((operand_30899 != NULL)) {
          macroValidPointer (operand_30899) ;
          GGS_entityPropertyMap  var_cas_allAvailablePropertyMap ;
          GGS_lstring  var_cas_superEntityName ;
          GGS_entityPropertyMap  automatic_var_31 ;
          GGS_bool automatic_var_32 ;
          GGS_entityPropertyMap  automatic_var_33 ;
          GGS_entityPropertyMap  automatic_var_34 ;
          GGS_stringset  automatic_var_35 ;
          GGS_entityPropertyMap  automatic_var_36 ;
          if (var_cas_inOriginalMetamodelEntityMap._isBuilt ()) {
            var_cas_inOriginalMetamodelEntityMap (HERE)->method_searchKey (_inLexique, GGS_lstring::constructor_new (_inLexique, operand_30899->mKey, GGS_location (_inLexique) COMMA_HERE), automatic_var_31, automatic_var_32, automatic_var_33, var_cas_superEntityName, automatic_var_34, automatic_var_35, automatic_var_36, var_cas_allAvailablePropertyMap SOURCE_FILE_AT_LINE (796)) ;
          }
          if ((((var_cas_usefulClassSet.reader_hasKey (_inLexique, var_cas_superEntityName.reader_string (_inLexique SOURCE_FILE_AT_LINE (808)) SOURCE_FILE_AT_LINE (808))) & ((! (var_cas_usefulClassSet.reader_hasKey (_inLexique, operand_30899->mKey SOURCE_FILE_AT_LINE (808))))))).isBuiltAndTrue ()) {
            var_cas_continue = GGS_bool (true, true) ;
            var_cas_usefulClassSet._addAssign_operation (operand_30899->mKey) ;
          }
          if ((var_cas_usefulClassSet.reader_hasKey (_inLexique, operand_30899->mKey SOURCE_FILE_AT_LINE (812))).isBuiltAndTrue ()) {
            if (((((var_cas_superEntityName.reader_string (_inLexique SOURCE_FILE_AT_LINE (814))) != (GGS_string (true, ""))) & ((! (var_cas_usefulClassSet.reader_hasKey (_inLexique, var_cas_superEntityName.reader_string (_inLexique SOURCE_FILE_AT_LINE (814)) SOURCE_FILE_AT_LINE (814))))))).isBuiltAndTrue ()) {
              var_cas_continue = GGS_bool (true, true) ;
              var_cas_usefulClassSet._addAssign_operation (var_cas_superEntityName.reader_string (_inLexique SOURCE_FILE_AT_LINE (816))) ;
            }
            GGS_entityPropertyMap::element_type * operand_31855 = var_cas_allAvailablePropertyMap.firstObject () ;
            while ((operand_31855 != NULL)) {
              macroValidPointer (operand_31855) ;
              if (operand_31855->mInfo.mProperty._isBuilt ()) {
                cPtr_metamodelSingleReferenceProperty * operand_31934 = dynamic_cast <cPtr_metamodelSingleReferenceProperty *> (operand_31855->mInfo.mProperty.getPtr ()) ;
                if (operand_31934 != NULL) {
                  macroValidPointer (operand_31934) ; 
                  if ((((var_cas_outOverriddenClassSet.reader_hasKey (_inLexique, operand_31934->mReferenceEntityName.reader_string (_inLexique SOURCE_FILE_AT_LINE (821)) SOURCE_FILE_AT_LINE (821))) & ((! (var_cas_usefulClassSet.reader_hasKey (_inLexique, operand_31934->mReferenceEntityName.reader_string (_inLexique SOURCE_FILE_AT_LINE (821)) SOURCE_FILE_AT_LINE (821))))))).isBuiltAndTrue ()) {
                    var_cas_continue = GGS_bool (true, true) ;
                    var_cas_usefulClassSet._addAssign_operation (operand_31934->mReferenceEntityName.reader_string (_inLexique SOURCE_FILE_AT_LINE (823))) ;
                  }
                }else{
                  cPtr_metamodelMultipleReferenceProperty * operand_32275 = dynamic_cast <cPtr_metamodelMultipleReferenceProperty *> (operand_31855->mInfo.mProperty.getPtr ()) ;
                  if (operand_32275 != NULL) {
                    macroValidPointer (operand_32275) ; 
                    if ((((var_cas_outOverriddenClassSet.reader_hasKey (_inLexique, operand_32275->mReferenceEntityName.reader_string (_inLexique SOURCE_FILE_AT_LINE (826)) SOURCE_FILE_AT_LINE (826))) & ((! (var_cas_usefulClassSet.reader_hasKey (_inLexique, operand_32275->mReferenceEntityName.reader_string (_inLexique SOURCE_FILE_AT_LINE (826)) SOURCE_FILE_AT_LINE (826))))))).isBuiltAndTrue ()) {
                      var_cas_continue = GGS_bool (true, true) ;
                      var_cas_usefulClassSet._addAssign_operation (operand_32275->mReferenceEntityName.reader_string (_inLexique SOURCE_FILE_AT_LINE (828))) ;
                    }
                  }else{ // Else part
                  }
                }
              }
              operand_31855 = operand_31855->nextObject () ;
            }
          }
          operand_30899 = operand_30899->nextObject () ;
        }
      }
    }
  }
  GGS_stringset  var_cas_missingClasses ;
  var_cas_missingClasses = var_cas_usefulClassSet._substract_operation (_inLexique, var_cas_outOverriddenClassSet SOURCE_FILE_AT_LINE (838)) ;
  GGS_stringset::element_type * operand_32866 = var_cas_missingClasses.firstObject () ;
  while ((operand_32866 != NULL)) {
    macroValidPointer (operand_32866) ;
    GGS_location (_inLexique).reader_location (_inLexique COMMA_HERE).signalGGSSemanticError (_inLexique, ((((GGS_string (true, "the '%")) + (operand_32866->mKey))) + (GGS_string (true, "' class should be overriden"))) SOURCE_FILE_AT_LINE (841)) ;
    operand_32866 = operand_32866->nextObject () ;
  }
  GGS_stringset  var_cas_uselessClasses ;
  var_cas_uselessClasses = var_cas_outOverriddenClassSet._substract_operation (_inLexique, var_cas_usefulClassSet SOURCE_FILE_AT_LINE (843)) ;
  GGS_stringset::element_type * operand_33118 = var_cas_uselessClasses.firstObject () ;
  while ((operand_33118 != NULL)) {
    macroValidPointer (operand_33118) ;
    GGS_location (_inLexique).reader_location (_inLexique COMMA_HERE).signalGGSSemanticError (_inLexique, ((((GGS_string (true, "it is useless to override '%")) + (operand_33118->mKey))) + (GGS_string (true, "' class"))) SOURCE_FILE_AT_LINE (846)) ;
    operand_33118 = operand_33118->nextObject () ;
  }
  var_cas_outMetamodelEntityMap = GGS_entityToImplementMap::constructor_emptyMap (_inLexique COMMA_HERE) ;
  GGS_entityToImplementMap::element_type * operand_33413 = var_cas_inOriginalMetamodelEntityMap.firstObject () ;
  while ((operand_33413 != NULL)) {
    macroValidPointer (operand_33413) ;
    if ((var_cas_usefulClassSet.reader_hasKey (_inLexique, operand_33413->mKey.reader_string (_inLexique SOURCE_FILE_AT_LINE (860)) SOURCE_FILE_AT_LINE (860))).isBuiltAndTrue ()) {
      GGS_entityPropertyMap  var_cas_allMetamodelPropertyMap ;
      ::routine_buildUsefullPropertyMap (_inLexique,  operand_33413->mInfo.mAllMetamodelPropertyMap,  var_cas_usefulClassSet,  var_cas_allMetamodelPropertyMap SOURCE_FILE_AT_LINE (862)) ;
      GGS_entityPropertyMap  var_cas_currentMetamodelPropertyMap ;
      ::routine_buildUsefullPropertyMap (_inLexique,  operand_33413->mInfo.mCurrentMetamodelPropertyMap,  var_cas_usefulClassSet,  var_cas_currentMetamodelPropertyMap SOURCE_FILE_AT_LINE (864)) ;
      GGS_entityPropertyMap  var_cas_currentConstraintPropertyMap ;
      ::routine_buildUsefullPropertyMap (_inLexique,  operand_33413->mInfo.mCurrentConstraintPropertyMap,  var_cas_usefulClassSet,  var_cas_currentConstraintPropertyMap SOURCE_FILE_AT_LINE (866)) ;
      GGS_entityPropertyMap  var_cas_allConstraintPropertyMap ;
      ::routine_buildUsefullPropertyMap (_inLexique,  operand_33413->mInfo.mAllConstraintPropertyMap,  var_cas_usefulClassSet,  var_cas_allConstraintPropertyMap SOURCE_FILE_AT_LINE (868)) ;
      GGS_entityPropertyMap  var_cas_allAvailablePropertyMap ;
      ::routine_buildUsefullPropertyMap (_inLexique,  operand_33413->mInfo.mAllAvailablePropertyMap,  var_cas_usefulClassSet,  var_cas_allAvailablePropertyMap SOURCE_FILE_AT_LINE (870)) ;
      var_cas_outMetamodelEntityMap.modifier_insertKey (_inLexique, operand_33413->mKey, var_cas_allMetamodelPropertyMap, operand_33413->mInfo.mIsAbstract, var_cas_currentMetamodelPropertyMap, operand_33413->mInfo.mSuperEntityName, var_cas_currentConstraintPropertyMap, operand_33413->mInfo.mSuperEntitySet, var_cas_allConstraintPropertyMap, var_cas_allAvailablePropertyMap SOURCE_FILE_AT_LINE (871)) ;
    }
    operand_33413 = operand_33413->nextObject () ;
  }
}

//---------------------------------------------------------------------------*

void constraint_parser::
pr_constraint_class_override_declarations_constraint_parser_762_6_parse (galgas_scanner & _inLexique) {
  { bool syntaxRepeat = true ;
    while (syntaxRepeat) {
        _inLexique.acceptTerminal (ACCEPT_TERMINAL (galgas_scanner::galgas_scanner_1_override) COMMA_HERE) ;
        _inLexique.acceptTerminal (ACCEPT_TERMINAL (galgas_scanner::galgas_scanner_1_mda_5Ftype_5Fname) COMMA_HERE) ;
        _inLexique.acceptTerminal (ACCEPT_TERMINAL (galgas_scanner::galgas_scanner_1__3B) COMMA_HERE) ;
      switch (select_repeat_constraint_parser_5 (_inLexique)) {
        case 2 : {
          } break ;
        default :
          syntaxRepeat = false ;
          break ;
      }
    }
  }
}

//---------------------------------------------------------------------------*

