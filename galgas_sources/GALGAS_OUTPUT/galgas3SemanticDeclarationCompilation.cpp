//---------------------------------------------------------------------------------------------------------------------*
//                                                                                                                     *
//                                  File 'galgas3SemanticDeclarationCompilation.cpp'                                   *
//                                             Generated by version 3.0.0                                              *
//                                          october 5th, 2014, at 19h56'28"                                            *
//                                                                                                                     *
//---------------------------------------------------------------------------------------------------------------------*

//--- START OF USER ZONE 1


//--- END OF USER ZONE 1

#include "galgas2/C_Compiler.h"
#include "galgas2/C_galgas_io.h"
#include "galgas2/C_galgas_CLI_Options.h"
#include "utilities/C_PrologueEpilogue.h"

//---------------------------------------------------------------------------------------------------------------------*

#include "templateGrammar.h"
#include "lexiqueLL1grammar.h"
#include "galgas_cli_options.h"
#include "grammarLL1grammar.h"
#include "syntaxSLRgrammar.h"
#include "optionLL1grammar.h"
#include "semanticsSLRgrammar.h"
#include "galgas3SemanticDeclarationCompilation.h"


//---------------------------------------------------------------------------------------------------------------------*
//                                                                                                                     *
//                                    Routine 'compileSemanticDeclarationsGalgas3'                                     *
//                                                                                                                     *
//---------------------------------------------------------------------------------------------------------------------*

void routine_compileSemanticDeclarationsGalgas_33_ (const GALGAS_string constinArgument_inProductDirectory,
                                                    const GALGAS_location constinArgument_inEndOfProjectSourceFile,
                                                    const GALGAS_semanticDeclarationListAST constinArgument_inSemanticDeclarationList,
                                                    GALGAS_semanticContext & outArgument_outSemanticContext,
                                                    GALGAS_semanticDeclarationSortedListForGeneration & outArgument_outSemanticDeclarationSortedListForGeneration,
                                                    C_Compiler * inCompiler
                                                    COMMA_UNUSED_LOCATION_ARGS) {
  outArgument_outSemanticContext.drop () ; // Release 'out' argument
  outArgument_outSemanticDeclarationSortedListForGeneration.drop () ; // Release 'out' argument
  inCompiler->printMessage (GALGAS_string ("*** Building context\n")  COMMA_SOURCE_FILE ("galgas3SemanticDeclarationCompilation.gSemantics", 34)) ;
  GALGAS_semanticDeclarationListAST var_semanticDeclarationListWithPredefinedTypes = constinArgument_inSemanticDeclarationList ;
  {
  routine_appendPredefinedTypesASTs (var_semanticDeclarationListWithPredefinedTypes, inCompiler  COMMA_SOURCE_FILE ("galgas3SemanticDeclarationCompilation.gSemantics", 37)) ;
  }
  GALGAS_commandLineOptionListAST var_options = GALGAS_commandLineOptionListAST::constructor_emptyList (SOURCE_FILE ("galgas3SemanticDeclarationCompilation.gSemantics", 39)) ;
  cEnumerator__32_stringlist enumerator_2284 (GALGAS_application::constructor_boolOptionNameList (SOURCE_FILE ("galgas3SemanticDeclarationCompilation.gSemantics", 40)), kEnumeration_up) ;
  while (enumerator_2284.hasCurrentObject ()) {
    var_options.addAssign_operation (GALGAS_string ("bool").reader_nowhere (SOURCE_FILE ("galgas3SemanticDeclarationCompilation.gSemantics", 42)), GALGAS_lstring::constructor_new (enumerator_2284.current_mValue_31_ (HERE), inCompiler->here ()  COMMA_SOURCE_FILE ("galgas3SemanticDeclarationCompilation.gSemantics", 43)), GALGAS_lchar::constructor_new (GALGAS_application::constructor_boolOptionInvocationLetter (enumerator_2284.current_mValue_30_ (HERE), enumerator_2284.current_mValue_31_ (HERE)  COMMA_SOURCE_FILE ("galgas3SemanticDeclarationCompilation.gSemantics", 44)), GALGAS_location::constructor_nowhere (SOURCE_FILE ("galgas3SemanticDeclarationCompilation.gSemantics", 44))  COMMA_SOURCE_FILE ("galgas3SemanticDeclarationCompilation.gSemantics", 44)), GALGAS_application::constructor_boolOptionInvocationString (enumerator_2284.current_mValue_30_ (HERE), enumerator_2284.current_mValue_31_ (HERE)  COMMA_SOURCE_FILE ("galgas3SemanticDeclarationCompilation.gSemantics", 45)).reader_nowhere (SOURCE_FILE ("galgas3SemanticDeclarationCompilation.gSemantics", 45)), GALGAS_application::constructor_boolOptionCommentString (enumerator_2284.current_mValue_30_ (HERE), enumerator_2284.current_mValue_31_ (HERE)  COMMA_SOURCE_FILE ("galgas3SemanticDeclarationCompilation.gSemantics", 46)).reader_nowhere (SOURCE_FILE ("galgas3SemanticDeclarationCompilation.gSemantics", 46)), GALGAS_string::makeEmptyString ().reader_nowhere (SOURCE_FILE ("galgas3SemanticDeclarationCompilation.gSemantics", 47)), GALGAS_optionDefaultValueEnumAST::constructor_noDefaultValue (SOURCE_FILE ("galgas3SemanticDeclarationCompilation.gSemantics", 48))  COMMA_SOURCE_FILE ("galgas3SemanticDeclarationCompilation.gSemantics", 41)) ;
    enumerator_2284.gotoNextObject () ;
  }
  cEnumerator__32_stringlist enumerator_2753 (GALGAS_application::constructor_uintOptionNameList (SOURCE_FILE ("galgas3SemanticDeclarationCompilation.gSemantics", 51)), kEnumeration_up) ;
  while (enumerator_2753.hasCurrentObject ()) {
    var_options.addAssign_operation (GALGAS_string ("uint").reader_nowhere (SOURCE_FILE ("galgas3SemanticDeclarationCompilation.gSemantics", 53)), GALGAS_lstring::constructor_new (enumerator_2753.current_mValue_31_ (HERE), inCompiler->here ()  COMMA_SOURCE_FILE ("galgas3SemanticDeclarationCompilation.gSemantics", 54)), GALGAS_lchar::constructor_new (GALGAS_application::constructor_boolOptionInvocationLetter (enumerator_2753.current_mValue_30_ (HERE), enumerator_2753.current_mValue_31_ (HERE)  COMMA_SOURCE_FILE ("galgas3SemanticDeclarationCompilation.gSemantics", 55)), GALGAS_location::constructor_nowhere (SOURCE_FILE ("galgas3SemanticDeclarationCompilation.gSemantics", 55))  COMMA_SOURCE_FILE ("galgas3SemanticDeclarationCompilation.gSemantics", 55)), GALGAS_application::constructor_boolOptionInvocationString (enumerator_2753.current_mValue_30_ (HERE), enumerator_2753.current_mValue_31_ (HERE)  COMMA_SOURCE_FILE ("galgas3SemanticDeclarationCompilation.gSemantics", 56)).reader_nowhere (SOURCE_FILE ("galgas3SemanticDeclarationCompilation.gSemantics", 56)), GALGAS_application::constructor_boolOptionCommentString (enumerator_2753.current_mValue_30_ (HERE), enumerator_2753.current_mValue_31_ (HERE)  COMMA_SOURCE_FILE ("galgas3SemanticDeclarationCompilation.gSemantics", 57)).reader_nowhere (SOURCE_FILE ("galgas3SemanticDeclarationCompilation.gSemantics", 57)), GALGAS_string::makeEmptyString ().reader_nowhere (SOURCE_FILE ("galgas3SemanticDeclarationCompilation.gSemantics", 58)), GALGAS_optionDefaultValueEnumAST::constructor_noDefaultValue (SOURCE_FILE ("galgas3SemanticDeclarationCompilation.gSemantics", 59))  COMMA_SOURCE_FILE ("galgas3SemanticDeclarationCompilation.gSemantics", 52)) ;
    enumerator_2753.gotoNextObject () ;
  }
  cEnumerator__32_stringlist enumerator_3224 (GALGAS_application::constructor_stringOptionNameList (SOURCE_FILE ("galgas3SemanticDeclarationCompilation.gSemantics", 62)), kEnumeration_up) ;
  while (enumerator_3224.hasCurrentObject ()) {
    var_options.addAssign_operation (GALGAS_string ("string").reader_nowhere (SOURCE_FILE ("galgas3SemanticDeclarationCompilation.gSemantics", 64)), GALGAS_lstring::constructor_new (enumerator_3224.current_mValue_31_ (HERE), inCompiler->here ()  COMMA_SOURCE_FILE ("galgas3SemanticDeclarationCompilation.gSemantics", 65)), GALGAS_lchar::constructor_new (GALGAS_application::constructor_boolOptionInvocationLetter (enumerator_3224.current_mValue_30_ (HERE), enumerator_3224.current_mValue_31_ (HERE)  COMMA_SOURCE_FILE ("galgas3SemanticDeclarationCompilation.gSemantics", 66)), GALGAS_location::constructor_nowhere (SOURCE_FILE ("galgas3SemanticDeclarationCompilation.gSemantics", 66))  COMMA_SOURCE_FILE ("galgas3SemanticDeclarationCompilation.gSemantics", 66)), GALGAS_application::constructor_boolOptionInvocationString (enumerator_3224.current_mValue_30_ (HERE), enumerator_3224.current_mValue_31_ (HERE)  COMMA_SOURCE_FILE ("galgas3SemanticDeclarationCompilation.gSemantics", 67)).reader_nowhere (SOURCE_FILE ("galgas3SemanticDeclarationCompilation.gSemantics", 67)), GALGAS_application::constructor_boolOptionCommentString (enumerator_3224.current_mValue_30_ (HERE), enumerator_3224.current_mValue_31_ (HERE)  COMMA_SOURCE_FILE ("galgas3SemanticDeclarationCompilation.gSemantics", 68)).reader_nowhere (SOURCE_FILE ("galgas3SemanticDeclarationCompilation.gSemantics", 68)), GALGAS_string::makeEmptyString ().reader_nowhere (SOURCE_FILE ("galgas3SemanticDeclarationCompilation.gSemantics", 69)), GALGAS_optionDefaultValueEnumAST::constructor_noDefaultValue (SOURCE_FILE ("galgas3SemanticDeclarationCompilation.gSemantics", 70))  COMMA_SOURCE_FILE ("galgas3SemanticDeclarationCompilation.gSemantics", 63)) ;
    enumerator_3224.gotoNextObject () ;
  }
  var_semanticDeclarationListWithPredefinedTypes.addAssign_operation (GALGAS_optionComponentDeclarationAST::constructor_new (GALGAS_bool (true), GALGAS_string ("galgas_builtin_options").reader_nowhere (SOURCE_FILE ("galgas3SemanticDeclarationCompilation.gSemantics", 75)), var_options  COMMA_SOURCE_FILE ("galgas3SemanticDeclarationCompilation.gSemantics", 73))  COMMA_SOURCE_FILE ("galgas3SemanticDeclarationCompilation.gSemantics", 73)) ;
  GALGAS_semanticDeclarationListAST var_sortedSemanticDeclarationListAST ;
  {
  routine_buildGalgas_33_SemanticContext (var_semanticDeclarationListWithPredefinedTypes, constinArgument_inEndOfProjectSourceFile, outArgument_outSemanticContext, var_sortedSemanticDeclarationListAST, inCompiler  COMMA_SOURCE_FILE ("galgas3SemanticDeclarationCompilation.gSemantics", 79)) ;
  }
  const enumGalgasBool test_0 = GALGAS_bool (gOption_galgas_5F_builtin_5F_options_verbose_5F_output.reader_value ()).boolEnum () ;
  if (kBoolTrue == test_0) {
    inCompiler->printMessage (GALGAS_string ("*** Semantic analysis\n")  COMMA_SOURCE_FILE ("galgas3SemanticDeclarationCompilation.gSemantics", 87)) ;
  }
  cEnumerator_lstringlist enumerator_4253 (outArgument_outSemanticContext.mAttribute_mTypeMap.reader_unsolvedProxyList (SOURCE_FILE ("galgas3SemanticDeclarationCompilation.gSemantics", 90)), kEnumeration_up) ;
  while (enumerator_4253.hasCurrentObject ()) {
    GALGAS_location location_1 (enumerator_4253.current_mValue (HERE).reader_location (HERE)) ; // Implicit use of 'location' reader
    inCompiler->emitSemanticError (location_1, GALGAS_string ("the '").operator_concat (enumerator_4253.current_mValue (HERE).reader_string (SOURCE_FILE ("galgas3SemanticDeclarationCompilation.gSemantics", 91))  COMMA_SOURCE_FILE ("galgas3SemanticDeclarationCompilation.gSemantics", 91)).operator_concat (GALGAS_string ("' type is undefined")  COMMA_SOURCE_FILE ("galgas3SemanticDeclarationCompilation.gSemantics", 91))  COMMA_SOURCE_FILE ("galgas3SemanticDeclarationCompilation.gSemantics", 91)) ;
    enumerator_4253.gotoNextObject () ;
  }
  outArgument_outSemanticDeclarationSortedListForGeneration = GALGAS_semanticDeclarationSortedListForGeneration::constructor_emptySortedList (SOURCE_FILE ("galgas3SemanticDeclarationCompilation.gSemantics", 94)) ;
  const enumGalgasBool test_2 = GALGAS_bool (kIsEqual, GALGAS_uint::constructor_errorCount (SOURCE_FILE ("galgas3SemanticDeclarationCompilation.gSemantics", 95)).objectCompare (GALGAS_uint ((uint32_t) 0U))).boolEnum () ;
  if (kBoolTrue == test_2) {
    GALGAS_predefinedTypes var_predefinedTypes = function_buildPredefinedTypes (outArgument_outSemanticContext, inCompiler COMMA_SOURCE_FILE ("galgas3SemanticDeclarationCompilation.gSemantics", 96)) ;
    cEnumerator_semanticDeclarationListAST enumerator_4645 (var_sortedSemanticDeclarationListAST, kEnumeration_up) ;
    while (enumerator_4645.hasCurrentObject ()) {
      callCategoryMethod_semanticAnalysis ((const cPtr_semanticDeclarationAST *) enumerator_4645.current_mSemanticDeclaration (HERE).ptr (), constinArgument_inProductDirectory, outArgument_outSemanticContext, var_predefinedTypes, outArgument_outSemanticDeclarationSortedListForGeneration, inCompiler COMMA_SOURCE_FILE ("galgas3SemanticDeclarationCompilation.gSemantics", 98)) ;
      enumerator_4645.gotoNextObject () ;
    }
  }
}


//---------------------------------------------------------------------------------------------------------------------*
//                                                                                                                     *
//                                        Routine 'buildGalgas3SemanticContext'                                        *
//                                                                                                                     *
//---------------------------------------------------------------------------------------------------------------------*

void routine_buildGalgas_33_SemanticContext (const GALGAS_semanticDeclarationListAST constinArgument_inSemanticDeclarationList,
                                             const GALGAS_location constinArgument_inEndOfProjectSourceFile,
                                             GALGAS_semanticContext & outArgument_outSemanticContext,
                                             GALGAS_semanticDeclarationListAST & outArgument_outSortedSemanticDeclarationListAST,
                                             C_Compiler * inCompiler
                                             COMMA_UNUSED_LOCATION_ARGS) {
  outArgument_outSemanticContext.drop () ; // Release 'out' argument
  outArgument_outSortedSemanticDeclarationListAST.drop () ; // Release 'out' argument
  GALGAS_semanticDeclarationListAST var_semanticDeclarationList = constinArgument_inSemanticDeclarationList ;
  cEnumerator_semanticDeclarationListAST enumerator_6923 (constinArgument_inSemanticDeclarationList, kEnumeration_up) ;
  while (enumerator_6923.hasCurrentObject ()) {
    callCategoryMethod_addAssociatedElement ((const cPtr_semanticDeclarationAST *) enumerator_6923.current_mSemanticDeclaration (HERE).ptr (), var_semanticDeclarationList, inCompiler COMMA_SOURCE_FILE ("galgas3SemanticDeclarationCompilation.gSemantics", 159)) ;
    enumerator_6923.gotoNextObject () ;
  }
  GALGAS_semanticTypePrecedenceGraph var_semanticTypePrecedenceGraph = GALGAS_semanticTypePrecedenceGraph::constructor_emptyGraph (SOURCE_FILE ("galgas3SemanticDeclarationCompilation.gSemantics", 165)) ;
  GALGAS_categoryMethodMapForBuildingContext var_categoryMethodMapForBuildingContext = GALGAS_categoryMethodMapForBuildingContext::constructor_emptyMap (SOURCE_FILE ("galgas3SemanticDeclarationCompilation.gSemantics", 166)) ;
  GALGAS_categoryReaderMapForBuildingContext var_categoryReaderMapForBuildingContext = GALGAS_categoryReaderMapForBuildingContext::constructor_emptyMap (SOURCE_FILE ("galgas3SemanticDeclarationCompilation.gSemantics", 167)) ;
  GALGAS_categoryModifierMapForBuildingContext var_categoryModifierMapForBuildingContext = GALGAS_categoryModifierMapForBuildingContext::constructor_emptyMap (SOURCE_FILE ("galgas3SemanticDeclarationCompilation.gSemantics", 168)) ;
  GALGAS_semanticDeclarationListAST var_categoryOverrideDefinitionList = GALGAS_semanticDeclarationListAST::constructor_emptyList (SOURCE_FILE ("galgas3SemanticDeclarationCompilation.gSemantics", 169)) ;
  cEnumerator_semanticDeclarationListAST enumerator_7656 (var_semanticDeclarationList, kEnumeration_up) ;
  while (enumerator_7656.hasCurrentObject ()) {
    callCategoryMethod_enterDeclarationInGraph ((const cPtr_semanticDeclarationAST *) enumerator_7656.current_mSemanticDeclaration (HERE).ptr (), var_semanticTypePrecedenceGraph, var_categoryMethodMapForBuildingContext, var_categoryReaderMapForBuildingContext, var_categoryModifierMapForBuildingContext, var_categoryOverrideDefinitionList, inCompiler COMMA_SOURCE_FILE ("galgas3SemanticDeclarationCompilation.gSemantics", 171)) ;
    enumerator_7656.gotoNextObject () ;
  }
  const enumGalgasBool test_0 = GALGAS_bool (kIsStrictSup, var_semanticTypePrecedenceGraph.reader_undefinedNodeCount (SOURCE_FILE ("galgas3SemanticDeclarationCompilation.gSemantics", 179)).objectCompare (GALGAS_uint ((uint32_t) 0U))).boolEnum () ;
  if (kBoolTrue == test_0) {
    cEnumerator_lstringlist enumerator_8076 (var_semanticTypePrecedenceGraph.reader_undefinedNodeReferenceList (SOURCE_FILE ("galgas3SemanticDeclarationCompilation.gSemantics", 180)), kEnumeration_up) ;
    while (enumerator_8076.hasCurrentObject ()) {
      GALGAS_location location_1 (enumerator_8076.current_mValue (HERE).reader_location (HERE)) ; // Implicit use of 'location' reader
      inCompiler->emitSemanticError (location_1, GALGAS_string ("the '").operator_concat (enumerator_8076.current_mValue (HERE).reader_string (SOURCE_FILE ("galgas3SemanticDeclarationCompilation.gSemantics", 181))  COMMA_SOURCE_FILE ("galgas3SemanticDeclarationCompilation.gSemantics", 181)).operator_concat (GALGAS_string ("' type is not defined")  COMMA_SOURCE_FILE ("galgas3SemanticDeclarationCompilation.gSemantics", 181))  COMMA_SOURCE_FILE ("galgas3SemanticDeclarationCompilation.gSemantics", 181)) ;
      enumerator_8076.gotoNextObject () ;
    }
    inCompiler->emitSemanticError (constinArgument_inEndOfProjectSourceFile, GALGAS_string ("semantic analysis not performed, due to undefined type error(s)")  COMMA_SOURCE_FILE ("galgas3SemanticDeclarationCompilation.gSemantics", 183)) ;
    outArgument_outSemanticContext.drop () ; // Release error dropped variable
    outArgument_outSortedSemanticDeclarationListAST.drop () ; // Release error dropped variable
  }else if (kBoolFalse == test_0) {
    GALGAS_semanticDeclarationListAST var_unsortedSemanticDeclarationListAST ;
    GALGAS_lstringlist var_unsortedNodeKeyList ;
    GALGAS_lstringlist joker_8433_0 ; // Joker input parameter
    var_semanticTypePrecedenceGraph.method_topologicalSort (outArgument_outSortedSemanticDeclarationListAST, joker_8433_0, var_unsortedSemanticDeclarationListAST, var_unsortedNodeKeyList, inCompiler COMMA_SOURCE_FILE ("galgas3SemanticDeclarationCompilation.gSemantics", 185)) ;
    const enumGalgasBool test_2 = GALGAS_bool (kIsStrictSup, var_unsortedSemanticDeclarationListAST.reader_length (SOURCE_FILE ("galgas3SemanticDeclarationCompilation.gSemantics", 191)).objectCompare (GALGAS_uint ((uint32_t) 0U))).boolEnum () ;
    if (kBoolTrue == test_2) {
      GALGAS_string var_s = GALGAS_string ("semantic analysis not performed, ").operator_concat (var_unsortedSemanticDeclarationListAST.reader_length (SOURCE_FILE ("galgas3SemanticDeclarationCompilation.gSemantics", 192)).reader_string (SOURCE_FILE ("galgas3SemanticDeclarationCompilation.gSemantics", 192))  COMMA_SOURCE_FILE ("galgas3SemanticDeclarationCompilation.gSemantics", 192)).operator_concat (GALGAS_string (" declarations are involved in circular definition:")  COMMA_SOURCE_FILE ("galgas3SemanticDeclarationCompilation.gSemantics", 192)) ;
      cEnumerator_semanticDeclarationListAST enumerator_8828 (var_unsortedSemanticDeclarationListAST, kEnumeration_up) ;
      while (enumerator_8828.hasCurrentObject ()) {
        var_s.dotAssign_operation (GALGAS_string ("\n"
          "-  ").operator_concat (callCategoryReader_keyRepresentation ((const cPtr_semanticDeclarationAST *) enumerator_8828.current_mSemanticDeclaration (HERE).ptr (), inCompiler COMMA_SOURCE_FILE ("galgas3SemanticDeclarationCompilation.gSemantics", 194))  COMMA_SOURCE_FILE ("galgas3SemanticDeclarationCompilation.gSemantics", 194))  COMMA_SOURCE_FILE ("galgas3SemanticDeclarationCompilation.gSemantics", 194)) ;
        enumerator_8828.gotoNextObject () ;
      }
      inCompiler->emitSemanticError (constinArgument_inEndOfProjectSourceFile, var_s  COMMA_SOURCE_FILE ("galgas3SemanticDeclarationCompilation.gSemantics", 196)) ;
      outArgument_outSemanticContext.drop () ; // Release error dropped variable
    }else if (kBoolFalse == test_2) {
      outArgument_outSortedSemanticDeclarationListAST.dotAssign_operation (var_categoryOverrideDefinitionList  COMMA_SOURCE_FILE ("galgas3SemanticDeclarationCompilation.gSemantics", 199)) ;
      outArgument_outSemanticContext = GALGAS_semanticContext::constructor_default (SOURCE_FILE ("galgas3SemanticDeclarationCompilation.gSemantics", 201)) ;
      cEnumerator_semanticDeclarationListAST enumerator_9286 (outArgument_outSortedSemanticDeclarationListAST, kEnumeration_up) ;
      while (enumerator_9286.hasCurrentObject ()) {
        callCategoryMethod_enterInSemanticContext ((const cPtr_semanticDeclarationAST *) enumerator_9286.current_mSemanticDeclaration (HERE).ptr (), var_categoryMethodMapForBuildingContext, var_categoryReaderMapForBuildingContext, var_categoryModifierMapForBuildingContext, outArgument_outSemanticContext, inCompiler COMMA_SOURCE_FILE ("galgas3SemanticDeclarationCompilation.gSemantics", 204)) ;
        enumerator_9286.gotoNextObject () ;
      }
    }
  }
}


//---------------------------------------------------------------------------------------------------------------------*
//                                                                                                                     *
//                                        Once function 'definitionGroupAmount'                                        *
//                                                                                                                     *
//---------------------------------------------------------------------------------------------------------------------*

static GALGAS_uint onceFunction_definitionGroupAmount (C_Compiler * /* inCompiler */
                                                       COMMA_UNUSED_LOCATION_ARGS) {
  GALGAS_uint result_outResult ; // Returned variable
  result_outResult = GALGAS_uint ((uint32_t) 100U) ;
//---
  return result_outResult ;
}



//---------------------------------------------------------------------------------------------------------------------*
//  Function implementation                                                                                            *
//---------------------------------------------------------------------------------------------------------------------*

static bool gOnceFunctionResultAvailable_definitionGroupAmount = false ;
static GALGAS_uint gOnceFunctionResult_definitionGroupAmount ;

//---------------------------------------------------------------------------------------------------------------------*

GALGAS_uint function_definitionGroupAmount (class C_Compiler * inCompiler
              COMMA_LOCATION_ARGS) {
  if (! gOnceFunctionResultAvailable_definitionGroupAmount) {
    gOnceFunctionResult_definitionGroupAmount = onceFunction_definitionGroupAmount (inCompiler COMMA_THERE) ;
    gOnceFunctionResultAvailable_definitionGroupAmount = true ;
  }
  return gOnceFunctionResult_definitionGroupAmount ;
}

//---------------------------------------------------------------------------------------------------------------------*

static void releaseOnceFunctionResult_definitionGroupAmount (void) {
  gOnceFunctionResult_definitionGroupAmount.drop () ;
}

//---------------------------------------------------------------------------------------------------------------------*

C_PrologueEpilogue gEpilogueForOnceFunction_definitionGroupAmount (NULL,
                                                                   releaseOnceFunctionResult_definitionGroupAmount) ;

//---------------------------------------------------------------------------------------------------------------------*
//  Function introspection                                                                                             *
//---------------------------------------------------------------------------------------------------------------------*

static const C_galgas_type_descriptor * functionArgs_definitionGroupAmount [1] = {
  NULL
} ;

//---------------------------------------------------------------------------------------------------------------------*

static GALGAS_object functionWithGenericHeader_definitionGroupAmount (C_Compiler * inCompiler,
                                                                      const cObjectArray & /* inEffectiveParameterArray */,
                                                                      const GALGAS_location & /* inErrorLocation */
                                                                      COMMA_LOCATION_ARGS) {
  return function_definitionGroupAmount (inCompiler COMMA_THERE).reader_object (THERE) ;
}

//---------------------------------------------------------------------------------------------------------------------*

C_galgas_function_descriptor functionDescriptor_definitionGroupAmount ("definitionGroupAmount",
                                                                       functionWithGenericHeader_definitionGroupAmount,
                                                                       & kTypeDescriptor_GALGAS_uint,
                                                                       0,
                                                                       functionArgs_definitionGroupAmount) ;

//---------------------------------------------------------------------------------------------------------------------*
//                                                                                                                     *
//                                    Routine 'generateSemanticDeclarationsGalgas3'                                    *
//                                                                                                                     *
//---------------------------------------------------------------------------------------------------------------------*

void routine_generateSemanticDeclarationsGalgas_33_ (const GALGAS_unifiedTypeMap constinArgument_inUnifiedTypeMap,
                                                     const GALGAS_string constinArgument_inProductDirectory,
                                                     const GALGAS_semanticDeclarationSortedListForGeneration constinArgument_inSemanticDeclarationSortedListForGeneration,
                                                     GALGAS_stringlist & ioArgument_ioToolProductFileList,
                                                     GALGAS_stringset & ioArgument_ioAllProductFileSet,
                                                     C_Compiler * inCompiler
                                                     COMMA_UNUSED_LOCATION_ARGS) {
  cEnumerator_semanticDeclarationSortedListForGeneration enumerator_10566 (constinArgument_inSemanticDeclarationSortedListForGeneration, kEnumeration_up) ;
  while (enumerator_10566.hasCurrentObject ()) {
    callCategoryMethod_appendSpecificFiles ((const cPtr_semanticDeclarationForGeneration *) enumerator_10566.current_mDeclaration (HERE).ptr (), constinArgument_inProductDirectory, ioArgument_ioAllProductFileSet, inCompiler COMMA_SOURCE_FILE ("galgas3SemanticDeclarationCompilation.gSemantics", 238)) ;
    enumerator_10566.gotoNextObject () ;
  }
  const enumGalgasBool test_0 = GALGAS_bool (kIsEqual, GALGAS_uint::constructor_errorCount (SOURCE_FILE ("galgas3SemanticDeclarationCompilation.gSemantics", 244)).objectCompare (GALGAS_uint ((uint32_t) 0U))).boolEnum () ;
  if (kBoolTrue == test_0) {
    const enumGalgasBool test_1 = GALGAS_bool (gOption_galgas_5F_cli_5F_options_generateOneHeader.reader_value ()).operator_and (GALGAS_bool (gOption_galgas_5F_cli_5F_options_generateManyFiles.reader_value ()) COMMA_SOURCE_FILE ("galgas3SemanticDeclarationCompilation.gSemantics", 245)).boolEnum () ;
    if (kBoolTrue == test_1) {
      {
      routine_generateOneBigHeader (constinArgument_inProductDirectory, constinArgument_inSemanticDeclarationSortedListForGeneration, ioArgument_ioAllProductFileSet, inCompiler  COMMA_SOURCE_FILE ("galgas3SemanticDeclarationCompilation.gSemantics", 246)) ;
      }
      {
      routine_generateManyImplementationFiles (constinArgument_inUnifiedTypeMap, constinArgument_inProductDirectory, constinArgument_inSemanticDeclarationSortedListForGeneration, ioArgument_ioToolProductFileList, ioArgument_ioAllProductFileSet, inCompiler  COMMA_SOURCE_FILE ("galgas3SemanticDeclarationCompilation.gSemantics", 251)) ;
      }
    }else if (kBoolFalse == test_1) {
      const enumGalgasBool test_2 = GALGAS_bool (gOption_galgas_5F_cli_5F_options_generateOneHeader.reader_value ()).operator_and (GALGAS_bool (gOption_galgas_5F_cli_5F_options_generateManyFiles.reader_value ()).operator_not (SOURCE_FILE ("galgas3SemanticDeclarationCompilation.gSemantics", 258)) COMMA_SOURCE_FILE ("galgas3SemanticDeclarationCompilation.gSemantics", 258)).boolEnum () ;
      if (kBoolTrue == test_2) {
        {
        routine_generateOneBigHeader (constinArgument_inProductDirectory, constinArgument_inSemanticDeclarationSortedListForGeneration, ioArgument_ioAllProductFileSet, inCompiler  COMMA_SOURCE_FILE ("galgas3SemanticDeclarationCompilation.gSemantics", 259)) ;
        }
        {
        routine_generateFewImplementationFiles (constinArgument_inUnifiedTypeMap, constinArgument_inProductDirectory, constinArgument_inSemanticDeclarationSortedListForGeneration, ioArgument_ioToolProductFileList, ioArgument_ioAllProductFileSet, inCompiler  COMMA_SOURCE_FILE ("galgas3SemanticDeclarationCompilation.gSemantics", 264)) ;
        }
      }else if (kBoolFalse == test_2) {
        const enumGalgasBool test_3 = GALGAS_bool (gOption_galgas_5F_cli_5F_options_generateOneHeader.reader_value ()).operator_not (SOURCE_FILE ("galgas3SemanticDeclarationCompilation.gSemantics", 271)).operator_and (GALGAS_bool (gOption_galgas_5F_cli_5F_options_generateManyFiles.reader_value ()) COMMA_SOURCE_FILE ("galgas3SemanticDeclarationCompilation.gSemantics", 271)).boolEnum () ;
        if (kBoolTrue == test_3) {
          {
          routine_generateManyHeaders (constinArgument_inProductDirectory, constinArgument_inSemanticDeclarationSortedListForGeneration, ioArgument_ioAllProductFileSet, inCompiler  COMMA_SOURCE_FILE ("galgas3SemanticDeclarationCompilation.gSemantics", 272)) ;
          }
          {
          routine_generateManyImplementationFiles (constinArgument_inUnifiedTypeMap, constinArgument_inProductDirectory, constinArgument_inSemanticDeclarationSortedListForGeneration, ioArgument_ioToolProductFileList, ioArgument_ioAllProductFileSet, inCompiler  COMMA_SOURCE_FILE ("galgas3SemanticDeclarationCompilation.gSemantics", 277)) ;
          }
        }else if (kBoolFalse == test_3) {
          const enumGalgasBool test_4 = function_generateFewHeaderFiles (inCompiler COMMA_SOURCE_FILE ("galgas3SemanticDeclarationCompilation.gSemantics", 284)).boolEnum () ;
          if (kBoolTrue == test_4) {
            {
            routine_generateFewImplementationFilesWithFewHeaders (constinArgument_inUnifiedTypeMap, constinArgument_inProductDirectory, constinArgument_inSemanticDeclarationSortedListForGeneration, ioArgument_ioToolProductFileList, ioArgument_ioAllProductFileSet, inCompiler  COMMA_SOURCE_FILE ("galgas3SemanticDeclarationCompilation.gSemantics", 285)) ;
            }
          }else if (kBoolFalse == test_4) {
            {
            routine_generateManyHeaders (constinArgument_inProductDirectory, constinArgument_inSemanticDeclarationSortedListForGeneration, ioArgument_ioAllProductFileSet, inCompiler  COMMA_SOURCE_FILE ("galgas3SemanticDeclarationCompilation.gSemantics", 293)) ;
            }
            {
            routine_generateManyImplementationFiles (constinArgument_inUnifiedTypeMap, constinArgument_inProductDirectory, constinArgument_inSemanticDeclarationSortedListForGeneration, ioArgument_ioToolProductFileList, ioArgument_ioAllProductFileSet, inCompiler  COMMA_SOURCE_FILE ("galgas3SemanticDeclarationCompilation.gSemantics", 298)) ;
            }
          }
        }
      }
    }
  }
}


//---------------------------------------------------------------------------------------------------------------------*
//                                                                                                                     *
//                                            Routine 'generateManyHeaders'                                            *
//                                                                                                                     *
//---------------------------------------------------------------------------------------------------------------------*

void routine_generateManyHeaders (const GALGAS_string constinArgument_inProductDirectory,
                                  const GALGAS_semanticDeclarationSortedListForGeneration constinArgument_inSemanticDeclarationSortedListForGeneration,
                                  GALGAS_stringset & ioArgument_ioAllProductFileSet,
                                  C_Compiler * inCompiler
                                  COMMA_UNUSED_LOCATION_ARGS) {
  GALGAS_stringlist var_headerInclusionList_31_ = GALGAS_stringlist::constructor_emptyList (SOURCE_FILE ("galgas3SemanticDeclarationCompilation.gSemantics", 317)) ;
  GALGAS_stringlist var_headerInclusionList_32_ = GALGAS_stringlist::constructor_emptyList (SOURCE_FILE ("galgas3SemanticDeclarationCompilation.gSemantics", 318)) ;
  cEnumerator_semanticDeclarationSortedListForGeneration enumerator_13320 (constinArgument_inSemanticDeclarationSortedListForGeneration, kEnumeration_up) ;
  while (enumerator_13320.hasCurrentObject ()) {
    const enumGalgasBool test_0 = callCategoryReader_isPredefined ((const cPtr_semanticDeclarationForGeneration *) enumerator_13320.current_mDeclaration (HERE).ptr (), inCompiler COMMA_SOURCE_FILE ("galgas3SemanticDeclarationCompilation.gSemantics", 320)).operator_not (SOURCE_FILE ("galgas3SemanticDeclarationCompilation.gSemantics", 320)).boolEnum () ;
    if (kBoolTrue == test_0) {
      GALGAS_stringset var_inclusionSet_31_ = GALGAS_stringset::constructor_emptySet (SOURCE_FILE ("galgas3SemanticDeclarationCompilation.gSemantics", 321)) ;
      GALGAS_string var_headerDef_31_ ;
      callCategoryMethod_appendDeclaration_31_ ((const cPtr_semanticDeclarationForGeneration *) enumerator_13320.current_mDeclaration (HERE).ptr (), var_inclusionSet_31_, var_headerDef_31_, inCompiler COMMA_SOURCE_FILE ("galgas3SemanticDeclarationCompilation.gSemantics", 322)) ;
      GALGAS_string var_headerIncludes_31_ = GALGAS_string::makeEmptyString () ;
      const enumGalgasBool test_1 = var_inclusionSet_31_.reader_hasKey (GALGAS_string::makeEmptyString () COMMA_SOURCE_FILE ("galgas3SemanticDeclarationCompilation.gSemantics", 324)).boolEnum () ;
      if (kBoolTrue == test_1) {
        inCompiler->printMessage (GALGAS_string ("Empty inclusion in ").operator_concat (callCategoryReader_implementationCppFileName ((const cPtr_semanticDeclarationForGeneration *) enumerator_13320.current_mDeclaration (HERE).ptr (), inCompiler COMMA_SOURCE_FILE ("galgas3SemanticDeclarationCompilation.gSemantics", 325))  COMMA_SOURCE_FILE ("galgas3SemanticDeclarationCompilation.gSemantics", 325)).operator_concat (GALGAS_string ("headers 1\n")  COMMA_SOURCE_FILE ("galgas3SemanticDeclarationCompilation.gSemantics", 325))  COMMA_SOURCE_FILE ("galgas3SemanticDeclarationCompilation.gSemantics", 325)) ;
      }
      cEnumerator_stringset enumerator_13717 (var_inclusionSet_31_, kEnumeration_up) ;
      while (enumerator_13717.hasCurrentObject ()) {
        var_headerIncludes_31_.dotAssign_operation (GALGAS_string ("#include \"").operator_concat (enumerator_13717.current_key (HERE)  COMMA_SOURCE_FILE ("galgas3SemanticDeclarationCompilation.gSemantics", 328)).operator_concat (GALGAS_string (".h\"\n")  COMMA_SOURCE_FILE ("galgas3SemanticDeclarationCompilation.gSemantics", 328))  COMMA_SOURCE_FILE ("galgas3SemanticDeclarationCompilation.gSemantics", 328)) ;
        enumerator_13717.gotoNextObject () ;
      }
      var_headerIncludes_31_.dotAssign_operation (var_headerDef_31_  COMMA_SOURCE_FILE ("galgas3SemanticDeclarationCompilation.gSemantics", 330)) ;
      GALGAS_stringset var_inclusionSet_32_ = GALGAS_stringset::constructor_emptySet (SOURCE_FILE ("galgas3SemanticDeclarationCompilation.gSemantics", 331)) ;
      GALGAS_string var_headerDef_32_ ;
      callCategoryMethod_appendDeclaration_32_ ((const cPtr_semanticDeclarationForGeneration *) enumerator_13320.current_mDeclaration (HERE).ptr (), GALGAS_bool (true), constinArgument_inProductDirectory, var_inclusionSet_32_, var_headerDef_32_, inCompiler COMMA_SOURCE_FILE ("galgas3SemanticDeclarationCompilation.gSemantics", 332)) ;
      GALGAS_string var_headerIncludes_32_ = GALGAS_string::makeEmptyString () ;
      const enumGalgasBool test_2 = var_inclusionSet_32_.reader_hasKey (GALGAS_string::makeEmptyString () COMMA_SOURCE_FILE ("galgas3SemanticDeclarationCompilation.gSemantics", 334)).boolEnum () ;
      if (kBoolTrue == test_2) {
        inCompiler->printMessage (GALGAS_string ("Empty inclusion in ").operator_concat (callCategoryReader_implementationCppFileName ((const cPtr_semanticDeclarationForGeneration *) enumerator_13320.current_mDeclaration (HERE).ptr (), inCompiler COMMA_SOURCE_FILE ("galgas3SemanticDeclarationCompilation.gSemantics", 335))  COMMA_SOURCE_FILE ("galgas3SemanticDeclarationCompilation.gSemantics", 335)).operator_concat (GALGAS_string ("headers 2\n")  COMMA_SOURCE_FILE ("galgas3SemanticDeclarationCompilation.gSemantics", 335))  COMMA_SOURCE_FILE ("galgas3SemanticDeclarationCompilation.gSemantics", 335)) ;
      }
      cEnumerator_stringset enumerator_14208 (var_inclusionSet_32_, kEnumeration_up) ;
      while (enumerator_14208.hasCurrentObject ()) {
        var_headerIncludes_32_.dotAssign_operation (GALGAS_string ("#include \"").operator_concat (enumerator_14208.current_key (HERE)  COMMA_SOURCE_FILE ("galgas3SemanticDeclarationCompilation.gSemantics", 338)).operator_concat (GALGAS_string (".h\"\n")  COMMA_SOURCE_FILE ("galgas3SemanticDeclarationCompilation.gSemantics", 338))  COMMA_SOURCE_FILE ("galgas3SemanticDeclarationCompilation.gSemantics", 338)) ;
        enumerator_14208.gotoNextObject () ;
      }
      var_headerIncludes_32_.dotAssign_operation (var_headerDef_32_  COMMA_SOURCE_FILE ("galgas3SemanticDeclarationCompilation.gSemantics", 340)) ;
      if (callCategoryReader_headerKind ((const cPtr_semanticDeclarationForGeneration *) enumerator_13320.current_mDeclaration (HERE).ptr (), inCompiler COMMA_SOURCE_FILE ("galgas3SemanticDeclarationCompilation.gSemantics", 342)).isValid ()) {
        switch (callCategoryReader_headerKind ((const cPtr_semanticDeclarationForGeneration *) enumerator_13320.current_mDeclaration (HERE).ptr (), inCompiler COMMA_SOURCE_FILE ("galgas3SemanticDeclarationCompilation.gSemantics", 342)).enumValue ()) {
        case GALGAS_headerKind::kNotBuilt:
          break ;
        case GALGAS_headerKind::kEnum_noHeader: {
          const enumGalgasBool test_3 = GALGAS_bool (kIsNotEqual, var_headerIncludes_31_.objectCompare (GALGAS_string::makeEmptyString ())).boolEnum () ;
          if (kBoolTrue == test_3) {
            GALGAS_location location_4 (GALGAS_string::makeEmptyString ().reader_nowhere (SOURCE_FILE ("galgas3SemanticDeclarationCompilation.gSemantics", 345)).reader_location (HERE)) ; // Implicit use of 'location' reader
            inCompiler->emitSemanticError (location_4, GALGAS_string ("'noHeader' setting for the '").operator_concat (enumerator_13320.current_mMessage (HERE)  COMMA_SOURCE_FILE ("galgas3SemanticDeclarationCompilation.gSemantics", 345)).operator_concat (GALGAS_string ("' declaration, and 'headerIncludes1' string is not empty")  COMMA_SOURCE_FILE ("galgas3SemanticDeclarationCompilation.gSemantics", 345))  COMMA_SOURCE_FILE ("galgas3SemanticDeclarationCompilation.gSemantics", 345)) ;
          }
          const enumGalgasBool test_5 = GALGAS_bool (kIsNotEqual, var_headerIncludes_32_.objectCompare (GALGAS_string::makeEmptyString ())).boolEnum () ;
          if (kBoolTrue == test_5) {
            GALGAS_location location_6 (GALGAS_string::makeEmptyString ().reader_nowhere (SOURCE_FILE ("galgas3SemanticDeclarationCompilation.gSemantics", 348)).reader_location (HERE)) ; // Implicit use of 'location' reader
            inCompiler->emitSemanticError (location_6, GALGAS_string ("'noHeader' setting for the '").operator_concat (enumerator_13320.current_mMessage (HERE)  COMMA_SOURCE_FILE ("galgas3SemanticDeclarationCompilation.gSemantics", 348)).operator_concat (GALGAS_string ("' declaration, and 'headerIncludes2' string is not empty")  COMMA_SOURCE_FILE ("galgas3SemanticDeclarationCompilation.gSemantics", 348))  COMMA_SOURCE_FILE ("galgas3SemanticDeclarationCompilation.gSemantics", 348)) ;
          }
          } break ;
        case GALGAS_headerKind::kEnum_oneHeader: {
          const enumGalgasBool test_7 = GALGAS_bool (kIsEqual, var_headerIncludes_31_.objectCompare (GALGAS_string::makeEmptyString ())).boolEnum () ;
          if (kBoolTrue == test_7) {
            GALGAS_location location_8 (GALGAS_string::makeEmptyString ().reader_nowhere (SOURCE_FILE ("galgas3SemanticDeclarationCompilation.gSemantics", 352)).reader_location (HERE)) ; // Implicit use of 'location' reader
            inCompiler->emitSemanticError (location_8, GALGAS_string ("'oneHeader' setting for the '").operator_concat (enumerator_13320.current_mMessage (HERE)  COMMA_SOURCE_FILE ("galgas3SemanticDeclarationCompilation.gSemantics", 352)).operator_concat (GALGAS_string ("' declaration, and 'headerIncludes1' string is empty")  COMMA_SOURCE_FILE ("galgas3SemanticDeclarationCompilation.gSemantics", 352))  COMMA_SOURCE_FILE ("galgas3SemanticDeclarationCompilation.gSemantics", 352)) ;
          }
          const enumGalgasBool test_9 = GALGAS_bool (kIsNotEqual, var_headerIncludes_32_.objectCompare (GALGAS_string::makeEmptyString ())).boolEnum () ;
          if (kBoolTrue == test_9) {
            GALGAS_location location_10 (GALGAS_string::makeEmptyString ().reader_nowhere (SOURCE_FILE ("galgas3SemanticDeclarationCompilation.gSemantics", 355)).reader_location (HERE)) ; // Implicit use of 'location' reader
            inCompiler->emitSemanticWarning (location_10, GALGAS_string ("'oneHeader' setting for the '").operator_concat (enumerator_13320.current_mMessage (HERE)  COMMA_SOURCE_FILE ("galgas3SemanticDeclarationCompilation.gSemantics", 355)).operator_concat (GALGAS_string ("' declaration, and 'headerIncludes2' string is not empty")  COMMA_SOURCE_FILE ("galgas3SemanticDeclarationCompilation.gSemantics", 355))  COMMA_SOURCE_FILE ("galgas3SemanticDeclarationCompilation.gSemantics", 355)) ;
          }
          } break ;
        case GALGAS_headerKind::kEnum_twoHeaders: {
          const enumGalgasBool test_11 = GALGAS_bool (kIsEqual, var_headerIncludes_31_.objectCompare (GALGAS_string::makeEmptyString ())).boolEnum () ;
          if (kBoolTrue == test_11) {
            GALGAS_location location_12 (GALGAS_string::makeEmptyString ().reader_nowhere (SOURCE_FILE ("galgas3SemanticDeclarationCompilation.gSemantics", 359)).reader_location (HERE)) ; // Implicit use of 'location' reader
            inCompiler->emitSemanticWarning (location_12, GALGAS_string ("'twoHeaders' setting for the '").operator_concat (enumerator_13320.current_mMessage (HERE)  COMMA_SOURCE_FILE ("galgas3SemanticDeclarationCompilation.gSemantics", 359)).operator_concat (GALGAS_string ("' declaration, and 'headerIncludes1' string is empty")  COMMA_SOURCE_FILE ("galgas3SemanticDeclarationCompilation.gSemantics", 359))  COMMA_SOURCE_FILE ("galgas3SemanticDeclarationCompilation.gSemantics", 359)) ;
          }
          const enumGalgasBool test_13 = GALGAS_bool (kIsEqual, var_headerIncludes_32_.objectCompare (GALGAS_string::makeEmptyString ())).boolEnum () ;
          if (kBoolTrue == test_13) {
            GALGAS_location location_14 (GALGAS_string::makeEmptyString ().reader_nowhere (SOURCE_FILE ("galgas3SemanticDeclarationCompilation.gSemantics", 362)).reader_location (HERE)) ; // Implicit use of 'location' reader
            inCompiler->emitSemanticWarning (location_14, GALGAS_string ("'twoHeaders' setting for the '").operator_concat (enumerator_13320.current_mMessage (HERE)  COMMA_SOURCE_FILE ("galgas3SemanticDeclarationCompilation.gSemantics", 362)).operator_concat (GALGAS_string ("' declaration, and 'headerIncludes2' string is empty")  COMMA_SOURCE_FILE ("galgas3SemanticDeclarationCompilation.gSemantics", 362))  COMMA_SOURCE_FILE ("galgas3SemanticDeclarationCompilation.gSemantics", 362)) ;
          }
          } break ;
        }
      }
      const enumGalgasBool test_15 = GALGAS_bool (kIsNotEqual, callCategoryReader_headerKind ((const cPtr_semanticDeclarationForGeneration *) enumerator_13320.current_mDeclaration (HERE).ptr (), inCompiler COMMA_SOURCE_FILE ("galgas3SemanticDeclarationCompilation.gSemantics", 366)).objectCompare (GALGAS_headerKind::constructor_noHeader (SOURCE_FILE ("galgas3SemanticDeclarationCompilation.gSemantics", 366)))).boolEnum () ;
      if (kBoolTrue == test_15) {
        GALGAS_string var_headerString = GALGAS_string ("#ifndef ").operator_concat (callCategoryReader_implementationCppFileName ((const cPtr_semanticDeclarationForGeneration *) enumerator_13320.current_mDeclaration (HERE).ptr (), inCompiler COMMA_SOURCE_FILE ("galgas3SemanticDeclarationCompilation.gSemantics", 367)).reader_identifierRepresentation (SOURCE_FILE ("galgas3SemanticDeclarationCompilation.gSemantics", 367))  COMMA_SOURCE_FILE ("galgas3SemanticDeclarationCompilation.gSemantics", 367)).operator_concat (GALGAS_string ("_1_DEFINED\n")  COMMA_SOURCE_FILE ("galgas3SemanticDeclarationCompilation.gSemantics", 367)) ;
        var_headerString.dotAssign_operation (GALGAS_string ("#define ").operator_concat (callCategoryReader_implementationCppFileName ((const cPtr_semanticDeclarationForGeneration *) enumerator_13320.current_mDeclaration (HERE).ptr (), inCompiler COMMA_SOURCE_FILE ("galgas3SemanticDeclarationCompilation.gSemantics", 368)).reader_identifierRepresentation (SOURCE_FILE ("galgas3SemanticDeclarationCompilation.gSemantics", 368))  COMMA_SOURCE_FILE ("galgas3SemanticDeclarationCompilation.gSemantics", 368)).operator_concat (GALGAS_string ("_1_DEFINED\n"
          "\n")  COMMA_SOURCE_FILE ("galgas3SemanticDeclarationCompilation.gSemantics", 368))  COMMA_SOURCE_FILE ("galgas3SemanticDeclarationCompilation.gSemantics", 368)) ;
        var_headerString.dotAssign_operation (GALGAS_string ("//---------------------------------------------------------------------------------------------------------------------*\n"
          "\n")  COMMA_SOURCE_FILE ("galgas3SemanticDeclarationCompilation.gSemantics", 369)) ;
        var_headerString.dotAssign_operation (GALGAS_string ("#include \"galgas2/predefined-types.h\"\n"
          "\n")  COMMA_SOURCE_FILE ("galgas3SemanticDeclarationCompilation.gSemantics", 370)) ;
        var_headerString.dotAssign_operation (GALGAS_string ("//---------------------------------------------------------------------------------------------------------------------*\n"
          "\n")  COMMA_SOURCE_FILE ("galgas3SemanticDeclarationCompilation.gSemantics", 371)) ;
        var_headerString.dotAssign_operation (var_headerIncludes_31_  COMMA_SOURCE_FILE ("galgas3SemanticDeclarationCompilation.gSemantics", 372)) ;
        var_headerString.dotAssign_operation (GALGAS_string ("\n")  COMMA_SOURCE_FILE ("galgas3SemanticDeclarationCompilation.gSemantics", 373)) ;
        var_headerString.dotAssign_operation (GALGAS_string ("//---------------------------------------------------------------------------------------------------------------------*\n"
          "\n")  COMMA_SOURCE_FILE ("galgas3SemanticDeclarationCompilation.gSemantics", 374)) ;
        var_headerString.dotAssign_operation (GALGAS_string ("#endif\n"
          "\n")  COMMA_SOURCE_FILE ("galgas3SemanticDeclarationCompilation.gSemantics", 375)) ;
        GALGAS_string temp_16 ;
        const enumGalgasBool test_17 = GALGAS_bool (kIsEqual, callCategoryReader_headerKind ((const cPtr_semanticDeclarationForGeneration *) enumerator_13320.current_mDeclaration (HERE).ptr (), inCompiler COMMA_SOURCE_FILE ("galgas3SemanticDeclarationCompilation.gSemantics", 376)).objectCompare (GALGAS_headerKind::constructor_twoHeaders (SOURCE_FILE ("galgas3SemanticDeclarationCompilation.gSemantics", 376)))).boolEnum () ;
        if (kBoolTrue == test_17) {
          temp_16 = GALGAS_string ("-1") ;
        }else if (kBoolFalse == test_17) {
          temp_16 = GALGAS_string::makeEmptyString () ;
        }
        GALGAS_string var_headerFileName = callCategoryReader_implementationCppFileName ((const cPtr_semanticDeclarationForGeneration *) enumerator_13320.current_mDeclaration (HERE).ptr (), inCompiler COMMA_SOURCE_FILE ("galgas3SemanticDeclarationCompilation.gSemantics", 376)).add_operation (temp_16, inCompiler COMMA_SOURCE_FILE ("galgas3SemanticDeclarationCompilation.gSemantics", 376)) ;
        var_headerInclusionList_31_.addAssign_operation (var_headerFileName  COMMA_SOURCE_FILE ("galgas3SemanticDeclarationCompilation.gSemantics", 377)) ;
        ioArgument_ioAllProductFileSet.addAssign_operation (var_headerFileName.operator_concat (GALGAS_string (".h")  COMMA_SOURCE_FILE ("galgas3SemanticDeclarationCompilation.gSemantics", 378))  COMMA_SOURCE_FILE ("galgas3SemanticDeclarationCompilation.gSemantics", 378)) ;
        {
        GALGAS_string::class_method_generateFile (constinArgument_inProductDirectory, var_headerFileName.operator_concat (GALGAS_string (".h")  COMMA_SOURCE_FILE ("galgas3SemanticDeclarationCompilation.gSemantics", 381)), var_headerString, inCompiler COMMA_SOURCE_FILE ("galgas3SemanticDeclarationCompilation.gSemantics", 379)) ;
        }
      }
      const enumGalgasBool test_18 = GALGAS_bool (kIsEqual, callCategoryReader_headerKind ((const cPtr_semanticDeclarationForGeneration *) enumerator_13320.current_mDeclaration (HERE).ptr (), inCompiler COMMA_SOURCE_FILE ("galgas3SemanticDeclarationCompilation.gSemantics", 386)).objectCompare (GALGAS_headerKind::constructor_twoHeaders (SOURCE_FILE ("galgas3SemanticDeclarationCompilation.gSemantics", 386)))).boolEnum () ;
      if (kBoolTrue == test_18) {
        GALGAS_string var_headerString = GALGAS_string ("#ifndef ").operator_concat (callCategoryReader_implementationCppFileName ((const cPtr_semanticDeclarationForGeneration *) enumerator_13320.current_mDeclaration (HERE).ptr (), inCompiler COMMA_SOURCE_FILE ("galgas3SemanticDeclarationCompilation.gSemantics", 387)).reader_identifierRepresentation (SOURCE_FILE ("galgas3SemanticDeclarationCompilation.gSemantics", 387))  COMMA_SOURCE_FILE ("galgas3SemanticDeclarationCompilation.gSemantics", 387)).operator_concat (GALGAS_string ("_DEFINED\n")  COMMA_SOURCE_FILE ("galgas3SemanticDeclarationCompilation.gSemantics", 387)) ;
        var_headerString.dotAssign_operation (GALGAS_string ("#define ").operator_concat (callCategoryReader_implementationCppFileName ((const cPtr_semanticDeclarationForGeneration *) enumerator_13320.current_mDeclaration (HERE).ptr (), inCompiler COMMA_SOURCE_FILE ("galgas3SemanticDeclarationCompilation.gSemantics", 388)).reader_identifierRepresentation (SOURCE_FILE ("galgas3SemanticDeclarationCompilation.gSemantics", 388))  COMMA_SOURCE_FILE ("galgas3SemanticDeclarationCompilation.gSemantics", 388)).operator_concat (GALGAS_string ("_DEFINED\n"
          "\n")  COMMA_SOURCE_FILE ("galgas3SemanticDeclarationCompilation.gSemantics", 388))  COMMA_SOURCE_FILE ("galgas3SemanticDeclarationCompilation.gSemantics", 388)) ;
        var_headerString.dotAssign_operation (GALGAS_string ("//---------------------------------------------------------------------------------------------------------------------*\n"
          "\n")  COMMA_SOURCE_FILE ("galgas3SemanticDeclarationCompilation.gSemantics", 389)) ;
        var_headerString.dotAssign_operation (GALGAS_string ("#include \"").operator_concat (callCategoryReader_implementationCppFileName ((const cPtr_semanticDeclarationForGeneration *) enumerator_13320.current_mDeclaration (HERE).ptr (), inCompiler COMMA_SOURCE_FILE ("galgas3SemanticDeclarationCompilation.gSemantics", 390))  COMMA_SOURCE_FILE ("galgas3SemanticDeclarationCompilation.gSemantics", 390)).operator_concat (GALGAS_string ("-1.h\"\n")  COMMA_SOURCE_FILE ("galgas3SemanticDeclarationCompilation.gSemantics", 390))  COMMA_SOURCE_FILE ("galgas3SemanticDeclarationCompilation.gSemantics", 390)) ;
        var_headerString.dotAssign_operation (GALGAS_string ("\n"
          "//---------------------------------------------------------------------------------------------------------------------*\n"
          "\n")  COMMA_SOURCE_FILE ("galgas3SemanticDeclarationCompilation.gSemantics", 391)) ;
        var_headerString.dotAssign_operation (var_headerIncludes_32_  COMMA_SOURCE_FILE ("galgas3SemanticDeclarationCompilation.gSemantics", 392)) ;
        var_headerString.dotAssign_operation (GALGAS_string ("\n")  COMMA_SOURCE_FILE ("galgas3SemanticDeclarationCompilation.gSemantics", 393)) ;
        var_headerString.dotAssign_operation (GALGAS_string ("//---------------------------------------------------------------------------------------------------------------------*\n"
          "\n")  COMMA_SOURCE_FILE ("galgas3SemanticDeclarationCompilation.gSemantics", 394)) ;
        var_headerString.dotAssign_operation (GALGAS_string ("#endif\n"
          "\n")  COMMA_SOURCE_FILE ("galgas3SemanticDeclarationCompilation.gSemantics", 395)) ;
        var_headerInclusionList_32_.addAssign_operation (callCategoryReader_implementationCppFileName ((const cPtr_semanticDeclarationForGeneration *) enumerator_13320.current_mDeclaration (HERE).ptr (), inCompiler COMMA_SOURCE_FILE ("galgas3SemanticDeclarationCompilation.gSemantics", 396))  COMMA_SOURCE_FILE ("galgas3SemanticDeclarationCompilation.gSemantics", 396)) ;
        ioArgument_ioAllProductFileSet.addAssign_operation (callCategoryReader_implementationCppFileName ((const cPtr_semanticDeclarationForGeneration *) enumerator_13320.current_mDeclaration (HERE).ptr (), inCompiler COMMA_SOURCE_FILE ("galgas3SemanticDeclarationCompilation.gSemantics", 397)).operator_concat (GALGAS_string (".h")  COMMA_SOURCE_FILE ("galgas3SemanticDeclarationCompilation.gSemantics", 397))  COMMA_SOURCE_FILE ("galgas3SemanticDeclarationCompilation.gSemantics", 397)) ;
        {
        GALGAS_string::class_method_generateFile (constinArgument_inProductDirectory, callCategoryReader_implementationCppFileName ((const cPtr_semanticDeclarationForGeneration *) enumerator_13320.current_mDeclaration (HERE).ptr (), inCompiler COMMA_SOURCE_FILE ("galgas3SemanticDeclarationCompilation.gSemantics", 400)).operator_concat (GALGAS_string (".h")  COMMA_SOURCE_FILE ("galgas3SemanticDeclarationCompilation.gSemantics", 400)), var_headerString, inCompiler COMMA_SOURCE_FILE ("galgas3SemanticDeclarationCompilation.gSemantics", 398)) ;
        }
      }
    }
    enumerator_13320.gotoNextObject () ;
  }
  GALGAS_string var_headerString = GALGAS_string (filewrapperTemplate_semanticFileGenerationTemplate_semanticFileHeader (inCompiler, GALGAS_string ("all-declarations"), var_headerInclusionList_31_.add_operation (var_headerInclusionList_32_, inCompiler COMMA_SOURCE_FILE ("galgas3SemanticDeclarationCompilation.gSemantics", 409)) COMMA_SOURCE_FILE ("galgas3SemanticDeclarationCompilation.gSemantics", 407))) ;
  ioArgument_ioAllProductFileSet.addAssign_operation (GALGAS_string ("all-declarations.h")  COMMA_SOURCE_FILE ("galgas3SemanticDeclarationCompilation.gSemantics", 411)) ;
  {
  GALGAS_string::class_method_generateFile (constinArgument_inProductDirectory, GALGAS_string ("all-declarations.h"), var_headerString.add_operation (GALGAS_string ("#endif\n"), inCompiler COMMA_SOURCE_FILE ("galgas3SemanticDeclarationCompilation.gSemantics", 415)), inCompiler COMMA_SOURCE_FILE ("galgas3SemanticDeclarationCompilation.gSemantics", 412)) ;
  }
}


//---------------------------------------------------------------------------------------------------------------------*
//                                                                                                                     *
//                                           Routine 'generateOneBigHeader'                                            *
//                                                                                                                     *
//---------------------------------------------------------------------------------------------------------------------*

void routine_generateOneBigHeader (const GALGAS_string constinArgument_inProductDirectory,
                                   const GALGAS_semanticDeclarationSortedListForGeneration constinArgument_inSemanticDeclarationSortedListForGeneration,
                                   GALGAS_stringset & ioArgument_ioAllProductFileSet,
                                   C_Compiler * inCompiler
                                   COMMA_UNUSED_LOCATION_ARGS) {
  GALGAS_string var_headerString = GALGAS_string (filewrapperTemplate_semanticFileGenerationTemplate_semanticFileHeader (inCompiler, GALGAS_string ("all-declarations"), GALGAS_stringlist::constructor_emptyList (SOURCE_FILE ("galgas3SemanticDeclarationCompilation.gSemantics", 428)) COMMA_SOURCE_FILE ("galgas3SemanticDeclarationCompilation.gSemantics", 426))) ;
  cEnumerator_semanticDeclarationSortedListForGeneration enumerator_19246 (constinArgument_inSemanticDeclarationSortedListForGeneration, kEnumeration_up) ;
  while (enumerator_19246.hasCurrentObject ()) {
    const enumGalgasBool test_0 = callCategoryReader_isPredefined ((const cPtr_semanticDeclarationForGeneration *) enumerator_19246.current_mDeclaration (HERE).ptr (), inCompiler COMMA_SOURCE_FILE ("galgas3SemanticDeclarationCompilation.gSemantics", 432)).operator_not (SOURCE_FILE ("galgas3SemanticDeclarationCompilation.gSemantics", 432)).boolEnum () ;
    if (kBoolTrue == test_0) {
      GALGAS_stringset var_inclusionSet_31_ = GALGAS_stringset::constructor_emptySet (SOURCE_FILE ("galgas3SemanticDeclarationCompilation.gSemantics", 433)) ;
      GALGAS_string var_headerString_31_ ;
      callCategoryMethod_appendDeclaration_31_ ((const cPtr_semanticDeclarationForGeneration *) enumerator_19246.current_mDeclaration (HERE).ptr (), var_inclusionSet_31_, var_headerString_31_, inCompiler COMMA_SOURCE_FILE ("galgas3SemanticDeclarationCompilation.gSemantics", 434)) ;
      var_headerString.dotAssign_operation (var_headerString_31_  COMMA_SOURCE_FILE ("galgas3SemanticDeclarationCompilation.gSemantics", 435)) ;
    }
    enumerator_19246.gotoNextObject () ;
  }
  cEnumerator_semanticDeclarationSortedListForGeneration enumerator_19567 (constinArgument_inSemanticDeclarationSortedListForGeneration, kEnumeration_up) ;
  while (enumerator_19567.hasCurrentObject ()) {
    const enumGalgasBool test_1 = callCategoryReader_isPredefined ((const cPtr_semanticDeclarationForGeneration *) enumerator_19567.current_mDeclaration (HERE).ptr (), inCompiler COMMA_SOURCE_FILE ("galgas3SemanticDeclarationCompilation.gSemantics", 440)).operator_not (SOURCE_FILE ("galgas3SemanticDeclarationCompilation.gSemantics", 440)).boolEnum () ;
    if (kBoolTrue == test_1) {
      GALGAS_stringset var_inclusionSet_32_ = GALGAS_stringset::constructor_emptySet (SOURCE_FILE ("galgas3SemanticDeclarationCompilation.gSemantics", 441)) ;
      GALGAS_string var_headerString_32_ ;
      callCategoryMethod_appendDeclaration_32_ ((const cPtr_semanticDeclarationForGeneration *) enumerator_19567.current_mDeclaration (HERE).ptr (), GALGAS_bool (true), constinArgument_inProductDirectory, var_inclusionSet_32_, var_headerString_32_, inCompiler COMMA_SOURCE_FILE ("galgas3SemanticDeclarationCompilation.gSemantics", 442)) ;
      var_headerString.dotAssign_operation (var_headerString_32_  COMMA_SOURCE_FILE ("galgas3SemanticDeclarationCompilation.gSemantics", 443)) ;
    }
    enumerator_19567.gotoNextObject () ;
  }
  ioArgument_ioAllProductFileSet.addAssign_operation (GALGAS_string ("all-declarations.h")  COMMA_SOURCE_FILE ("galgas3SemanticDeclarationCompilation.gSemantics", 446)) ;
  {
  GALGAS_string::class_method_generateFile (constinArgument_inProductDirectory, GALGAS_string ("all-declarations.h"), var_headerString.add_operation (GALGAS_string ("#endif\n"), inCompiler COMMA_SOURCE_FILE ("galgas3SemanticDeclarationCompilation.gSemantics", 450)), inCompiler COMMA_SOURCE_FILE ("galgas3SemanticDeclarationCompilation.gSemantics", 447)) ;
  }
}


//---------------------------------------------------------------------------------------------------------------------*

cMapElement_headerCompositionMap::cMapElement_headerCompositionMap (const GALGAS_lstring & inKey,
                                                                    const GALGAS_stringset & in_mInclusion,
                                                                    const GALGAS_string & in_mHeaderString
                                                                    COMMA_LOCATION_ARGS) :
cMapElement (inKey COMMA_THERE),
mAttribute_mInclusion (in_mInclusion),
mAttribute_mHeaderString (in_mHeaderString) {
}

//---------------------------------------------------------------------------------------------------------------------*

bool cMapElement_headerCompositionMap::isValid (void) const {
  return mAttribute_lkey.isValid () && mAttribute_mInclusion.isValid () && mAttribute_mHeaderString.isValid () ;
}

//---------------------------------------------------------------------------------------------------------------------*

cMapElement * cMapElement_headerCompositionMap::copy (void) {
  cMapElement * result = NULL ;
  macroMyNew (result, cMapElement_headerCompositionMap (mAttribute_lkey, mAttribute_mInclusion, mAttribute_mHeaderString COMMA_HERE)) ;
  return result ;
}

//---------------------------------------------------------------------------------------------------------------------*

void cMapElement_headerCompositionMap::description (C_String & ioString, const int32_t inIndentation) const {
  ioString << "\n" ;
  ioString.writeStringMultiple ("| ", inIndentation) ;
  ioString << "mInclusion" ":" ;
  mAttribute_mInclusion.description (ioString, inIndentation) ;
  ioString << "\n" ;
  ioString.writeStringMultiple ("| ", inIndentation) ;
  ioString << "mHeaderString" ":" ;
  mAttribute_mHeaderString.description (ioString, inIndentation) ;
}

//---------------------------------------------------------------------------------------------------------------------*

typeComparisonResult cMapElement_headerCompositionMap::compare (const cCollectionElement * inOperand) const {
  cMapElement_headerCompositionMap * operand = (cMapElement_headerCompositionMap *) inOperand ;
  typeComparisonResult result = mAttribute_lkey.objectCompare (operand->mAttribute_lkey) ;
  if (kOperandEqual == result) {
    result = mAttribute_mInclusion.objectCompare (operand->mAttribute_mInclusion) ;
  }
  if (kOperandEqual == result) {
    result = mAttribute_mHeaderString.objectCompare (operand->mAttribute_mHeaderString) ;
  }
  return result ;
}

//---------------------------------------------------------------------------------------------------------------------*

GALGAS_headerCompositionMap::GALGAS_headerCompositionMap (void) :
AC_GALGAS_map () {
}

//---------------------------------------------------------------------------------------------------------------------*

GALGAS_headerCompositionMap::GALGAS_headerCompositionMap (const GALGAS_headerCompositionMap & inSource) :
AC_GALGAS_map (inSource) {
}

//---------------------------------------------------------------------------------------------------------------------*

GALGAS_headerCompositionMap & GALGAS_headerCompositionMap::operator = (const GALGAS_headerCompositionMap & inSource) {
  * ((AC_GALGAS_map *) this) = inSource ;
  return * this ;
}

//---------------------------------------------------------------------------------------------------------------------*

GALGAS_headerCompositionMap GALGAS_headerCompositionMap::constructor_emptyMap (LOCATION_ARGS) {
  GALGAS_headerCompositionMap result ;
  result.makeNewEmptyMap (THERE) ;
  return result ;
}

//---------------------------------------------------------------------------------------------------------------------*

GALGAS_headerCompositionMap GALGAS_headerCompositionMap::constructor_mapWithMapToOverride (const GALGAS_headerCompositionMap & inMapToOverride
                                                                                           COMMA_LOCATION_ARGS) {
  GALGAS_headerCompositionMap result ;
  result.makeNewEmptyMapWithMapToOverride (inMapToOverride COMMA_THERE) ;
  return result ;
}

//---------------------------------------------------------------------------------------------------------------------*

GALGAS_headerCompositionMap GALGAS_headerCompositionMap::reader_overriddenMap (C_Compiler * inCompiler
                                                                               COMMA_LOCATION_ARGS) const {
  GALGAS_headerCompositionMap result ;
  getOverridenMap (result, inCompiler COMMA_THERE) ;
  return result ;
}

//---------------------------------------------------------------------------------------------------------------------*

void GALGAS_headerCompositionMap::addAssign_operation (const GALGAS_lstring & inKey,
                                                       const GALGAS_stringset & inArgument0,
                                                       const GALGAS_string & inArgument1,
                                                       C_Compiler * inCompiler
                                                       COMMA_LOCATION_ARGS) {
  cMapElement_headerCompositionMap * p = NULL ;
  macroMyNew (p, cMapElement_headerCompositionMap (inKey, inArgument0, inArgument1 COMMA_HERE)) ;
  capCollectionElement attributes ;
  attributes.setPointer (p) ;
  macroDetachSharedObject (p) ;
  const char * kInsertErrorMessage = "@headerCompositionMap insert error: '%K' already in map" ;
  const char * kShadowErrorMessage = "" ;
  performInsert (attributes, inCompiler, kInsertErrorMessage, kShadowErrorMessage COMMA_THERE) ;
}

//---------------------------------------------------------------------------------------------------------------------*

void GALGAS_headerCompositionMap::modifier_insertKey (GALGAS_lstring inKey,
                                                      GALGAS_stringset inArgument0,
                                                      GALGAS_string inArgument1,
                                                      C_Compiler * inCompiler
                                                      COMMA_LOCATION_ARGS) {
  cMapElement_headerCompositionMap * p = NULL ;
  macroMyNew (p, cMapElement_headerCompositionMap (inKey, inArgument0, inArgument1 COMMA_HERE)) ;
  capCollectionElement attributes ;
  attributes.setPointer (p) ;
  macroDetachSharedObject (p) ;
  const char * kInsertErrorMessage = "the '%K' key is already declared in %L" ;
  const char * kShadowErrorMessage = "" ;
  performInsert (attributes, inCompiler, kInsertErrorMessage, kShadowErrorMessage COMMA_THERE) ;
}

//---------------------------------------------------------------------------------------------------------------------*

const char * kSearchErrorMessage_headerCompositionMap_searchKey = "there is no '%K' key" ;

//---------------------------------------------------------------------------------------------------------------------*

void GALGAS_headerCompositionMap::method_searchKey (GALGAS_lstring inKey,
                                                    GALGAS_stringset & outArgument0,
                                                    GALGAS_string & outArgument1,
                                                    C_Compiler * inCompiler
                                                    COMMA_LOCATION_ARGS) const {
  const cMapElement_headerCompositionMap * p = (const cMapElement_headerCompositionMap *) performSearch (inKey,
                                                                                                           inCompiler,
                                                                                                           kSearchErrorMessage_headerCompositionMap_searchKey
                                                                                                           COMMA_THERE) ;
  if (NULL == p) {
    outArgument0.drop () ;
    outArgument1.drop () ;
  }else{
    macroValidSharedObject (p, cMapElement_headerCompositionMap) ;
    outArgument0 = p->mAttribute_mInclusion ;
    outArgument1 = p->mAttribute_mHeaderString ;
  }
}

//---------------------------------------------------------------------------------------------------------------------*

GALGAS_stringset GALGAS_headerCompositionMap::reader_mInclusionForKey (const GALGAS_string & inKey,
                                                                       C_Compiler * inCompiler
                                                                       COMMA_LOCATION_ARGS) const {
  const cCollectionElement * attributes = searchForReadingAttribute (inKey, inCompiler COMMA_THERE) ;
  const cMapElement_headerCompositionMap * p = (const cMapElement_headerCompositionMap *) attributes ;
  GALGAS_stringset result ;
  if (NULL != p) {
    macroValidSharedObject (p, cMapElement_headerCompositionMap) ;
    result = p->mAttribute_mInclusion ;
  }
  return result ;
}

//---------------------------------------------------------------------------------------------------------------------*

GALGAS_string GALGAS_headerCompositionMap::reader_mHeaderStringForKey (const GALGAS_string & inKey,
                                                                       C_Compiler * inCompiler
                                                                       COMMA_LOCATION_ARGS) const {
  const cCollectionElement * attributes = searchForReadingAttribute (inKey, inCompiler COMMA_THERE) ;
  const cMapElement_headerCompositionMap * p = (const cMapElement_headerCompositionMap *) attributes ;
  GALGAS_string result ;
  if (NULL != p) {
    macroValidSharedObject (p, cMapElement_headerCompositionMap) ;
    result = p->mAttribute_mHeaderString ;
  }
  return result ;
}

//---------------------------------------------------------------------------------------------------------------------*

void GALGAS_headerCompositionMap::modifier_setMInclusionForKey (GALGAS_stringset inAttributeValue,
                                                                GALGAS_string inKey,
                                                                C_Compiler * inCompiler
                                                                COMMA_LOCATION_ARGS) {
  cCollectionElement * attributes = searchForReadWriteAttribute (inKey, inCompiler COMMA_THERE) ;
  cMapElement_headerCompositionMap * p = (cMapElement_headerCompositionMap *) attributes ;
  if (NULL != p) {
    macroValidSharedObject (p, cMapElement_headerCompositionMap) ;
    p->mAttribute_mInclusion = inAttributeValue ;
  }
}

//---------------------------------------------------------------------------------------------------------------------*

void GALGAS_headerCompositionMap::modifier_setMHeaderStringForKey (GALGAS_string inAttributeValue,
                                                                   GALGAS_string inKey,
                                                                   C_Compiler * inCompiler
                                                                   COMMA_LOCATION_ARGS) {
  cCollectionElement * attributes = searchForReadWriteAttribute (inKey, inCompiler COMMA_THERE) ;
  cMapElement_headerCompositionMap * p = (cMapElement_headerCompositionMap *) attributes ;
  if (NULL != p) {
    macroValidSharedObject (p, cMapElement_headerCompositionMap) ;
    p->mAttribute_mHeaderString = inAttributeValue ;
  }
}

//---------------------------------------------------------------------------------------------------------------------*

cMapElement_headerCompositionMap * GALGAS_headerCompositionMap::readWriteAccessForWithInstruction (C_Compiler * inCompiler,
                                                                                                   const GALGAS_string & inKey
                                                                                                   COMMA_LOCATION_ARGS) {
  cMapElement_headerCompositionMap * result = (cMapElement_headerCompositionMap *) searchForReadWriteAttribute (inKey, inCompiler COMMA_THERE) ;
  macroNullOrValidSharedObject (result, cMapElement_headerCompositionMap) ;
  return result ;
}

//---------------------------------------------------------------------------------------------------------------------*

cEnumerator_headerCompositionMap::cEnumerator_headerCompositionMap (const GALGAS_headerCompositionMap & inEnumeratedObject,
                                                                    const typeEnumerationOrder inOrder) :
cGenericAbstractEnumerator () {
  inEnumeratedObject.populateEnumerationArray (mEnumerationArray, inOrder) ;
}

//---------------------------------------------------------------------------------------------------------------------*

GALGAS_headerCompositionMap_2D_element cEnumerator_headerCompositionMap::current (LOCATION_ARGS) const {
  const cMapElement_headerCompositionMap * p = (const cMapElement_headerCompositionMap *) currentObjectPtr (THERE) ;
  macroValidSharedObject (p, cMapElement_headerCompositionMap) ;
  return GALGAS_headerCompositionMap_2D_element (p->mAttribute_lkey, p->mAttribute_mInclusion, p->mAttribute_mHeaderString) ;
}

//---------------------------------------------------------------------------------------------------------------------*

GALGAS_lstring cEnumerator_headerCompositionMap::current_lkey (LOCATION_ARGS) const {
  const cMapElement * p = (const cMapElement *) currentObjectPtr (THERE) ;
  macroValidSharedObject (p, cMapElement) ;
  return p->mAttribute_lkey ;
}

//---------------------------------------------------------------------------------------------------------------------*

GALGAS_stringset cEnumerator_headerCompositionMap::current_mInclusion (LOCATION_ARGS) const {
  const cMapElement_headerCompositionMap * p = (const cMapElement_headerCompositionMap *) currentObjectPtr (THERE) ;
  macroValidSharedObject (p, cMapElement_headerCompositionMap) ;
  return p->mAttribute_mInclusion ;
}

//---------------------------------------------------------------------------------------------------------------------*

GALGAS_string cEnumerator_headerCompositionMap::current_mHeaderString (LOCATION_ARGS) const {
  const cMapElement_headerCompositionMap * p = (const cMapElement_headerCompositionMap *) currentObjectPtr (THERE) ;
  macroValidSharedObject (p, cMapElement_headerCompositionMap) ;
  return p->mAttribute_mHeaderString ;
}



//---------------------------------------------------------------------------------------------------------------------*
//                                                                                                                     *
//                                             @headerCompositionMap type                                              *
//                                                                                                                     *
//---------------------------------------------------------------------------------------------------------------------*

const C_galgas_type_descriptor
kTypeDescriptor_GALGAS_headerCompositionMap ("headerCompositionMap",
                                             NULL) ;

//---------------------------------------------------------------------------------------------------------------------*

const C_galgas_type_descriptor * GALGAS_headerCompositionMap::staticTypeDescriptor (void) const {
  return & kTypeDescriptor_GALGAS_headerCompositionMap ;
}

//---------------------------------------------------------------------------------------------------------------------*

AC_GALGAS_root * GALGAS_headerCompositionMap::clonedObject (void) const {
  AC_GALGAS_root * result = NULL ;
  if (isValid ()) {
    macroMyNew (result, GALGAS_headerCompositionMap (*this)) ;
  }
  return result ;
}

//---------------------------------------------------------------------------------------------------------------------*

GALGAS_headerCompositionMap GALGAS_headerCompositionMap::extractObject (const GALGAS_object & inObject,
                                                                        C_Compiler * inCompiler
                                                                        COMMA_LOCATION_ARGS) {
  GALGAS_headerCompositionMap result ;
  const GALGAS_headerCompositionMap * p = (const GALGAS_headerCompositionMap *) inObject.embeddedObject () ;
  if (NULL != p) {
    if (NULL != dynamic_cast <const GALGAS_headerCompositionMap *> (p)) {
      result = *p ;
    }else{
      inCompiler->castError ("headerCompositionMap", p->dynamicTypeDescriptor () COMMA_THERE) ;
    }  
  }
  return result ;
}

//---------------------------------------------------------------------------------------------------------------------*

cMapElement_headerRepartitionMap::cMapElement_headerRepartitionMap (const GALGAS_lstring & inKey,
                                                                    const GALGAS_string & in_mHeaderFileName
                                                                    COMMA_LOCATION_ARGS) :
cMapElement (inKey COMMA_THERE),
mAttribute_mHeaderFileName (in_mHeaderFileName) {
}

//---------------------------------------------------------------------------------------------------------------------*

bool cMapElement_headerRepartitionMap::isValid (void) const {
  return mAttribute_lkey.isValid () && mAttribute_mHeaderFileName.isValid () ;
}

//---------------------------------------------------------------------------------------------------------------------*

cMapElement * cMapElement_headerRepartitionMap::copy (void) {
  cMapElement * result = NULL ;
  macroMyNew (result, cMapElement_headerRepartitionMap (mAttribute_lkey, mAttribute_mHeaderFileName COMMA_HERE)) ;
  return result ;
}

//---------------------------------------------------------------------------------------------------------------------*

void cMapElement_headerRepartitionMap::description (C_String & ioString, const int32_t inIndentation) const {
  ioString << "\n" ;
  ioString.writeStringMultiple ("| ", inIndentation) ;
  ioString << "mHeaderFileName" ":" ;
  mAttribute_mHeaderFileName.description (ioString, inIndentation) ;
}

//---------------------------------------------------------------------------------------------------------------------*

typeComparisonResult cMapElement_headerRepartitionMap::compare (const cCollectionElement * inOperand) const {
  cMapElement_headerRepartitionMap * operand = (cMapElement_headerRepartitionMap *) inOperand ;
  typeComparisonResult result = mAttribute_lkey.objectCompare (operand->mAttribute_lkey) ;
  if (kOperandEqual == result) {
    result = mAttribute_mHeaderFileName.objectCompare (operand->mAttribute_mHeaderFileName) ;
  }
  return result ;
}

//---------------------------------------------------------------------------------------------------------------------*

GALGAS_headerRepartitionMap::GALGAS_headerRepartitionMap (void) :
AC_GALGAS_map () {
}

//---------------------------------------------------------------------------------------------------------------------*

GALGAS_headerRepartitionMap::GALGAS_headerRepartitionMap (const GALGAS_headerRepartitionMap & inSource) :
AC_GALGAS_map (inSource) {
}

//---------------------------------------------------------------------------------------------------------------------*

GALGAS_headerRepartitionMap & GALGAS_headerRepartitionMap::operator = (const GALGAS_headerRepartitionMap & inSource) {
  * ((AC_GALGAS_map *) this) = inSource ;
  return * this ;
}

//---------------------------------------------------------------------------------------------------------------------*

GALGAS_headerRepartitionMap GALGAS_headerRepartitionMap::constructor_emptyMap (LOCATION_ARGS) {
  GALGAS_headerRepartitionMap result ;
  result.makeNewEmptyMap (THERE) ;
  return result ;
}

//---------------------------------------------------------------------------------------------------------------------*

GALGAS_headerRepartitionMap GALGAS_headerRepartitionMap::constructor_mapWithMapToOverride (const GALGAS_headerRepartitionMap & inMapToOverride
                                                                                           COMMA_LOCATION_ARGS) {
  GALGAS_headerRepartitionMap result ;
  result.makeNewEmptyMapWithMapToOverride (inMapToOverride COMMA_THERE) ;
  return result ;
}

//---------------------------------------------------------------------------------------------------------------------*

GALGAS_headerRepartitionMap GALGAS_headerRepartitionMap::reader_overriddenMap (C_Compiler * inCompiler
                                                                               COMMA_LOCATION_ARGS) const {
  GALGAS_headerRepartitionMap result ;
  getOverridenMap (result, inCompiler COMMA_THERE) ;
  return result ;
}

//---------------------------------------------------------------------------------------------------------------------*

void GALGAS_headerRepartitionMap::addAssign_operation (const GALGAS_lstring & inKey,
                                                       const GALGAS_string & inArgument0,
                                                       C_Compiler * inCompiler
                                                       COMMA_LOCATION_ARGS) {
  cMapElement_headerRepartitionMap * p = NULL ;
  macroMyNew (p, cMapElement_headerRepartitionMap (inKey, inArgument0 COMMA_HERE)) ;
  capCollectionElement attributes ;
  attributes.setPointer (p) ;
  macroDetachSharedObject (p) ;
  const char * kInsertErrorMessage = "@headerRepartitionMap insert error: '%K' already in map" ;
  const char * kShadowErrorMessage = "" ;
  performInsert (attributes, inCompiler, kInsertErrorMessage, kShadowErrorMessage COMMA_THERE) ;
}

//---------------------------------------------------------------------------------------------------------------------*

void GALGAS_headerRepartitionMap::modifier_insertKey (GALGAS_lstring inKey,
                                                      GALGAS_string inArgument0,
                                                      C_Compiler * inCompiler
                                                      COMMA_LOCATION_ARGS) {
  cMapElement_headerRepartitionMap * p = NULL ;
  macroMyNew (p, cMapElement_headerRepartitionMap (inKey, inArgument0 COMMA_HERE)) ;
  capCollectionElement attributes ;
  attributes.setPointer (p) ;
  macroDetachSharedObject (p) ;
  const char * kInsertErrorMessage = "the '%K' key is already declared in %L" ;
  const char * kShadowErrorMessage = "" ;
  performInsert (attributes, inCompiler, kInsertErrorMessage, kShadowErrorMessage COMMA_THERE) ;
}

//---------------------------------------------------------------------------------------------------------------------*

const char * kSearchErrorMessage_headerRepartitionMap_searchKey = "there is no '%K' key" ;

//---------------------------------------------------------------------------------------------------------------------*

void GALGAS_headerRepartitionMap::method_searchKey (GALGAS_lstring inKey,
                                                    GALGAS_string & outArgument0,
                                                    C_Compiler * inCompiler
                                                    COMMA_LOCATION_ARGS) const {
  const cMapElement_headerRepartitionMap * p = (const cMapElement_headerRepartitionMap *) performSearch (inKey,
                                                                                                           inCompiler,
                                                                                                           kSearchErrorMessage_headerRepartitionMap_searchKey
                                                                                                           COMMA_THERE) ;
  if (NULL == p) {
    outArgument0.drop () ;
  }else{
    macroValidSharedObject (p, cMapElement_headerRepartitionMap) ;
    outArgument0 = p->mAttribute_mHeaderFileName ;
  }
}

//---------------------------------------------------------------------------------------------------------------------*

GALGAS_string GALGAS_headerRepartitionMap::reader_mHeaderFileNameForKey (const GALGAS_string & inKey,
                                                                         C_Compiler * inCompiler
                                                                         COMMA_LOCATION_ARGS) const {
  const cCollectionElement * attributes = searchForReadingAttribute (inKey, inCompiler COMMA_THERE) ;
  const cMapElement_headerRepartitionMap * p = (const cMapElement_headerRepartitionMap *) attributes ;
  GALGAS_string result ;
  if (NULL != p) {
    macroValidSharedObject (p, cMapElement_headerRepartitionMap) ;
    result = p->mAttribute_mHeaderFileName ;
  }
  return result ;
}

//---------------------------------------------------------------------------------------------------------------------*

void GALGAS_headerRepartitionMap::modifier_setMHeaderFileNameForKey (GALGAS_string inAttributeValue,
                                                                     GALGAS_string inKey,
                                                                     C_Compiler * inCompiler
                                                                     COMMA_LOCATION_ARGS) {
  cCollectionElement * attributes = searchForReadWriteAttribute (inKey, inCompiler COMMA_THERE) ;
  cMapElement_headerRepartitionMap * p = (cMapElement_headerRepartitionMap *) attributes ;
  if (NULL != p) {
    macroValidSharedObject (p, cMapElement_headerRepartitionMap) ;
    p->mAttribute_mHeaderFileName = inAttributeValue ;
  }
}

//---------------------------------------------------------------------------------------------------------------------*

cMapElement_headerRepartitionMap * GALGAS_headerRepartitionMap::readWriteAccessForWithInstruction (C_Compiler * inCompiler,
                                                                                                   const GALGAS_string & inKey
                                                                                                   COMMA_LOCATION_ARGS) {
  cMapElement_headerRepartitionMap * result = (cMapElement_headerRepartitionMap *) searchForReadWriteAttribute (inKey, inCompiler COMMA_THERE) ;
  macroNullOrValidSharedObject (result, cMapElement_headerRepartitionMap) ;
  return result ;
}

//---------------------------------------------------------------------------------------------------------------------*

cEnumerator_headerRepartitionMap::cEnumerator_headerRepartitionMap (const GALGAS_headerRepartitionMap & inEnumeratedObject,
                                                                    const typeEnumerationOrder inOrder) :
cGenericAbstractEnumerator () {
  inEnumeratedObject.populateEnumerationArray (mEnumerationArray, inOrder) ;
}

//---------------------------------------------------------------------------------------------------------------------*

GALGAS_headerRepartitionMap_2D_element cEnumerator_headerRepartitionMap::current (LOCATION_ARGS) const {
  const cMapElement_headerRepartitionMap * p = (const cMapElement_headerRepartitionMap *) currentObjectPtr (THERE) ;
  macroValidSharedObject (p, cMapElement_headerRepartitionMap) ;
  return GALGAS_headerRepartitionMap_2D_element (p->mAttribute_lkey, p->mAttribute_mHeaderFileName) ;
}

//---------------------------------------------------------------------------------------------------------------------*

GALGAS_lstring cEnumerator_headerRepartitionMap::current_lkey (LOCATION_ARGS) const {
  const cMapElement * p = (const cMapElement *) currentObjectPtr (THERE) ;
  macroValidSharedObject (p, cMapElement) ;
  return p->mAttribute_lkey ;
}

//---------------------------------------------------------------------------------------------------------------------*

GALGAS_string cEnumerator_headerRepartitionMap::current_mHeaderFileName (LOCATION_ARGS) const {
  const cMapElement_headerRepartitionMap * p = (const cMapElement_headerRepartitionMap *) currentObjectPtr (THERE) ;
  macroValidSharedObject (p, cMapElement_headerRepartitionMap) ;
  return p->mAttribute_mHeaderFileName ;
}



//---------------------------------------------------------------------------------------------------------------------*
//                                                                                                                     *
//                                             @headerRepartitionMap type                                              *
//                                                                                                                     *
//---------------------------------------------------------------------------------------------------------------------*

const C_galgas_type_descriptor
kTypeDescriptor_GALGAS_headerRepartitionMap ("headerRepartitionMap",
                                             NULL) ;

//---------------------------------------------------------------------------------------------------------------------*

const C_galgas_type_descriptor * GALGAS_headerRepartitionMap::staticTypeDescriptor (void) const {
  return & kTypeDescriptor_GALGAS_headerRepartitionMap ;
}

//---------------------------------------------------------------------------------------------------------------------*

AC_GALGAS_root * GALGAS_headerRepartitionMap::clonedObject (void) const {
  AC_GALGAS_root * result = NULL ;
  if (isValid ()) {
    macroMyNew (result, GALGAS_headerRepartitionMap (*this)) ;
  }
  return result ;
}

//---------------------------------------------------------------------------------------------------------------------*

GALGAS_headerRepartitionMap GALGAS_headerRepartitionMap::extractObject (const GALGAS_object & inObject,
                                                                        C_Compiler * inCompiler
                                                                        COMMA_LOCATION_ARGS) {
  GALGAS_headerRepartitionMap result ;
  const GALGAS_headerRepartitionMap * p = (const GALGAS_headerRepartitionMap *) inObject.embeddedObject () ;
  if (NULL != p) {
    if (NULL != dynamic_cast <const GALGAS_headerRepartitionMap *> (p)) {
      result = *p ;
    }else{
      inCompiler->castError ("headerRepartitionMap", p->dynamicTypeDescriptor () COMMA_THERE) ;
    }  
  }
  return result ;
}

//---------------------------------------------------------------------------------------------------------------------*
//                                                                                                                     *
//                                                Routine 'buildHeader'                                                *
//                                                                                                                     *
//---------------------------------------------------------------------------------------------------------------------*

void routine_buildHeader (const GALGAS_headerCompositionMap constinArgument_inHeaderCompositionMap,
                          const GALGAS_string constinArgument_inHeaderFileName,
                          const GALGAS_string constinArgument_inDeclarationName,
                          GALGAS_headerRepartitionMap & ioArgument_ioHeaderRepartitionMap,
                          GALGAS_string & ioArgument_ioHeaderString,
                          C_Compiler * inCompiler
                          COMMA_UNUSED_LOCATION_ARGS) {
  const enumGalgasBool test_0 = ioArgument_ioHeaderRepartitionMap.reader_hasKey (constinArgument_inDeclarationName COMMA_SOURCE_FILE ("galgas3SemanticDeclarationCompilation.gSemantics", 481)).operator_not (SOURCE_FILE ("galgas3SemanticDeclarationCompilation.gSemantics", 481)).boolEnum () ;
  if (kBoolTrue == test_0) {
    {
    ioArgument_ioHeaderRepartitionMap.modifier_insertKey (constinArgument_inDeclarationName.reader_nowhere (SOURCE_FILE ("galgas3SemanticDeclarationCompilation.gSemantics", 482)), constinArgument_inHeaderFileName, inCompiler COMMA_SOURCE_FILE ("galgas3SemanticDeclarationCompilation.gSemantics", 482)) ;
    }
    const enumGalgasBool test_1 = constinArgument_inHeaderCompositionMap.reader_hasKey (constinArgument_inDeclarationName COMMA_SOURCE_FILE ("galgas3SemanticDeclarationCompilation.gSemantics", 483)).boolEnum () ;
    if (kBoolTrue == test_1) {
      GALGAS_stringset var_inclusionSet ;
      GALGAS_string var_headerString ;
      constinArgument_inHeaderCompositionMap.method_searchKey (constinArgument_inDeclarationName.reader_nowhere (SOURCE_FILE ("galgas3SemanticDeclarationCompilation.gSemantics", 485)), var_inclusionSet, var_headerString, inCompiler COMMA_SOURCE_FILE ("galgas3SemanticDeclarationCompilation.gSemantics", 484)) ;
      cEnumerator_stringset enumerator_21347 (var_inclusionSet, kEnumeration_up) ;
      while (enumerator_21347.hasCurrentObject ()) {
        {
        routine_buildHeader (constinArgument_inHeaderCompositionMap, constinArgument_inHeaderFileName, enumerator_21347.current_key (HERE), ioArgument_ioHeaderRepartitionMap, ioArgument_ioHeaderString, inCompiler  COMMA_SOURCE_FILE ("galgas3SemanticDeclarationCompilation.gSemantics", 491)) ;
        }
        enumerator_21347.gotoNextObject () ;
      }
      ioArgument_ioHeaderString.dotAssign_operation (var_headerString  COMMA_SOURCE_FILE ("galgas3SemanticDeclarationCompilation.gSemantics", 503)) ;
    }else if (kBoolFalse == test_1) {
      ioArgument_ioHeaderString.dotAssign_operation (GALGAS_string ("#include \"").add_operation (constinArgument_inDeclarationName, inCompiler COMMA_SOURCE_FILE ("galgas3SemanticDeclarationCompilation.gSemantics", 505)).add_operation (GALGAS_string (".h\"\n"), inCompiler COMMA_SOURCE_FILE ("galgas3SemanticDeclarationCompilation.gSemantics", 505))  COMMA_SOURCE_FILE ("galgas3SemanticDeclarationCompilation.gSemantics", 505)) ;
    }
  }
}


//---------------------------------------------------------------------------------------------------------------------*
//                                                                                                                     *
//                                      Routine 'generateFewImplementationFiles'                                       *
//                                                                                                                     *
//---------------------------------------------------------------------------------------------------------------------*

void routine_generateFewImplementationFiles (const GALGAS_unifiedTypeMap constinArgument_inUnifiedTypeMap,
                                             const GALGAS_string constinArgument_inProductDirectory,
                                             const GALGAS_semanticDeclarationSortedListForGeneration constinArgument_inSemanticDeclarationSortedListForGeneration,
                                             GALGAS_stringlist & ioArgument_ioToolProductFileList,
                                             GALGAS_stringset & ioArgument_ioAllProductFileSet,
                                             C_Compiler * inCompiler
                                             COMMA_UNUSED_LOCATION_ARGS) {
  GALGAS_bool var_useOneHugeHeader = GALGAS_bool (gOption_galgas_5F_cli_5F_options_generateOneHeader.reader_value ()) ;
  GALGAS_uint var_n = GALGAS_uint ((uint32_t) 0U) ;
  GALGAS_uint var_fileIdx = GALGAS_uint ((uint32_t) 0U) ;
  GALGAS_string var_implementationString = GALGAS_string::makeEmptyString () ;
  GALGAS_stringset var_inclusionSet = GALGAS_stringset::constructor_emptySet (SOURCE_FILE ("galgas3SemanticDeclarationCompilation.gSemantics", 526)) ;
  cEnumerator_semanticDeclarationSortedListForGeneration enumerator_22576 (constinArgument_inSemanticDeclarationSortedListForGeneration, kEnumeration_up) ;
  while (enumerator_22576.hasCurrentObject ()) {
    const enumGalgasBool test_0 = callCategoryReader_isPredefined ((const cPtr_semanticDeclarationForGeneration *) enumerator_22576.current_mDeclaration (HERE).ptr (), inCompiler COMMA_SOURCE_FILE ("galgas3SemanticDeclarationCompilation.gSemantics", 528)).operator_not (SOURCE_FILE ("galgas3SemanticDeclarationCompilation.gSemantics", 528)).boolEnum () ;
    if (kBoolTrue == test_0) {
      GALGAS_string var_code ;
      callCategoryMethod_appendSpecificImplementation ((const cPtr_semanticDeclarationForGeneration *) enumerator_22576.current_mDeclaration (HERE).ptr (), constinArgument_inUnifiedTypeMap, var_inclusionSet, var_code, inCompiler COMMA_SOURCE_FILE ("galgas3SemanticDeclarationCompilation.gSemantics", 529)) ;
      const enumGalgasBool test_1 = var_inclusionSet.reader_hasKey (GALGAS_string::makeEmptyString () COMMA_SOURCE_FILE ("galgas3SemanticDeclarationCompilation.gSemantics", 530)).boolEnum () ;
      if (kBoolTrue == test_1) {
        inCompiler->printMessage (GALGAS_string ("Empty inclusion in ").operator_concat (callCategoryReader_implementationCppFileName ((const cPtr_semanticDeclarationForGeneration *) enumerator_22576.current_mDeclaration (HERE).ptr (), inCompiler COMMA_SOURCE_FILE ("galgas3SemanticDeclarationCompilation.gSemantics", 531))  COMMA_SOURCE_FILE ("galgas3SemanticDeclarationCompilation.gSemantics", 531)).operator_concat (GALGAS_string (" cpp headers\n")  COMMA_SOURCE_FILE ("galgas3SemanticDeclarationCompilation.gSemantics", 531))  COMMA_SOURCE_FILE ("galgas3SemanticDeclarationCompilation.gSemantics", 531)) ;
      }
      var_implementationString.dotAssign_operation (var_code  COMMA_SOURCE_FILE ("galgas3SemanticDeclarationCompilation.gSemantics", 533)) ;
      var_implementationString.dotAssign_operation (callCategoryReader_appendTypeGenericImplementation ((const cPtr_semanticDeclarationForGeneration *) enumerator_22576.current_mDeclaration (HERE).ptr (), inCompiler COMMA_SOURCE_FILE ("galgas3SemanticDeclarationCompilation.gSemantics", 534))  COMMA_SOURCE_FILE ("galgas3SemanticDeclarationCompilation.gSemantics", 534)) ;
      var_n.increment_operation (inCompiler  COMMA_SOURCE_FILE ("galgas3SemanticDeclarationCompilation.gSemantics", 535)) ;
      const enumGalgasBool test_2 = GALGAS_bool (kIsEqual, var_n.objectCompare (function_definitionGroupAmount (inCompiler COMMA_SOURCE_FILE ("galgas3SemanticDeclarationCompilation.gSemantics", 536)))).boolEnum () ;
      if (kBoolTrue == test_2) {
        const enumGalgasBool test_3 = var_useOneHugeHeader.boolEnum () ;
        if (kBoolTrue == test_3) {
          var_inclusionSet = GALGAS_stringset::constructor_setWithString (GALGAS_string ("all-declarations")  COMMA_SOURCE_FILE ("galgas3SemanticDeclarationCompilation.gSemantics", 538)) ;
        }
        GALGAS_string var_header = GALGAS_string (filewrapperTemplate_semanticFileGenerationTemplate_semanticFileImplementation (inCompiler, var_inclusionSet.reader_stringList (SOURCE_FILE ("galgas3SemanticDeclarationCompilation.gSemantics", 546)) COMMA_SOURCE_FILE ("galgas3SemanticDeclarationCompilation.gSemantics", 545))) ;
        GALGAS_string var_fileName = GALGAS_string ("all-declarations-").operator_concat (var_fileIdx.reader_string (SOURCE_FILE ("galgas3SemanticDeclarationCompilation.gSemantics", 548))  COMMA_SOURCE_FILE ("galgas3SemanticDeclarationCompilation.gSemantics", 548)).operator_concat (GALGAS_string (".cpp")  COMMA_SOURCE_FILE ("galgas3SemanticDeclarationCompilation.gSemantics", 548)) ;
        ioArgument_ioToolProductFileList = GALGAS_stringlist::constructor_listWithValue (var_fileName  COMMA_SOURCE_FILE ("galgas3SemanticDeclarationCompilation.gSemantics", 549)).add_operation (ioArgument_ioToolProductFileList, inCompiler COMMA_SOURCE_FILE ("galgas3SemanticDeclarationCompilation.gSemantics", 549)) ;
        ioArgument_ioAllProductFileSet.addAssign_operation (var_fileName  COMMA_SOURCE_FILE ("galgas3SemanticDeclarationCompilation.gSemantics", 550)) ;
        {
        GALGAS_string::class_method_generateFile (constinArgument_inProductDirectory, var_fileName, var_header.add_operation (var_implementationString, inCompiler COMMA_SOURCE_FILE ("galgas3SemanticDeclarationCompilation.gSemantics", 554)), inCompiler COMMA_SOURCE_FILE ("galgas3SemanticDeclarationCompilation.gSemantics", 551)) ;
        }
        var_n = GALGAS_uint ((uint32_t) 0U) ;
        var_fileIdx.increment_operation (inCompiler  COMMA_SOURCE_FILE ("galgas3SemanticDeclarationCompilation.gSemantics", 557)) ;
        var_implementationString = GALGAS_string::makeEmptyString () ;
        var_inclusionSet = GALGAS_stringset::constructor_emptySet (SOURCE_FILE ("galgas3SemanticDeclarationCompilation.gSemantics", 559)) ;
      }
    }
    enumerator_22576.gotoNextObject () ;
  }
  const enumGalgasBool test_4 = GALGAS_bool (kIsNotEqual, var_implementationString.objectCompare (GALGAS_string::makeEmptyString ())).boolEnum () ;
  if (kBoolTrue == test_4) {
    const enumGalgasBool test_5 = var_useOneHugeHeader.boolEnum () ;
    if (kBoolTrue == test_5) {
      var_inclusionSet = GALGAS_stringset::constructor_setWithString (GALGAS_string ("all-declarations")  COMMA_SOURCE_FILE ("galgas3SemanticDeclarationCompilation.gSemantics", 566)) ;
    }
    GALGAS_string var_header = GALGAS_string (filewrapperTemplate_semanticFileGenerationTemplate_semanticFileImplementation (inCompiler, var_inclusionSet.reader_stringList (SOURCE_FILE ("galgas3SemanticDeclarationCompilation.gSemantics", 573)) COMMA_SOURCE_FILE ("galgas3SemanticDeclarationCompilation.gSemantics", 571))) ;
    GALGAS_string var_fileName = GALGAS_string ("all-declarations-").operator_concat (var_fileIdx.reader_string (SOURCE_FILE ("galgas3SemanticDeclarationCompilation.gSemantics", 575))  COMMA_SOURCE_FILE ("galgas3SemanticDeclarationCompilation.gSemantics", 575)).operator_concat (GALGAS_string (".cpp")  COMMA_SOURCE_FILE ("galgas3SemanticDeclarationCompilation.gSemantics", 575)) ;
    ioArgument_ioToolProductFileList = GALGAS_stringlist::constructor_listWithValue (var_fileName  COMMA_SOURCE_FILE ("galgas3SemanticDeclarationCompilation.gSemantics", 576)).add_operation (ioArgument_ioToolProductFileList, inCompiler COMMA_SOURCE_FILE ("galgas3SemanticDeclarationCompilation.gSemantics", 576)) ;
    ioArgument_ioAllProductFileSet.addAssign_operation (var_fileName  COMMA_SOURCE_FILE ("galgas3SemanticDeclarationCompilation.gSemantics", 577)) ;
    {
    GALGAS_string::class_method_generateFile (constinArgument_inProductDirectory, var_fileName, var_header.add_operation (var_implementationString, inCompiler COMMA_SOURCE_FILE ("galgas3SemanticDeclarationCompilation.gSemantics", 581)), inCompiler COMMA_SOURCE_FILE ("galgas3SemanticDeclarationCompilation.gSemantics", 578)) ;
    }
  }
}


//---------------------------------------------------------------------------------------------------------------------*
//                                                                                                                     *
//                               Routine 'generateFewImplementationFilesWithFewHeaders'                                *
//                                                                                                                     *
//---------------------------------------------------------------------------------------------------------------------*

void routine_generateFewImplementationFilesWithFewHeaders (const GALGAS_unifiedTypeMap constinArgument_inUnifiedTypeMap,
                                                           const GALGAS_string constinArgument_inProductDirectory,
                                                           const GALGAS_semanticDeclarationSortedListForGeneration constinArgument_inSemanticDeclarationSortedListForGeneration,
                                                           GALGAS_stringlist & ioArgument_ioToolProductFileList,
                                                           GALGAS_stringset & ioArgument_ioAllProductFileSet,
                                                           C_Compiler * inCompiler
                                                           COMMA_UNUSED_LOCATION_ARGS) {
  GALGAS_bool var_useOneHugeHeader = GALGAS_bool (gOption_galgas_5F_cli_5F_options_generateOneHeader.reader_value ()) ;
  GALGAS_headerCompositionMap var_headerCompositionMap = GALGAS_headerCompositionMap::constructor_emptyMap (SOURCE_FILE ("galgas3SemanticDeclarationCompilation.gSemantics", 596)) ;
  cEnumerator_semanticDeclarationSortedListForGeneration enumerator_25486 (constinArgument_inSemanticDeclarationSortedListForGeneration, kEnumeration_up) ;
  while (enumerator_25486.hasCurrentObject ()) {
    const enumGalgasBool test_0 = callCategoryReader_isPredefined ((const cPtr_semanticDeclarationForGeneration *) enumerator_25486.current_mDeclaration (HERE).ptr (), inCompiler COMMA_SOURCE_FILE ("galgas3SemanticDeclarationCompilation.gSemantics", 598)).operator_not (SOURCE_FILE ("galgas3SemanticDeclarationCompilation.gSemantics", 598)).boolEnum () ;
    if (kBoolTrue == test_0) {
      GALGAS_stringset var_inclusionSet_31_ = GALGAS_stringset::constructor_emptySet (SOURCE_FILE ("galgas3SemanticDeclarationCompilation.gSemantics", 599)) ;
      GALGAS_string var_headerString_31_ ;
      callCategoryMethod_appendDeclaration_31_ ((const cPtr_semanticDeclarationForGeneration *) enumerator_25486.current_mDeclaration (HERE).ptr (), var_inclusionSet_31_, var_headerString_31_, inCompiler COMMA_SOURCE_FILE ("galgas3SemanticDeclarationCompilation.gSemantics", 600)) ;
      GALGAS_stringset var_inclusionSet_32_ = GALGAS_stringset::constructor_emptySet (SOURCE_FILE ("galgas3SemanticDeclarationCompilation.gSemantics", 601)) ;
      GALGAS_string var_headerString_32_ ;
      callCategoryMethod_appendDeclaration_32_ ((const cPtr_semanticDeclarationForGeneration *) enumerator_25486.current_mDeclaration (HERE).ptr (), GALGAS_bool (true), constinArgument_inProductDirectory, var_inclusionSet_32_, var_headerString_32_, inCompiler COMMA_SOURCE_FILE ("galgas3SemanticDeclarationCompilation.gSemantics", 602)) ;
      const enumGalgasBool test_1 = GALGAS_bool (kIsNotEqual, callCategoryReader_headerKind ((const cPtr_semanticDeclarationForGeneration *) enumerator_25486.current_mDeclaration (HERE).ptr (), inCompiler COMMA_SOURCE_FILE ("galgas3SemanticDeclarationCompilation.gSemantics", 603)).objectCompare (GALGAS_headerKind::constructor_noHeader (SOURCE_FILE ("galgas3SemanticDeclarationCompilation.gSemantics", 603)))).boolEnum () ;
      if (kBoolTrue == test_1) {
        GALGAS_string temp_2 ;
        const enumGalgasBool test_3 = GALGAS_bool (kIsEqual, callCategoryReader_headerKind ((const cPtr_semanticDeclarationForGeneration *) enumerator_25486.current_mDeclaration (HERE).ptr (), inCompiler COMMA_SOURCE_FILE ("galgas3SemanticDeclarationCompilation.gSemantics", 604)).objectCompare (GALGAS_headerKind::constructor_twoHeaders (SOURCE_FILE ("galgas3SemanticDeclarationCompilation.gSemantics", 604)))).boolEnum () ;
        if (kBoolTrue == test_3) {
          temp_2 = GALGAS_string ("-1") ;
        }else if (kBoolFalse == test_3) {
          temp_2 = GALGAS_string::makeEmptyString () ;
        }
        GALGAS_string var_headerFileName = callCategoryReader_implementationCppFileName ((const cPtr_semanticDeclarationForGeneration *) enumerator_25486.current_mDeclaration (HERE).ptr (), inCompiler COMMA_SOURCE_FILE ("galgas3SemanticDeclarationCompilation.gSemantics", 604)).add_operation (temp_2, inCompiler COMMA_SOURCE_FILE ("galgas3SemanticDeclarationCompilation.gSemantics", 604)) ;
        {
        var_headerCompositionMap.modifier_insertKey (var_headerFileName.reader_nowhere (SOURCE_FILE ("galgas3SemanticDeclarationCompilation.gSemantics", 606)), var_inclusionSet_31_, var_headerString_31_, inCompiler COMMA_SOURCE_FILE ("galgas3SemanticDeclarationCompilation.gSemantics", 605)) ;
        }
      }
      const enumGalgasBool test_4 = GALGAS_bool (kIsEqual, callCategoryReader_headerKind ((const cPtr_semanticDeclarationForGeneration *) enumerator_25486.current_mDeclaration (HERE).ptr (), inCompiler COMMA_SOURCE_FILE ("galgas3SemanticDeclarationCompilation.gSemantics", 611)).objectCompare (GALGAS_headerKind::constructor_twoHeaders (SOURCE_FILE ("galgas3SemanticDeclarationCompilation.gSemantics", 611)))).boolEnum () ;
      if (kBoolTrue == test_4) {
        {
        GALGAS_stringset temp_5 = GALGAS_stringset::constructor_emptySet (SOURCE_FILE ("galgas3SemanticDeclarationCompilation.gSemantics", 614)) ;
        temp_5.addAssign_operation (callCategoryReader_implementationCppFileName ((const cPtr_semanticDeclarationForGeneration *) enumerator_25486.current_mDeclaration (HERE).ptr (), inCompiler COMMA_SOURCE_FILE ("galgas3SemanticDeclarationCompilation.gSemantics", 614)).add_operation (GALGAS_string ("-1"), inCompiler COMMA_SOURCE_FILE ("galgas3SemanticDeclarationCompilation.gSemantics", 614))  COMMA_SOURCE_FILE ("galgas3SemanticDeclarationCompilation.gSemantics", 614)) ;
        var_headerCompositionMap.modifier_insertKey (callCategoryReader_implementationCppFileName ((const cPtr_semanticDeclarationForGeneration *) enumerator_25486.current_mDeclaration (HERE).ptr (), inCompiler COMMA_SOURCE_FILE ("galgas3SemanticDeclarationCompilation.gSemantics", 613)).reader_nowhere (SOURCE_FILE ("galgas3SemanticDeclarationCompilation.gSemantics", 613)), var_inclusionSet_32_.operator_or (temp_5 COMMA_SOURCE_FILE ("galgas3SemanticDeclarationCompilation.gSemantics", 614)), var_headerString_32_, inCompiler COMMA_SOURCE_FILE ("galgas3SemanticDeclarationCompilation.gSemantics", 612)) ;
        }
      }
    }
    enumerator_25486.gotoNextObject () ;
  }
  GALGAS_headerRepartitionMap var_headerRepartitionMap = GALGAS_headerRepartitionMap::constructor_emptyMap (SOURCE_FILE ("galgas3SemanticDeclarationCompilation.gSemantics", 621)) ;
  GALGAS_uint var_fileIdx = GALGAS_uint ((uint32_t) 0U) ;
  GALGAS_string var_implementationString = GALGAS_string::makeEmptyString () ;
  GALGAS_string var_headerString = GALGAS_string::makeEmptyString () ;
  GALGAS_stringset var_inclusionSet = GALGAS_stringset::constructor_emptySet (SOURCE_FILE ("galgas3SemanticDeclarationCompilation.gSemantics", 625)) ;
  GALGAS_string var_headerFileName = GALGAS_string ("all-declarations-").add_operation (var_fileIdx.reader_string (SOURCE_FILE ("galgas3SemanticDeclarationCompilation.gSemantics", 626)), inCompiler COMMA_SOURCE_FILE ("galgas3SemanticDeclarationCompilation.gSemantics", 626)) ;
  cEnumerator_semanticDeclarationSortedListForGeneration enumerator_26861 (constinArgument_inSemanticDeclarationSortedListForGeneration, kEnumeration_up) ;
  while (enumerator_26861.hasCurrentObject ()) {
    const enumGalgasBool test_6 = callCategoryReader_isPredefined ((const cPtr_semanticDeclarationForGeneration *) enumerator_26861.current_mDeclaration (HERE).ptr (), inCompiler COMMA_SOURCE_FILE ("galgas3SemanticDeclarationCompilation.gSemantics", 628)).operator_not (SOURCE_FILE ("galgas3SemanticDeclarationCompilation.gSemantics", 628)).boolEnum () ;
    if (kBoolTrue == test_6) {
      const enumGalgasBool test_7 = callCategoryReader_isPredefined ((const cPtr_semanticDeclarationForGeneration *) enumerator_26861.current_mDeclaration (HERE).ptr (), inCompiler COMMA_SOURCE_FILE ("galgas3SemanticDeclarationCompilation.gSemantics", 629)).operator_not (SOURCE_FILE ("galgas3SemanticDeclarationCompilation.gSemantics", 629)).boolEnum () ;
      if (kBoolTrue == test_7) {
        const enumGalgasBool test_8 = GALGAS_bool (kIsEqual, callCategoryReader_headerKind ((const cPtr_semanticDeclarationForGeneration *) enumerator_26861.current_mDeclaration (HERE).ptr (), inCompiler COMMA_SOURCE_FILE ("galgas3SemanticDeclarationCompilation.gSemantics", 630)).objectCompare (GALGAS_headerKind::constructor_twoHeaders (SOURCE_FILE ("galgas3SemanticDeclarationCompilation.gSemantics", 630)))).boolEnum () ;
        if (kBoolTrue == test_8) {
          {
          routine_buildHeader (var_headerCompositionMap, var_headerFileName, callCategoryReader_implementationCppFileName ((const cPtr_semanticDeclarationForGeneration *) enumerator_26861.current_mDeclaration (HERE).ptr (), inCompiler COMMA_SOURCE_FILE ("galgas3SemanticDeclarationCompilation.gSemantics", 631)).add_operation (GALGAS_string ("-1"), inCompiler COMMA_SOURCE_FILE ("galgas3SemanticDeclarationCompilation.gSemantics", 631)), var_headerRepartitionMap, var_headerString, inCompiler  COMMA_SOURCE_FILE ("galgas3SemanticDeclarationCompilation.gSemantics", 631)) ;
          }
          {
          routine_buildHeader (var_headerCompositionMap, var_headerFileName, callCategoryReader_implementationCppFileName ((const cPtr_semanticDeclarationForGeneration *) enumerator_26861.current_mDeclaration (HERE).ptr (), inCompiler COMMA_SOURCE_FILE ("galgas3SemanticDeclarationCompilation.gSemantics", 632)), var_headerRepartitionMap, var_headerString, inCompiler  COMMA_SOURCE_FILE ("galgas3SemanticDeclarationCompilation.gSemantics", 632)) ;
          }
        }else if (kBoolFalse == test_8) {
          const enumGalgasBool test_9 = GALGAS_bool (kIsEqual, callCategoryReader_headerKind ((const cPtr_semanticDeclarationForGeneration *) enumerator_26861.current_mDeclaration (HERE).ptr (), inCompiler COMMA_SOURCE_FILE ("galgas3SemanticDeclarationCompilation.gSemantics", 633)).objectCompare (GALGAS_headerKind::constructor_oneHeader (SOURCE_FILE ("galgas3SemanticDeclarationCompilation.gSemantics", 633)))).boolEnum () ;
          if (kBoolTrue == test_9) {
            {
            routine_buildHeader (var_headerCompositionMap, var_headerFileName, callCategoryReader_implementationCppFileName ((const cPtr_semanticDeclarationForGeneration *) enumerator_26861.current_mDeclaration (HERE).ptr (), inCompiler COMMA_SOURCE_FILE ("galgas3SemanticDeclarationCompilation.gSemantics", 634)), var_headerRepartitionMap, var_headerString, inCompiler  COMMA_SOURCE_FILE ("galgas3SemanticDeclarationCompilation.gSemantics", 634)) ;
            }
          }
        }
      }
      GALGAS_string var_code ;
      callCategoryMethod_appendSpecificImplementation ((const cPtr_semanticDeclarationForGeneration *) enumerator_26861.current_mDeclaration (HERE).ptr (), constinArgument_inUnifiedTypeMap, var_inclusionSet, var_code, inCompiler COMMA_SOURCE_FILE ("galgas3SemanticDeclarationCompilation.gSemantics", 637)) ;
      cEnumerator_stringset enumerator_27690 (var_inclusionSet, kEnumeration_up) ;
      while (enumerator_27690.hasCurrentObject ()) {
        {
        routine_buildHeader (var_headerCompositionMap, var_headerFileName, enumerator_27690.current_key (HERE), var_headerRepartitionMap, var_headerString, inCompiler  COMMA_SOURCE_FILE ("galgas3SemanticDeclarationCompilation.gSemantics", 639)) ;
        }
        enumerator_27690.gotoNextObject () ;
      }
      var_implementationString.dotAssign_operation (var_code  COMMA_SOURCE_FILE ("galgas3SemanticDeclarationCompilation.gSemantics", 641)) ;
      var_implementationString.dotAssign_operation (callCategoryReader_appendTypeGenericImplementation ((const cPtr_semanticDeclarationForGeneration *) enumerator_26861.current_mDeclaration (HERE).ptr (), inCompiler COMMA_SOURCE_FILE ("galgas3SemanticDeclarationCompilation.gSemantics", 642))  COMMA_SOURCE_FILE ("galgas3SemanticDeclarationCompilation.gSemantics", 642)) ;
      const enumGalgasBool test_10 = GALGAS_bool (kIsStrictSup, var_implementationString.reader_length (SOURCE_FILE ("galgas3SemanticDeclarationCompilation.gSemantics", 643)).objectCompare (GALGAS_uint ((uint32_t) 1000000U))).boolEnum () ;
      if (kBoolTrue == test_10) {
        const enumGalgasBool test_11 = var_useOneHugeHeader.boolEnum () ;
        if (kBoolTrue == test_11) {
          var_inclusionSet = GALGAS_stringset::constructor_setWithString (GALGAS_string ("all-declarations")  COMMA_SOURCE_FILE ("galgas3SemanticDeclarationCompilation.gSemantics", 645)) ;
        }else if (kBoolFalse == test_11) {
          GALGAS_stringset temp_12 = GALGAS_stringset::constructor_emptySet (SOURCE_FILE ("galgas3SemanticDeclarationCompilation.gSemantics", 648)) ;
          temp_12.addAssign_operation (GALGAS_string ("all-declarations-").operator_concat (var_fileIdx.reader_string (SOURCE_FILE ("galgas3SemanticDeclarationCompilation.gSemantics", 648))  COMMA_SOURCE_FILE ("galgas3SemanticDeclarationCompilation.gSemantics", 648))  COMMA_SOURCE_FILE ("galgas3SemanticDeclarationCompilation.gSemantics", 648)) ;
          var_inclusionSet = temp_12 ;
        }
        GALGAS_string var_cppHeader = GALGAS_string (filewrapperTemplate_semanticFileGenerationTemplate_semanticFileImplementation (inCompiler, var_inclusionSet.reader_stringList (SOURCE_FILE ("galgas3SemanticDeclarationCompilation.gSemantics", 655)) COMMA_SOURCE_FILE ("galgas3SemanticDeclarationCompilation.gSemantics", 654))) ;
        GALGAS_string var_fileName = GALGAS_string ("all-declarations-").operator_concat (var_fileIdx.reader_string (SOURCE_FILE ("galgas3SemanticDeclarationCompilation.gSemantics", 657))  COMMA_SOURCE_FILE ("galgas3SemanticDeclarationCompilation.gSemantics", 657)).operator_concat (GALGAS_string (".cpp")  COMMA_SOURCE_FILE ("galgas3SemanticDeclarationCompilation.gSemantics", 657)) ;
        ioArgument_ioToolProductFileList = GALGAS_stringlist::constructor_listWithValue (var_fileName  COMMA_SOURCE_FILE ("galgas3SemanticDeclarationCompilation.gSemantics", 658)).add_operation (ioArgument_ioToolProductFileList, inCompiler COMMA_SOURCE_FILE ("galgas3SemanticDeclarationCompilation.gSemantics", 658)) ;
        ioArgument_ioAllProductFileSet.addAssign_operation (var_fileName  COMMA_SOURCE_FILE ("galgas3SemanticDeclarationCompilation.gSemantics", 659)) ;
        {
        GALGAS_string::class_method_generateFile (constinArgument_inProductDirectory, var_fileName, var_cppHeader.add_operation (var_implementationString, inCompiler COMMA_SOURCE_FILE ("galgas3SemanticDeclarationCompilation.gSemantics", 663)), inCompiler COMMA_SOURCE_FILE ("galgas3SemanticDeclarationCompilation.gSemantics", 660)) ;
        }
        ioArgument_ioAllProductFileSet.addAssign_operation (var_headerFileName.add_operation (GALGAS_string (".h"), inCompiler COMMA_SOURCE_FILE ("galgas3SemanticDeclarationCompilation.gSemantics", 666))  COMMA_SOURCE_FILE ("galgas3SemanticDeclarationCompilation.gSemantics", 666)) ;
        GALGAS_stringlist temp_13 ;
        const enumGalgasBool test_14 = GALGAS_bool (kIsEqual, var_fileIdx.objectCompare (GALGAS_uint ((uint32_t) 0U))).boolEnum () ;
        if (kBoolTrue == test_14) {
          temp_13 = GALGAS_stringlist::constructor_emptyList (SOURCE_FILE ("galgas3SemanticDeclarationCompilation.gSemantics", 669)) ;
        }else if (kBoolFalse == test_14) {
          GALGAS_stringlist temp_15 = GALGAS_stringlist::constructor_emptyList (SOURCE_FILE ("galgas3SemanticDeclarationCompilation.gSemantics", 669)) ;
          temp_15.addAssign_operation (GALGAS_string ("all-declarations-").add_operation (var_fileIdx.substract_operation (GALGAS_uint ((uint32_t) 1U), inCompiler COMMA_SOURCE_FILE ("galgas3SemanticDeclarationCompilation.gSemantics", 669)).reader_string (SOURCE_FILE ("galgas3SemanticDeclarationCompilation.gSemantics", 669)), inCompiler COMMA_SOURCE_FILE ("galgas3SemanticDeclarationCompilation.gSemantics", 669))  COMMA_SOURCE_FILE ("galgas3SemanticDeclarationCompilation.gSemantics", 669)) ;
          temp_13 = temp_15 ;
        }
        GALGAS_string var_startOfHeader = GALGAS_string (filewrapperTemplate_semanticFileGenerationTemplate_semanticFileHeader (inCompiler, var_headerFileName, temp_13 COMMA_SOURCE_FILE ("galgas3SemanticDeclarationCompilation.gSemantics", 667))) ;
        {
        GALGAS_string::class_method_generateFile (constinArgument_inProductDirectory, var_headerFileName.add_operation (GALGAS_string (".h"), inCompiler COMMA_SOURCE_FILE ("galgas3SemanticDeclarationCompilation.gSemantics", 673)), var_startOfHeader.add_operation (var_headerString, inCompiler COMMA_SOURCE_FILE ("galgas3SemanticDeclarationCompilation.gSemantics", 674)).add_operation (GALGAS_string ("#endif\n"), inCompiler COMMA_SOURCE_FILE ("galgas3SemanticDeclarationCompilation.gSemantics", 674)), inCompiler COMMA_SOURCE_FILE ("galgas3SemanticDeclarationCompilation.gSemantics", 671)) ;
        }
        var_fileIdx.increment_operation (inCompiler  COMMA_SOURCE_FILE ("galgas3SemanticDeclarationCompilation.gSemantics", 677)) ;
        var_implementationString = GALGAS_string::makeEmptyString () ;
        var_headerString = GALGAS_string::makeEmptyString () ;
        var_headerFileName = GALGAS_string ("all-declarations-").add_operation (var_fileIdx.reader_string (SOURCE_FILE ("galgas3SemanticDeclarationCompilation.gSemantics", 680)), inCompiler COMMA_SOURCE_FILE ("galgas3SemanticDeclarationCompilation.gSemantics", 680)) ;
        var_inclusionSet = GALGAS_stringset::constructor_emptySet (SOURCE_FILE ("galgas3SemanticDeclarationCompilation.gSemantics", 681)) ;
      }
    }
    enumerator_26861.gotoNextObject () ;
  }
  const enumGalgasBool test_16 = GALGAS_bool (kIsNotEqual, var_implementationString.objectCompare (GALGAS_string::makeEmptyString ())).boolEnum () ;
  if (kBoolTrue == test_16) {
    const enumGalgasBool test_17 = var_useOneHugeHeader.boolEnum () ;
    if (kBoolTrue == test_17) {
      var_inclusionSet = GALGAS_stringset::constructor_setWithString (GALGAS_string ("all-declarations")  COMMA_SOURCE_FILE ("galgas3SemanticDeclarationCompilation.gSemantics", 689)) ;
    }
    GALGAS_stringlist temp_18 = GALGAS_stringlist::constructor_emptyList (SOURCE_FILE ("galgas3SemanticDeclarationCompilation.gSemantics", 696)) ;
    temp_18.addAssign_operation (GALGAS_string ("all-declarations-").operator_concat (var_fileIdx.reader_string (SOURCE_FILE ("galgas3SemanticDeclarationCompilation.gSemantics", 696))  COMMA_SOURCE_FILE ("galgas3SemanticDeclarationCompilation.gSemantics", 696))  COMMA_SOURCE_FILE ("galgas3SemanticDeclarationCompilation.gSemantics", 696)) ;
    GALGAS_string var_header = GALGAS_string (filewrapperTemplate_semanticFileGenerationTemplate_semanticFileImplementation (inCompiler, temp_18 COMMA_SOURCE_FILE ("galgas3SemanticDeclarationCompilation.gSemantics", 694))) ;
    GALGAS_string var_fileName = GALGAS_string ("all-declarations-").operator_concat (var_fileIdx.reader_string (SOURCE_FILE ("galgas3SemanticDeclarationCompilation.gSemantics", 698))  COMMA_SOURCE_FILE ("galgas3SemanticDeclarationCompilation.gSemantics", 698)).operator_concat (GALGAS_string (".cpp")  COMMA_SOURCE_FILE ("galgas3SemanticDeclarationCompilation.gSemantics", 698)) ;
    ioArgument_ioToolProductFileList = GALGAS_stringlist::constructor_listWithValue (var_fileName  COMMA_SOURCE_FILE ("galgas3SemanticDeclarationCompilation.gSemantics", 699)).add_operation (ioArgument_ioToolProductFileList, inCompiler COMMA_SOURCE_FILE ("galgas3SemanticDeclarationCompilation.gSemantics", 699)) ;
    ioArgument_ioAllProductFileSet.addAssign_operation (var_fileName  COMMA_SOURCE_FILE ("galgas3SemanticDeclarationCompilation.gSemantics", 700)) ;
    {
    GALGAS_string::class_method_generateFile (constinArgument_inProductDirectory, var_fileName, var_header.add_operation (var_implementationString, inCompiler COMMA_SOURCE_FILE ("galgas3SemanticDeclarationCompilation.gSemantics", 704)), inCompiler COMMA_SOURCE_FILE ("galgas3SemanticDeclarationCompilation.gSemantics", 701)) ;
    }
    ioArgument_ioAllProductFileSet.addAssign_operation (var_headerFileName.add_operation (GALGAS_string (".h"), inCompiler COMMA_SOURCE_FILE ("galgas3SemanticDeclarationCompilation.gSemantics", 707))  COMMA_SOURCE_FILE ("galgas3SemanticDeclarationCompilation.gSemantics", 707)) ;
    GALGAS_stringlist temp_19 ;
    const enumGalgasBool test_20 = GALGAS_bool (kIsEqual, var_fileIdx.objectCompare (GALGAS_uint ((uint32_t) 0U))).boolEnum () ;
    if (kBoolTrue == test_20) {
      temp_19 = GALGAS_stringlist::constructor_emptyList (SOURCE_FILE ("galgas3SemanticDeclarationCompilation.gSemantics", 710)) ;
    }else if (kBoolFalse == test_20) {
      GALGAS_stringlist temp_21 = GALGAS_stringlist::constructor_emptyList (SOURCE_FILE ("galgas3SemanticDeclarationCompilation.gSemantics", 710)) ;
      temp_21.addAssign_operation (GALGAS_string ("all-declarations-").add_operation (var_fileIdx.substract_operation (GALGAS_uint ((uint32_t) 1U), inCompiler COMMA_SOURCE_FILE ("galgas3SemanticDeclarationCompilation.gSemantics", 710)).reader_string (SOURCE_FILE ("galgas3SemanticDeclarationCompilation.gSemantics", 710)), inCompiler COMMA_SOURCE_FILE ("galgas3SemanticDeclarationCompilation.gSemantics", 710))  COMMA_SOURCE_FILE ("galgas3SemanticDeclarationCompilation.gSemantics", 710)) ;
      temp_19 = temp_21 ;
    }
    GALGAS_string var_startOfHeader = GALGAS_string (filewrapperTemplate_semanticFileGenerationTemplate_semanticFileHeader (inCompiler, var_headerFileName, temp_19 COMMA_SOURCE_FILE ("galgas3SemanticDeclarationCompilation.gSemantics", 708))) ;
    {
    GALGAS_string::class_method_generateFile (constinArgument_inProductDirectory, var_headerFileName.add_operation (GALGAS_string (".h"), inCompiler COMMA_SOURCE_FILE ("galgas3SemanticDeclarationCompilation.gSemantics", 714)), var_startOfHeader.add_operation (var_headerString, inCompiler COMMA_SOURCE_FILE ("galgas3SemanticDeclarationCompilation.gSemantics", 715)).add_operation (GALGAS_string ("#endif\n"), inCompiler COMMA_SOURCE_FILE ("galgas3SemanticDeclarationCompilation.gSemantics", 715)), inCompiler COMMA_SOURCE_FILE ("galgas3SemanticDeclarationCompilation.gSemantics", 712)) ;
    }
  }
  ioArgument_ioAllProductFileSet.addAssign_operation (GALGAS_string ("all-declarations.h")  COMMA_SOURCE_FILE ("galgas3SemanticDeclarationCompilation.gSemantics", 719)) ;
  GALGAS_stringlist temp_22 = GALGAS_stringlist::constructor_emptyList (SOURCE_FILE ("galgas3SemanticDeclarationCompilation.gSemantics", 722)) ;
  temp_22.addAssign_operation (GALGAS_string ("all-declarations-").add_operation (var_fileIdx.reader_string (SOURCE_FILE ("galgas3SemanticDeclarationCompilation.gSemantics", 722)), inCompiler COMMA_SOURCE_FILE ("galgas3SemanticDeclarationCompilation.gSemantics", 722))  COMMA_SOURCE_FILE ("galgas3SemanticDeclarationCompilation.gSemantics", 722)) ;
  GALGAS_string var_startOfAllDeclarationsHeader = GALGAS_string (filewrapperTemplate_semanticFileGenerationTemplate_semanticFileHeader (inCompiler, GALGAS_string ("all-declarations"), temp_22 COMMA_SOURCE_FILE ("galgas3SemanticDeclarationCompilation.gSemantics", 720))) ;
  {
  GALGAS_string::class_method_generateFile (constinArgument_inProductDirectory, GALGAS_string ("all-declarations.h"), var_startOfAllDeclarationsHeader.add_operation (GALGAS_string ("#endif\n"), inCompiler COMMA_SOURCE_FILE ("galgas3SemanticDeclarationCompilation.gSemantics", 727)), inCompiler COMMA_SOURCE_FILE ("galgas3SemanticDeclarationCompilation.gSemantics", 724)) ;
  }
}


//---------------------------------------------------------------------------------------------------------------------*
//                                                                                                                     *
//                                      Routine 'generateManyImplementationFiles'                                      *
//                                                                                                                     *
//---------------------------------------------------------------------------------------------------------------------*

void routine_generateManyImplementationFiles (const GALGAS_unifiedTypeMap constinArgument_inUnifiedTypeMap,
                                              const GALGAS_string constinArgument_inProductDirectory,
                                              const GALGAS_semanticDeclarationSortedListForGeneration constinArgument_inSemanticDeclarationSortedListForGeneration,
                                              GALGAS_stringlist & ioArgument_ioToolProductFileList,
                                              GALGAS_stringset & ioArgument_ioAllProductFileSet,
                                              C_Compiler * inCompiler
                                              COMMA_UNUSED_LOCATION_ARGS) {
  GALGAS_bool var_useOneHugeHeader = GALGAS_bool (gOption_galgas_5F_cli_5F_options_generateOneHeader.reader_value ()) ;
  cEnumerator_semanticDeclarationSortedListForGeneration enumerator_31763 (constinArgument_inSemanticDeclarationSortedListForGeneration, kEnumeration_up) ;
  while (enumerator_31763.hasCurrentObject ()) {
    GALGAS_stringset var_inclusionSet = GALGAS_stringset::constructor_emptySet (SOURCE_FILE ("galgas3SemanticDeclarationCompilation.gSemantics", 742)) ;
    const enumGalgasBool test_0 = callCategoryReader_isPredefined ((const cPtr_semanticDeclarationForGeneration *) enumerator_31763.current_mDeclaration (HERE).ptr (), inCompiler COMMA_SOURCE_FILE ("galgas3SemanticDeclarationCompilation.gSemantics", 743)).operator_not (SOURCE_FILE ("galgas3SemanticDeclarationCompilation.gSemantics", 743)).boolEnum () ;
    if (kBoolTrue == test_0) {
      GALGAS_string var_implementationString ;
      callCategoryMethod_appendSpecificImplementation ((const cPtr_semanticDeclarationForGeneration *) enumerator_31763.current_mDeclaration (HERE).ptr (), constinArgument_inUnifiedTypeMap, var_inclusionSet, var_implementationString, inCompiler COMMA_SOURCE_FILE ("galgas3SemanticDeclarationCompilation.gSemantics", 744)) ;
      const enumGalgasBool test_1 = callCategoryReader_hasCppHeaderFile ((const cPtr_semanticDeclarationForGeneration *) enumerator_31763.current_mDeclaration (HERE).ptr (), inCompiler COMMA_SOURCE_FILE ("galgas3SemanticDeclarationCompilation.gSemantics", 745)).boolEnum () ;
      if (kBoolTrue == test_1) {
        var_inclusionSet.addAssign_operation (callCategoryReader_implementationCppFileName ((const cPtr_semanticDeclarationForGeneration *) enumerator_31763.current_mDeclaration (HERE).ptr (), inCompiler COMMA_SOURCE_FILE ("galgas3SemanticDeclarationCompilation.gSemantics", 746))  COMMA_SOURCE_FILE ("galgas3SemanticDeclarationCompilation.gSemantics", 746)) ;
      }
      const enumGalgasBool test_2 = var_useOneHugeHeader.boolEnum () ;
      if (kBoolTrue == test_2) {
        var_inclusionSet = GALGAS_stringset::constructor_setWithString (GALGAS_string ("all-declarations")  COMMA_SOURCE_FILE ("galgas3SemanticDeclarationCompilation.gSemantics", 749)) ;
      }
      GALGAS_string var_header = GALGAS_string (filewrapperTemplate_semanticFileGenerationTemplate_semanticFileImplementation (inCompiler, var_inclusionSet.reader_stringList (SOURCE_FILE ("galgas3SemanticDeclarationCompilation.gSemantics", 755)) COMMA_SOURCE_FILE ("galgas3SemanticDeclarationCompilation.gSemantics", 754))) ;
      var_implementationString.dotAssign_operation (callCategoryReader_appendTypeGenericImplementation ((const cPtr_semanticDeclarationForGeneration *) enumerator_31763.current_mDeclaration (HERE).ptr (), inCompiler COMMA_SOURCE_FILE ("galgas3SemanticDeclarationCompilation.gSemantics", 757))  COMMA_SOURCE_FILE ("galgas3SemanticDeclarationCompilation.gSemantics", 757)) ;
      ioArgument_ioAllProductFileSet.addAssign_operation (callCategoryReader_implementationCppFileName ((const cPtr_semanticDeclarationForGeneration *) enumerator_31763.current_mDeclaration (HERE).ptr (), inCompiler COMMA_SOURCE_FILE ("galgas3SemanticDeclarationCompilation.gSemantics", 758)).operator_concat (GALGAS_string (".cpp")  COMMA_SOURCE_FILE ("galgas3SemanticDeclarationCompilation.gSemantics", 758))  COMMA_SOURCE_FILE ("galgas3SemanticDeclarationCompilation.gSemantics", 758)) ;
      {
      GALGAS_string::class_method_generateFile (constinArgument_inProductDirectory, callCategoryReader_implementationCppFileName ((const cPtr_semanticDeclarationForGeneration *) enumerator_31763.current_mDeclaration (HERE).ptr (), inCompiler COMMA_SOURCE_FILE ("galgas3SemanticDeclarationCompilation.gSemantics", 761)).operator_concat (GALGAS_string (".cpp")  COMMA_SOURCE_FILE ("galgas3SemanticDeclarationCompilation.gSemantics", 761)), var_header.add_operation (var_implementationString, inCompiler COMMA_SOURCE_FILE ("galgas3SemanticDeclarationCompilation.gSemantics", 762)), inCompiler COMMA_SOURCE_FILE ("galgas3SemanticDeclarationCompilation.gSemantics", 759)) ;
      }
      ioArgument_ioToolProductFileList.addAssign_operation (callCategoryReader_implementationCppFileName ((const cPtr_semanticDeclarationForGeneration *) enumerator_31763.current_mDeclaration (HERE).ptr (), inCompiler COMMA_SOURCE_FILE ("galgas3SemanticDeclarationCompilation.gSemantics", 764)).operator_concat (GALGAS_string (".cpp")  COMMA_SOURCE_FILE ("galgas3SemanticDeclarationCompilation.gSemantics", 764))  COMMA_SOURCE_FILE ("galgas3SemanticDeclarationCompilation.gSemantics", 764)) ;
    }
    enumerator_31763.gotoNextObject () ;
  }
}


//---------------------------------------------------------------------------------------------------------------------*

GALGAS_headerCompositionMap_2D_element::GALGAS_headerCompositionMap_2D_element (void) :
mAttribute_lkey (),
mAttribute_mInclusion (),
mAttribute_mHeaderString () {
}

//---------------------------------------------------------------------------------------------------------------------*

GALGAS_headerCompositionMap_2D_element::~ GALGAS_headerCompositionMap_2D_element (void) {
}

//---------------------------------------------------------------------------------------------------------------------*

GALGAS_headerCompositionMap_2D_element::GALGAS_headerCompositionMap_2D_element (const GALGAS_lstring & inOperand0,
                                                                                const GALGAS_stringset & inOperand1,
                                                                                const GALGAS_string & inOperand2) :
mAttribute_lkey (inOperand0),
mAttribute_mInclusion (inOperand1),
mAttribute_mHeaderString (inOperand2) {
}

//---------------------------------------------------------------------------------------------------------------------*

GALGAS_headerCompositionMap_2D_element GALGAS_headerCompositionMap_2D_element::constructor_default (UNUSED_LOCATION_ARGS) {
  return GALGAS_headerCompositionMap_2D_element (GALGAS_lstring::constructor_default (HERE),
                                                 GALGAS_stringset::constructor_emptySet (HERE),
                                                 GALGAS_string::constructor_default (HERE)) ;
}

//---------------------------------------------------------------------------------------------------------------------*

GALGAS_headerCompositionMap_2D_element GALGAS_headerCompositionMap_2D_element::constructor_new (const GALGAS_lstring & inOperand0,
                                                                                                const GALGAS_stringset & inOperand1,
                                                                                                const GALGAS_string & inOperand2 
                                                                                                COMMA_UNUSED_LOCATION_ARGS) {
  GALGAS_headerCompositionMap_2D_element result ;
  if (inOperand0.isValid () && inOperand1.isValid () && inOperand2.isValid ()) {
    result = GALGAS_headerCompositionMap_2D_element (inOperand0, inOperand1, inOperand2) ;
  }
  return result ;
}

//---------------------------------------------------------------------------------------------------------------------*

typeComparisonResult GALGAS_headerCompositionMap_2D_element::objectCompare (const GALGAS_headerCompositionMap_2D_element & inOperand) const {
   typeComparisonResult result = kOperandEqual ;
  if (result == kOperandEqual) {
    result = mAttribute_lkey.objectCompare (inOperand.mAttribute_lkey) ;
  }
  if (result == kOperandEqual) {
    result = mAttribute_mInclusion.objectCompare (inOperand.mAttribute_mInclusion) ;
  }
  if (result == kOperandEqual) {
    result = mAttribute_mHeaderString.objectCompare (inOperand.mAttribute_mHeaderString) ;
  }
  return result ;
}

//---------------------------------------------------------------------------------------------------------------------*

bool GALGAS_headerCompositionMap_2D_element::isValid (void) const {
  return mAttribute_lkey.isValid () && mAttribute_mInclusion.isValid () && mAttribute_mHeaderString.isValid () ;
}

//---------------------------------------------------------------------------------------------------------------------*

void GALGAS_headerCompositionMap_2D_element::drop (void) {
  mAttribute_lkey.drop () ;
  mAttribute_mInclusion.drop () ;
  mAttribute_mHeaderString.drop () ;
}

//---------------------------------------------------------------------------------------------------------------------*

void GALGAS_headerCompositionMap_2D_element::description (C_String & ioString,
                                                          const int32_t inIndentation) const {
  ioString << "<struct @headerCompositionMap-element:" ;
  if (! isValid ()) {
    ioString << " not built" ;
  }else{
    mAttribute_lkey.description (ioString, inIndentation+1) ;
    ioString << ", " ;
    mAttribute_mInclusion.description (ioString, inIndentation+1) ;
    ioString << ", " ;
    mAttribute_mHeaderString.description (ioString, inIndentation+1) ;
  }
  ioString << ">" ;
}

//---------------------------------------------------------------------------------------------------------------------*

GALGAS_lstring GALGAS_headerCompositionMap_2D_element::reader_lkey (UNUSED_LOCATION_ARGS) const {
  return mAttribute_lkey ;
}

//---------------------------------------------------------------------------------------------------------------------*

GALGAS_stringset GALGAS_headerCompositionMap_2D_element::reader_mInclusion (UNUSED_LOCATION_ARGS) const {
  return mAttribute_mInclusion ;
}

//---------------------------------------------------------------------------------------------------------------------*

GALGAS_string GALGAS_headerCompositionMap_2D_element::reader_mHeaderString (UNUSED_LOCATION_ARGS) const {
  return mAttribute_mHeaderString ;
}



//---------------------------------------------------------------------------------------------------------------------*
//                                                                                                                     *
//                                         @headerCompositionMap-element type                                          *
//                                                                                                                     *
//---------------------------------------------------------------------------------------------------------------------*

const C_galgas_type_descriptor
kTypeDescriptor_GALGAS_headerCompositionMap_2D_element ("headerCompositionMap-element",
                                                        NULL) ;

//---------------------------------------------------------------------------------------------------------------------*

const C_galgas_type_descriptor * GALGAS_headerCompositionMap_2D_element::staticTypeDescriptor (void) const {
  return & kTypeDescriptor_GALGAS_headerCompositionMap_2D_element ;
}

//---------------------------------------------------------------------------------------------------------------------*

AC_GALGAS_root * GALGAS_headerCompositionMap_2D_element::clonedObject (void) const {
  AC_GALGAS_root * result = NULL ;
  if (isValid ()) {
    macroMyNew (result, GALGAS_headerCompositionMap_2D_element (*this)) ;
  }
  return result ;
}

//---------------------------------------------------------------------------------------------------------------------*

GALGAS_headerCompositionMap_2D_element GALGAS_headerCompositionMap_2D_element::extractObject (const GALGAS_object & inObject,
                                                                                              C_Compiler * inCompiler
                                                                                              COMMA_LOCATION_ARGS) {
  GALGAS_headerCompositionMap_2D_element result ;
  const GALGAS_headerCompositionMap_2D_element * p = (const GALGAS_headerCompositionMap_2D_element *) inObject.embeddedObject () ;
  if (NULL != p) {
    if (NULL != dynamic_cast <const GALGAS_headerCompositionMap_2D_element *> (p)) {
      result = *p ;
    }else{
      inCompiler->castError ("headerCompositionMap-element", p->dynamicTypeDescriptor () COMMA_THERE) ;
    }  
  }
  return result ;
}

//---------------------------------------------------------------------------------------------------------------------*

GALGAS_headerRepartitionMap_2D_element::GALGAS_headerRepartitionMap_2D_element (void) :
mAttribute_lkey (),
mAttribute_mHeaderFileName () {
}

//---------------------------------------------------------------------------------------------------------------------*

GALGAS_headerRepartitionMap_2D_element::~ GALGAS_headerRepartitionMap_2D_element (void) {
}

//---------------------------------------------------------------------------------------------------------------------*

GALGAS_headerRepartitionMap_2D_element::GALGAS_headerRepartitionMap_2D_element (const GALGAS_lstring & inOperand0,
                                                                                const GALGAS_string & inOperand1) :
mAttribute_lkey (inOperand0),
mAttribute_mHeaderFileName (inOperand1) {
}

//---------------------------------------------------------------------------------------------------------------------*

GALGAS_headerRepartitionMap_2D_element GALGAS_headerRepartitionMap_2D_element::constructor_default (UNUSED_LOCATION_ARGS) {
  return GALGAS_headerRepartitionMap_2D_element (GALGAS_lstring::constructor_default (HERE),
                                                 GALGAS_string::constructor_default (HERE)) ;
}

//---------------------------------------------------------------------------------------------------------------------*

GALGAS_headerRepartitionMap_2D_element GALGAS_headerRepartitionMap_2D_element::constructor_new (const GALGAS_lstring & inOperand0,
                                                                                                const GALGAS_string & inOperand1 
                                                                                                COMMA_UNUSED_LOCATION_ARGS) {
  GALGAS_headerRepartitionMap_2D_element result ;
  if (inOperand0.isValid () && inOperand1.isValid ()) {
    result = GALGAS_headerRepartitionMap_2D_element (inOperand0, inOperand1) ;
  }
  return result ;
}

//---------------------------------------------------------------------------------------------------------------------*

typeComparisonResult GALGAS_headerRepartitionMap_2D_element::objectCompare (const GALGAS_headerRepartitionMap_2D_element & inOperand) const {
   typeComparisonResult result = kOperandEqual ;
  if (result == kOperandEqual) {
    result = mAttribute_lkey.objectCompare (inOperand.mAttribute_lkey) ;
  }
  if (result == kOperandEqual) {
    result = mAttribute_mHeaderFileName.objectCompare (inOperand.mAttribute_mHeaderFileName) ;
  }
  return result ;
}

//---------------------------------------------------------------------------------------------------------------------*

bool GALGAS_headerRepartitionMap_2D_element::isValid (void) const {
  return mAttribute_lkey.isValid () && mAttribute_mHeaderFileName.isValid () ;
}

//---------------------------------------------------------------------------------------------------------------------*

void GALGAS_headerRepartitionMap_2D_element::drop (void) {
  mAttribute_lkey.drop () ;
  mAttribute_mHeaderFileName.drop () ;
}

//---------------------------------------------------------------------------------------------------------------------*

void GALGAS_headerRepartitionMap_2D_element::description (C_String & ioString,
                                                          const int32_t inIndentation) const {
  ioString << "<struct @headerRepartitionMap-element:" ;
  if (! isValid ()) {
    ioString << " not built" ;
  }else{
    mAttribute_lkey.description (ioString, inIndentation+1) ;
    ioString << ", " ;
    mAttribute_mHeaderFileName.description (ioString, inIndentation+1) ;
  }
  ioString << ">" ;
}

//---------------------------------------------------------------------------------------------------------------------*

GALGAS_lstring GALGAS_headerRepartitionMap_2D_element::reader_lkey (UNUSED_LOCATION_ARGS) const {
  return mAttribute_lkey ;
}

//---------------------------------------------------------------------------------------------------------------------*

GALGAS_string GALGAS_headerRepartitionMap_2D_element::reader_mHeaderFileName (UNUSED_LOCATION_ARGS) const {
  return mAttribute_mHeaderFileName ;
}



//---------------------------------------------------------------------------------------------------------------------*
//                                                                                                                     *
//                                         @headerRepartitionMap-element type                                          *
//                                                                                                                     *
//---------------------------------------------------------------------------------------------------------------------*

const C_galgas_type_descriptor
kTypeDescriptor_GALGAS_headerRepartitionMap_2D_element ("headerRepartitionMap-element",
                                                        NULL) ;

//---------------------------------------------------------------------------------------------------------------------*

const C_galgas_type_descriptor * GALGAS_headerRepartitionMap_2D_element::staticTypeDescriptor (void) const {
  return & kTypeDescriptor_GALGAS_headerRepartitionMap_2D_element ;
}

//---------------------------------------------------------------------------------------------------------------------*

AC_GALGAS_root * GALGAS_headerRepartitionMap_2D_element::clonedObject (void) const {
  AC_GALGAS_root * result = NULL ;
  if (isValid ()) {
    macroMyNew (result, GALGAS_headerRepartitionMap_2D_element (*this)) ;
  }
  return result ;
}

//---------------------------------------------------------------------------------------------------------------------*

GALGAS_headerRepartitionMap_2D_element GALGAS_headerRepartitionMap_2D_element::extractObject (const GALGAS_object & inObject,
                                                                                              C_Compiler * inCompiler
                                                                                              COMMA_LOCATION_ARGS) {
  GALGAS_headerRepartitionMap_2D_element result ;
  const GALGAS_headerRepartitionMap_2D_element * p = (const GALGAS_headerRepartitionMap_2D_element *) inObject.embeddedObject () ;
  if (NULL != p) {
    if (NULL != dynamic_cast <const GALGAS_headerRepartitionMap_2D_element *> (p)) {
      result = *p ;
    }else{
      inCompiler->castError ("headerRepartitionMap-element", p->dynamicTypeDescriptor () COMMA_THERE) ;
    }  
  }
  return result ;
}

//--- START OF USER ZONE 2


//--- END OF USER ZONE 2


