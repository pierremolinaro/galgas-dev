//---------------------------------------------------------------------------------------------------------------------*
//                                                                                                                     *
//                                       File 'programComponentCompilation.cpp'                                        *
//                                             Generated by version 3.0.0                                              *
//                                          october 10th, 2014, at 10h48'53"                                           *
//                                                                                                                     *
//---------------------------------------------------------------------------------------------------------------------*

//--- START OF USER ZONE 1


//--- END OF USER ZONE 1

#include "galgas2/C_Compiler.h"
#include "galgas2/C_galgas_io.h"
#include "galgas2/C_galgas_CLI_Options.h"
#include "utilities/C_PrologueEpilogue.h"

//---------------------------------------------------------------------------------------------------------------------*

#include "programSLRgrammar.h"
#include "optionLL1grammar.h"
#include "grammarLL1grammar.h"
#include "syntaxSLRgrammar.h"
#include "lexiqueLL1grammar.h"
#include "galgas_cli_options.h"
#include "templateGrammar.h"
#include "semanticsSLRgrammar.h"
#include "programComponentCompilation.h"


//---------------------------------------------------------------------------------------------------------------------*
//                                                                                                                     *
//                                Class for element of '@programListForGeneration' list                                *
//                                                                                                                     *
//---------------------------------------------------------------------------------------------------------------------*

class cCollectionElement_programListForGeneration : public cCollectionElement {
  public : GALGAS_programListForGeneration_2D_element mObject ;

//--- Constructor
  public : cCollectionElement_programListForGeneration (const GALGAS_semanticDeclarationForGeneration & in_mDeclaration
                                                        COMMA_LOCATION_ARGS) ;

//--- Virtual method for comparing elements
  public : virtual typeComparisonResult compare (const cCollectionElement * inOperand) const ;

//--- Virtual method that checks that all attributes are valid
  public : virtual bool isValid (void) const ;

//--- Virtual method that returns a copy of current object
  public : virtual cCollectionElement * copy (void) ;

//--- Description
 public : virtual void description (C_String & ioString, const int32_t inIndentation) const ;
} ;

//---------------------------------------------------------------------------------------------------------------------*

cCollectionElement_programListForGeneration::cCollectionElement_programListForGeneration (const GALGAS_semanticDeclarationForGeneration & in_mDeclaration
                                                                                          COMMA_LOCATION_ARGS) :
cCollectionElement (THERE),
mObject (in_mDeclaration) {
}

//---------------------------------------------------------------------------------------------------------------------*

bool cCollectionElement_programListForGeneration::isValid (void) const {
  return mObject.isValid () ;
}

//---------------------------------------------------------------------------------------------------------------------*

cCollectionElement * cCollectionElement_programListForGeneration::copy (void) {
  cCollectionElement * result = NULL ;
  macroMyNew (result, cCollectionElement_programListForGeneration (mObject.mAttribute_mDeclaration COMMA_HERE)) ;
  return result ;
}

//---------------------------------------------------------------------------------------------------------------------*

void cCollectionElement_programListForGeneration::description (C_String & ioString, const int32_t inIndentation) const {
  ioString << "\n" ;
  ioString.writeStringMultiple ("| ", inIndentation) ;
  ioString << "mDeclaration" ":" ;
  mObject.mAttribute_mDeclaration.description (ioString, inIndentation) ;
}

//---------------------------------------------------------------------------------------------------------------------*

typeComparisonResult cCollectionElement_programListForGeneration::compare (const cCollectionElement * inOperand) const {
  cCollectionElement_programListForGeneration * operand = (cCollectionElement_programListForGeneration *) inOperand ;
  macroValidSharedObject (operand, cCollectionElement_programListForGeneration) ;
  return mObject.objectCompare (operand->mObject) ;
}

//---------------------------------------------------------------------------------------------------------------------*

GALGAS_programListForGeneration::GALGAS_programListForGeneration (void) :
AC_GALGAS_list () {
}

//---------------------------------------------------------------------------------------------------------------------*

GALGAS_programListForGeneration::GALGAS_programListForGeneration (cSharedList * inSharedListPtr) :
AC_GALGAS_list (inSharedListPtr) {
  if (NULL == inSharedListPtr) {
    createNewEmptyList (HERE) ;
  }
}

//---------------------------------------------------------------------------------------------------------------------*

GALGAS_programListForGeneration GALGAS_programListForGeneration::constructor_emptyList (LOCATION_ARGS) {
  GALGAS_programListForGeneration result ;
  result.createNewEmptyList (THERE) ;
  return result ;
}

//---------------------------------------------------------------------------------------------------------------------*

GALGAS_programListForGeneration GALGAS_programListForGeneration::constructor_listWithValue (const GALGAS_semanticDeclarationForGeneration & inOperand0
                                                                                            COMMA_LOCATION_ARGS) {
  GALGAS_programListForGeneration result ;
  if (inOperand0.isValid ()) {
    result.createNewEmptyList (THERE) ;
    capCollectionElement attributes ;
    GALGAS_programListForGeneration::makeAttributesFromObjects (attributes, inOperand0 COMMA_THERE) ;
    result.addObject (attributes) ;
  }
  return result ;
}

//---------------------------------------------------------------------------------------------------------------------*

void GALGAS_programListForGeneration::makeAttributesFromObjects (capCollectionElement & outAttributes,
                                                                 const GALGAS_semanticDeclarationForGeneration & in_mDeclaration
                                                                 COMMA_LOCATION_ARGS) {
  cCollectionElement_programListForGeneration * p = NULL ;
  macroMyNew (p, cCollectionElement_programListForGeneration (in_mDeclaration COMMA_THERE)) ;
  outAttributes.setPointer (p) ;
  macroDetachSharedObject (p) ;
}

//---------------------------------------------------------------------------------------------------------------------*

void GALGAS_programListForGeneration::addAssign_operation (const GALGAS_semanticDeclarationForGeneration & inOperand0
                                                           COMMA_LOCATION_ARGS) {
  if (isValid () && inOperand0.isValid ()) {
    cCollectionElement * p = NULL ;
    macroMyNew (p, cCollectionElement_programListForGeneration (inOperand0 COMMA_THERE)) ;
    capCollectionElement attributes ;
    attributes.setPointer (p) ;
    macroDetachSharedObject (p) ;
    addObject (attributes) ;
  }
}

//---------------------------------------------------------------------------------------------------------------------*

void GALGAS_programListForGeneration::modifier_insertAtIndex (const GALGAS_semanticDeclarationForGeneration inOperand0,
                                                              const GALGAS_uint inInsertionIndex,
                                                              C_Compiler * inCompiler
                                                              COMMA_LOCATION_ARGS) {
  if (isValid () && inInsertionIndex.isValid () && inOperand0.isValid ()) {
    cCollectionElement * p = NULL ;
    macroMyNew (p, cCollectionElement_programListForGeneration (inOperand0 COMMA_THERE)) ;
    capCollectionElement attributes ;
    attributes.setPointer (p) ;
    macroDetachSharedObject (p) ;
    addObjectAtIndex (attributes, inInsertionIndex.uintValue (), inCompiler COMMA_THERE) ;
  }
}

//---------------------------------------------------------------------------------------------------------------------*

void GALGAS_programListForGeneration::modifier_removeAtIndex (GALGAS_semanticDeclarationForGeneration & outOperand0,
                                                              const GALGAS_uint inRemoveIndex,
                                                              C_Compiler * inCompiler
                                                              COMMA_LOCATION_ARGS) {
  if (isValid () && inRemoveIndex.isValid ()) {
    capCollectionElement attributes ;
    removeObjectAtIndex (attributes, inRemoveIndex.uintValue (), inCompiler COMMA_THERE) ;
    cCollectionElement_programListForGeneration * p = (cCollectionElement_programListForGeneration *) attributes.ptr () ;
    if (NULL == p) {
      outOperand0.drop () ;
    }else{
      macroValidSharedObject (p, cCollectionElement_programListForGeneration) ;
      outOperand0 = p->mObject.mAttribute_mDeclaration ;
    }
  }
}

//---------------------------------------------------------------------------------------------------------------------*

void GALGAS_programListForGeneration::modifier_popFirst (GALGAS_semanticDeclarationForGeneration & outOperand0,
                                                         C_Compiler * inCompiler
                                                         COMMA_LOCATION_ARGS) {
  capCollectionElement attributes ;
  removeFirstObject (attributes, inCompiler COMMA_THERE) ;
  cCollectionElement_programListForGeneration * p = (cCollectionElement_programListForGeneration *) attributes.ptr () ;
  if (NULL == p) {
    outOperand0.drop () ;
  }else{
    macroValidSharedObject (p, cCollectionElement_programListForGeneration) ;
    outOperand0 = p->mObject.mAttribute_mDeclaration ;
  }
}

//---------------------------------------------------------------------------------------------------------------------*

void GALGAS_programListForGeneration::modifier_popLast (GALGAS_semanticDeclarationForGeneration & outOperand0,
                                                        C_Compiler * inCompiler
                                                        COMMA_LOCATION_ARGS) {
  capCollectionElement attributes ;
  removeLastObject (attributes, inCompiler COMMA_THERE) ;
  cCollectionElement_programListForGeneration * p = (cCollectionElement_programListForGeneration *) attributes.ptr () ;
  if (NULL == p) {
    outOperand0.drop () ;
  }else{
    macroValidSharedObject (p, cCollectionElement_programListForGeneration) ;
    outOperand0 = p->mObject.mAttribute_mDeclaration ;
  }
}

//---------------------------------------------------------------------------------------------------------------------*

void GALGAS_programListForGeneration::method_first (GALGAS_semanticDeclarationForGeneration & outOperand0,
                                                    C_Compiler * inCompiler
                                                    COMMA_LOCATION_ARGS) const {
  capCollectionElement attributes ;
  readFirst (attributes, inCompiler COMMA_THERE) ;
  cCollectionElement_programListForGeneration * p = (cCollectionElement_programListForGeneration *) attributes.ptr () ;
  if (NULL == p) {
    outOperand0.drop () ;
  }else{
    macroValidSharedObject (p, cCollectionElement_programListForGeneration) ;
    outOperand0 = p->mObject.mAttribute_mDeclaration ;
  }
}

//---------------------------------------------------------------------------------------------------------------------*

void GALGAS_programListForGeneration::method_last (GALGAS_semanticDeclarationForGeneration & outOperand0,
                                                   C_Compiler * inCompiler
                                                   COMMA_LOCATION_ARGS) const {
  capCollectionElement attributes ;
  readLast (attributes, inCompiler COMMA_THERE) ;
  cCollectionElement_programListForGeneration * p = (cCollectionElement_programListForGeneration *) attributes.ptr () ;
  if (NULL == p) {
    outOperand0.drop () ;
  }else{
    macroValidSharedObject (p, cCollectionElement_programListForGeneration) ;
    outOperand0 = p->mObject.mAttribute_mDeclaration ;
  }
}

//---------------------------------------------------------------------------------------------------------------------*

GALGAS_programListForGeneration GALGAS_programListForGeneration::operator_concat (const GALGAS_programListForGeneration & inOperand
                                                                                  COMMA_UNUSED_LOCATION_ARGS) const {
  GALGAS_programListForGeneration result ;
  if (isValid () && inOperand.isValid ()) {
    result = *this ;
    result.appendList (inOperand) ;
  }
  return result ;
}

//---------------------------------------------------------------------------------------------------------------------*

GALGAS_programListForGeneration GALGAS_programListForGeneration::add_operation (const GALGAS_programListForGeneration & inOperand,
                                                                                C_Compiler * /* inCompiler */
                                                                                COMMA_UNUSED_LOCATION_ARGS) const {
  GALGAS_programListForGeneration result ;
  if (isValid () && inOperand.isValid ()) {
    result = *this ;
    result.appendList (inOperand) ;
  }
  return result ;
}

//---------------------------------------------------------------------------------------------------------------------*

GALGAS_programListForGeneration GALGAS_programListForGeneration::reader_subListWithRange (const GALGAS_range & inRange,
                                                                                          C_Compiler * inCompiler
                                                                                          COMMA_LOCATION_ARGS) const {
  GALGAS_programListForGeneration result = GALGAS_programListForGeneration::constructor_emptyList (THERE) ;
  subListWithRange (result, inRange, inCompiler COMMA_THERE) ;
  return result ;
}

//---------------------------------------------------------------------------------------------------------------------*

GALGAS_programListForGeneration GALGAS_programListForGeneration::reader_subListFromIndex (const GALGAS_uint & inIndex,
                                                                                          C_Compiler * inCompiler
                                                                                          COMMA_LOCATION_ARGS) const {
  GALGAS_programListForGeneration result = GALGAS_programListForGeneration::constructor_emptyList (THERE) ;
  subListFromIndex (result, inIndex, inCompiler COMMA_THERE) ;
  return result ;
}

//---------------------------------------------------------------------------------------------------------------------*

void GALGAS_programListForGeneration::dotAssign_operation (const GALGAS_programListForGeneration inOperand
                                                           COMMA_UNUSED_LOCATION_ARGS) {
  appendList (inOperand) ;
}

//---------------------------------------------------------------------------------------------------------------------*

GALGAS_semanticDeclarationForGeneration GALGAS_programListForGeneration::reader_mDeclarationAtIndex (const GALGAS_uint & inIndex,
                                                                                                     C_Compiler * inCompiler
                                                                                                     COMMA_LOCATION_ARGS) const {
  capCollectionElement attributes = readObjectAtIndex (inIndex, inCompiler COMMA_THERE) ;
  cCollectionElement_programListForGeneration * p = (cCollectionElement_programListForGeneration *) attributes.ptr () ;
  GALGAS_semanticDeclarationForGeneration result ;
  if (NULL != p) {
    macroValidSharedObject (p, cCollectionElement_programListForGeneration) ;
    result = p->mObject.mAttribute_mDeclaration ;
  }
  return result ;
}



//---------------------------------------------------------------------------------------------------------------------*

cEnumerator_programListForGeneration::cEnumerator_programListForGeneration (const GALGAS_programListForGeneration & inEnumeratedObject,
                                                                            const typeEnumerationOrder inOrder) :
cGenericAbstractEnumerator () {
  inEnumeratedObject.populateEnumerationArray (mEnumerationArray, inOrder) ;
}

//---------------------------------------------------------------------------------------------------------------------*

GALGAS_programListForGeneration_2D_element cEnumerator_programListForGeneration::current (LOCATION_ARGS) const {
  const cCollectionElement_programListForGeneration * p = (const cCollectionElement_programListForGeneration *) currentObjectPtr (THERE) ;
  macroValidSharedObject (p, cCollectionElement_programListForGeneration) ;
  return p->mObject ;
}


//---------------------------------------------------------------------------------------------------------------------*

GALGAS_semanticDeclarationForGeneration cEnumerator_programListForGeneration::current_mDeclaration (LOCATION_ARGS) const {
  const cCollectionElement_programListForGeneration * p = (const cCollectionElement_programListForGeneration *) currentObjectPtr (THERE) ;
  macroValidSharedObject (p, cCollectionElement_programListForGeneration) ;
  return p->mObject.mAttribute_mDeclaration ;
}




//---------------------------------------------------------------------------------------------------------------------*
//                                                                                                                     *
//                                           @programListForGeneration type                                            *
//                                                                                                                     *
//---------------------------------------------------------------------------------------------------------------------*

const C_galgas_type_descriptor
kTypeDescriptor_GALGAS_programListForGeneration ("programListForGeneration",
                                                 NULL) ;

//---------------------------------------------------------------------------------------------------------------------*

const C_galgas_type_descriptor * GALGAS_programListForGeneration::staticTypeDescriptor (void) const {
  return & kTypeDescriptor_GALGAS_programListForGeneration ;
}

//---------------------------------------------------------------------------------------------------------------------*

AC_GALGAS_root * GALGAS_programListForGeneration::clonedObject (void) const {
  AC_GALGAS_root * result = NULL ;
  if (isValid ()) {
    macroMyNew (result, GALGAS_programListForGeneration (*this)) ;
  }
  return result ;
}

//---------------------------------------------------------------------------------------------------------------------*

GALGAS_programListForGeneration GALGAS_programListForGeneration::extractObject (const GALGAS_object & inObject,
                                                                                C_Compiler * inCompiler
                                                                                COMMA_LOCATION_ARGS) {
  GALGAS_programListForGeneration result ;
  const GALGAS_programListForGeneration * p = (const GALGAS_programListForGeneration *) inObject.embeddedObject () ;
  if (NULL != p) {
    if (NULL != dynamic_cast <const GALGAS_programListForGeneration *> (p)) {
      result = *p ;
    }else{
      inCompiler->castError ("programListForGeneration", p->dynamicTypeDescriptor () COMMA_THERE) ;
    }  
  }
  return result ;
}

//---------------------------------------------------------------------------------------------------------------------*
//                                                                                                                     *
//                                     Filewrapper 'programFileGenerationTemplate'                                     *
//                                                                                                                     *
//---------------------------------------------------------------------------------------------------------------------*

//--- All files of '' directory

static const cRegularFileWrapper * gWrapperAllFiles_programFileGenerationTemplate_0 [1] = {
  NULL
} ;

//--- All sub-directories of '' directory

static const cDirectoryWrapper * gWrapperAllDirectories_programFileGenerationTemplate_0 [1] = {
  NULL
} ;

//--- Directory ''

const cDirectoryWrapper gWrapperDirectory_0_programFileGenerationTemplate (
  "",
  0,
  gWrapperAllFiles_programFileGenerationTemplate_0,
  0,
  gWrapperAllDirectories_programFileGenerationTemplate_0
) ;


//---------------------------------------------------------------------------------------------------------------------*
//                                                                                                                     *
//                       Filewrapper template 'programFileGenerationTemplate programFileHeader'                        *
//                                                                                                                     *
//---------------------------------------------------------------------------------------------------------------------*

GALGAS_string filewrapperTemplate_programFileGenerationTemplate_programFileHeader (C_Compiler * /* inCompiler */,
                                                                                   const GALGAS_string & in_COMPONENT_5F_NAME,
                                                                                   const GALGAS_stringlist & in_IMPORTED_5F_COMPONENT_5F_LIST
                                                                                   COMMA_UNUSED_LOCATION_ARGS) {
  C_String result ;
  result << "#ifndef " ;
  result << in_COMPONENT_5F_NAME.stringValue () ;
  result << "_ENTITIES_DEFINED\n"
    "#define " ;
  result << in_COMPONENT_5F_NAME.stringValue () ;
  result << "_ENTITIES_DEFINED\n"
    "\n"
    "//---------------------------------------------------------------------------------------------------------------------*\n"
    "\n"
    "#include \"galgas2/predefined-types.h\"\n"
    "/*\n"
    "#include \"galgas2/C_Compiler.h\"\n"
    "#include \"galgas2/C_galgas_io.h\"\n"
    "#include \"utilities/basic-allocation.h\"\n"
    "#include \"utilities/cpp-allocation.h\"\n"
    "#include \"utilities/C_PrologueEpilogue.h\"\n"
    "#include \"command_line_interface/C_builtin_CLI_Options.h\"\n"
    "#include \"galgas2/C_galgas_CLI_Options.h\"\n"
    "#include \"command_line_interface/F_mainForLIBPM.h\"\n"
    " */\n"
    "\n"
    "\n"
    "//---------------------------------------------------------------------------------------------------------------------*\n"
    "\n" ;
  GALGAS_uint index_751_ (0) ;
  if (in_IMPORTED_5F_COMPONENT_5F_LIST.isValid ()) {
    cEnumerator_stringlist enumerator_751 (in_IMPORTED_5F_COMPONENT_5F_LIST, kEnumeration_up) ;
    while (enumerator_751.hasCurrentObject ()) {
      result << "#include \"" ;
      result << enumerator_751.current_mValue (HERE).stringValue () ;
      result << ".h\"\n" ;
      index_751_.increment () ;
      enumerator_751.gotoNextObject () ;
    }
  }
  result << "\n"
    "//---------------------------------------------------------------------------------------------------------------------*\n" ;
  return GALGAS_string (result) ;
}

//---------------------------------------------------------------------------------------------------------------------*
//                                                                                                                     *
//                   Filewrapper template 'programFileGenerationTemplate programFileImplementation'                    *
//                                                                                                                     *
//---------------------------------------------------------------------------------------------------------------------*

GALGAS_string filewrapperTemplate_programFileGenerationTemplate_programFileImplementation (C_Compiler * inCompiler,
                                                                                           const GALGAS_string & /* in_COMPONENT_5F_NAME */,
                                                                                           const GALGAS_stringlist & in_IMPORTED_5F_COMPONENT_5F_LIST,
                                                                                           const GALGAS_string & in_BEFORE_5F_AFTER_5F_RULE_5F_IMPLEMENTATION_5F_STRING,
                                                                                           const GALGAS_programRuleList & in_PROGRAM_5F_RULE_5F_LIST,
                                                                                           const GALGAS_bool & in_HAS_5F_INDEXING
                                                                                           COMMA_UNUSED_LOCATION_ARGS) {
  C_String result ;
  result << "#include \"project_header.h\"\n"
    "#include \"command_line_interface/F_mainForLIBPM.h\"\n"
    "#include \"command_line_interface/F_Analyze_CLI_Options.h\"\n"
    "#include \"utilities/F_DisplayException.h\"\n"
    "#include \"galgas2/C_galgas_CLI_Options.h\"\n" ;
  GALGAS_uint index_258_ (0) ;
  if (in_IMPORTED_5F_COMPONENT_5F_LIST.isValid ()) {
    cEnumerator_stringlist enumerator_258 (in_IMPORTED_5F_COMPONENT_5F_LIST, kEnumeration_up) ;
    while (enumerator_258.hasCurrentObject ()) {
      result << "#include \"" ;
      result << enumerator_258.current_mValue (HERE).stringValue () ;
      result << ".h\"\n" ;
      index_258_.increment () ;
      enumerator_258.gotoNextObject () ;
    }
  }
  result << "\n"
    "//---------------------------------------------------------------------------------------------------------------------*\n"
    "//                                                                                                                     *\n"
    "//                      print_tool_help_message                                                                        *\n"
    "//                                                                                                                     *\n"
    "//---------------------------------------------------------------------------------------------------------------------*\n"
    "\n"
    "static void print_tool_help_message (void) {\n"
    "  co << \"Compiled with GALGAS revision NUMERO_REVISION_GALGAS\\n\" ;\n"
    "}\n"
    "\n"
    "//---------------------------------------------------------------------------------------------------------------------*\n"
    "\n"
    "static const char * kSourceFileExtensions [] = {\n" ;
  GALGAS_uint index_1222_ (0) ;
  if (in_PROGRAM_5F_RULE_5F_LIST.isValid ()) {
    cEnumerator_programRuleList enumerator_1222 (in_PROGRAM_5F_RULE_5F_LIST, kEnumeration_up) ;
    while (enumerator_1222.hasCurrentObject ()) {
      result << "  " ;
      result << enumerator_1222.current_mSourceFileExtension (HERE).mAttribute_string.reader_utf_38_Representation (SOURCE_FILE ("program-file.cpp.gTemplate", 24)).stringValue () ;
      result << ",\n" ;
      index_1222_.increment () ;
      enumerator_1222.gotoNextObject () ;
    }
  }
  result << "  NULL\n"
    "} ;    \n"
    "\n"
    "//---------------------------------------------------------------------------------------------------------------------*\n"
    "\n"
    "static const char * kSourceFileHelpMessages [] = {\n" ;
  GALGAS_uint index_1503_ (0) ;
  if (in_PROGRAM_5F_RULE_5F_LIST.isValid ()) {
    cEnumerator_programRuleList enumerator_1503 (in_PROGRAM_5F_RULE_5F_LIST, kEnumeration_up) ;
    while (enumerator_1503.hasCurrentObject ()) {
      result << "  " ;
      result << enumerator_1503.current_mSourceFileHelp (HERE).mAttribute_string.reader_utf_38_Representation (SOURCE_FILE ("program-file.cpp.gTemplate", 34)).stringValue () ;
      result << ",\n" ;
      index_1503_.increment () ;
      enumerator_1503.gotoNextObject () ;
    }
  }
  result << "  NULL\n"
    "} ;    \n"
    "\n"
    "//---------------------------------------------------------------------------------------------------------------------*\n"
    "\n"
    "#ifndef DO_NOT_GENERATE_CHECKINGS\n"
    "  static const char * kVersionString = \"version \" PROJECT_VERSION_STRING \" [debug]\" ;\n"
    "#else\n"
    "  static const char * kVersionString = \"version \" PROJECT_VERSION_STRING ;\n"
    "#endif\n"
    "\n" ;
  result << in_BEFORE_5F_AFTER_5F_RULE_5F_IMPLEMENTATION_5F_STRING.stringValue () ;
  result << "//---------------------------------------------------------------------------------------------------------------------*\n"
    "//                                                                                                                     *\n"
    "//                      M A I N    F O R    L I B P M                                                                  *\n"
    "//                                                                                                                     *\n"
    "//---------------------------------------------------------------------------------------------------------------------*\n"
    "\n"
    "int mainForLIBPM (int inArgc, const char * inArgv []) {\n"
    "//--- Analyze Command Line Options\n"
    "  TC_UniqueArray <C_String> sourceFilesArray ;\n"
    "  F_Analyze_CLI_Options (inArgc, inArgv,\n"
    "                         kVersionString,\n"
    "                         sourceFilesArray,\n"
    "                         kSourceFileExtensions,\n"
    "                         kSourceFileHelpMessages,\n"
    "                         print_tool_help_message) ;\n"
    "//---\n"
    "  bool verboseOptionOn = true ;\n"
    "  int16_t returnCode = 0 ; // No error\n"
    "//--- Set Execution mode\n"
    "  C_String executionModeOptionErrorMessage ;\n"
    "  setExecutionMode (executionModeOptionErrorMessage) ;\n"
    "  if (executionModeOptionErrorMessage.length () > 0) {\n"
    "    co << executionModeOptionErrorMessage ;\n"
    "    returnCode = 1 ;\n"
    "  }else{\n"
    "  //--- Common lexique object\n"
    "    C_Compiler * commonLexique = NULL ;\n"
    "    macroMyNew (commonLexique, C_Compiler (NULL, \"\", \"\" COMMA_HERE)) ;\n"
    "    try{\n"
    "      routine_before (commonLexique COMMA_HERE) ;\n"
    "      verboseOptionOn = gOption_galgas_5F_builtin_5F_options_verbose_5F_output.mValue ;\n"
    "      for (int32_t i=0 ; i<sourceFilesArray.count () ; i++) {\n"
    "        setCurrentCompiledFilePath (sourceFilesArray (i COMMA_HERE)) ;\n"
    "        if (gOption_galgas_5F_builtin_5F_options_trace.mValue) {\n"
    "          enableTraceWithPath (sourceFilesArray (i COMMA_HERE)) ;\n"
    "        }\n"
    "        const C_String fileExtension = sourceFilesArray (i COMMA_HERE).pathExtension () ;\n"
    "        const GALGAS_string sfp = GALGAS_string (sourceFilesArray (i COMMA_HERE)) ;\n"
    "        const GALGAS_location location = commonLexique->here () ;\n"
    "        const GALGAS_lstring sourceFilePath (sfp, location) ;\n"
    "        int16_t r = 0 ;\n"
    "        " ;
  GALGAS_uint index_4257_IDX (0) ;
  if (in_PROGRAM_5F_RULE_5F_LIST.isValid ()) {
    cEnumerator_programRuleList enumerator_4257 (in_PROGRAM_5F_RULE_5F_LIST, kEnumeration_up) ;
    while (enumerator_4257.hasCurrentObject ()) {
      result << "if (fileExtension == " ;
      result << enumerator_4257.current_mSourceFileExtension (HERE).mAttribute_string.reader_utf_38_Representation (SOURCE_FILE ("program-file.cpp.gTemplate", 92)).stringValue () ;
      result << ") {\n" ;
      const enumGalgasBool test_0 = in_HAS_5F_INDEXING.boolEnum () ;
      if (kBoolTrue == test_0) {
        const enumGalgasBool test_1 = GALGAS_bool (kIsEqual, enumerator_4257.current_mIndexingGrammar (HERE).reader_string (SOURCE_FILE ("program-file.cpp.gTemplate", 94)).objectCompare (GALGAS_string::makeEmptyString ())).boolEnum () ;
        if (kBoolTrue == test_1) {
          result << "          if (! executionModeIsIndexing ()) {\n"
            "            routine_" ;
          result << GALGAS_string ("programRule_").add_operation (index_4257_IDX.reader_string (SOURCE_FILE ("program-file.cpp.gTemplate", 96)), inCompiler COMMA_SOURCE_FILE ("program-file.cpp.gTemplate", 96)).reader_identifierRepresentation (SOURCE_FILE ("program-file.cpp.gTemplate", 96)).stringValue () ;
          result << " (sourceFilePath, commonLexique COMMA_HERE) ;\n"
            "          }\n" ;
        }else if (kBoolFalse == test_1) {
          result << "          if (executionModeIsIndexing ()) {\n"
            "            cGrammar_" ;
          result << enumerator_4257.current_mIndexingGrammar (HERE).mAttribute_string.reader_identifierRepresentation (SOURCE_FILE ("program-file.cpp.gTemplate", 100)).stringValue () ;
          result << "::performIndexing (commonLexique, sourceFilesArray (i COMMA_HERE)) ;\n"
            "          }else{\n"
            "            routine_" ;
          result << GALGAS_string ("programRule_").add_operation (index_4257_IDX.reader_string (SOURCE_FILE ("program-file.cpp.gTemplate", 102)), inCompiler COMMA_SOURCE_FILE ("program-file.cpp.gTemplate", 102)).reader_identifierRepresentation (SOURCE_FILE ("program-file.cpp.gTemplate", 102)).stringValue () ;
          result << " (sourceFilePath, commonLexique COMMA_HERE) ;\n"
            "          }\n" ;
        }
      }else if (kBoolFalse == test_0) {
        result << "          routine_" ;
        result << GALGAS_string ("programRule_").add_operation (index_4257_IDX.reader_string (SOURCE_FILE ("program-file.cpp.gTemplate", 106)), inCompiler COMMA_SOURCE_FILE ("program-file.cpp.gTemplate", 106)).reader_identifierRepresentation (SOURCE_FILE ("program-file.cpp.gTemplate", 106)).stringValue () ;
        result << " (sourceFilePath, commonLexique COMMA_HERE) ;\n" ;
      }
      if (enumerator_4257.hasNextObject ()) {
        result << "        }else " ;
      }
      index_4257_IDX.increment () ;
      enumerator_4257.gotoNextObject () ;
    }
  }
  result << "        }else{\n"
    "          printf (\"*** Error: unhandled extension for file '%s' ***\\n\", sourceFilesArray (i COMMA_HERE).cString (HERE)) ;\n"
    "          r = 1 ;\n"
    "        }\n"
    "        if (r != 0) {\n"
    "          returnCode = r ;\n"
    "        }\n"
    "        closeTrace () ;\n"
    "      }\n"
    "    //--- Error or warnings \?\n"
    "      if (totalErrorCount () > 0) {\n"
    "        returnCode = 1 ; // Error code\n"
    "      }else if (totalWarningCount () > 0) {\n"
    "        if (gOption_galgas_5F_builtin_5F_options_treat_5F_warnings_5F_as_5F_error.mValue) {\n"
    "          returnCode = 1 ; // Error code\n"
    "          if (verboseOptionOn) {\n"
    "            printf (\"** Note: warnings are treated as errors. **\\n\") ;\n"
    "          }\n"
    "        }\n"
    "      }\n"
    "    //--- Epilogue\n"
    "      routine_after (commonLexique COMMA_HERE) ;\n"
    "    //--- Display error and warnings count\n"
    "      if (gOption_galgas_5F_builtin_5F_options_verbose_5F_output.mValue || (totalWarningCount () > 0) || (totalErrorCount () > 0)) {\n"
    "        C_String message ;\n"
    "        if (totalWarningCount () == 0) {\n"
    "          message << \"No warning\" ;\n"
    "        }else if (totalWarningCount () == 1) {\n"
    "          message << \"1 warning\" ;\n"
    "        }else{\n"
    "          message << cStringWithSigned (totalWarningCount ()) << \" warnings\" ;\n"
    "        }\n"
    "        message << \", \" ;\n"
    "        if (totalErrorCount () == 0) {\n"
    "          message << \"no error\" ;\n"
    "        }else if (totalErrorCount () == 1) {\n"
    "          message << \"1 error\" ;\n"
    "        }else{\n"
    "          message << cStringWithSigned (totalErrorCount ()) << \" errors\" ;\n"
    "        }\n"
    "        message << \".\\n\" ;\n"
    "        ggs_printMessage (message COMMA_HERE) ;\n"
    "      }\n"
    "    }catch (const ::std:: exception & e) {\n"
    "      F_default_display_exception (e) ;\n"
    "      returnCode = 1 ; // Error code\n"
    "    }catch (...) {\n"
    "      printf (\"**** Unknow exception ****\\n\") ;\n"
    "      throw ;\n"
    "    }\n"
    "    macroDetachSharedObject (commonLexique) ;\n"
    "  }\n"
    "  return returnCode ;\n"
    "}\n"
    "\n" ;
  return GALGAS_string (result) ;
}

//---------------------------------------------------------------------------------------------------------------------*
//                                                                                                                     *
//                                            Routine 'compileBeforeClause'                                            *
//                                                                                                                     *
//---------------------------------------------------------------------------------------------------------------------*

void routine_compileBeforeClause (const GALGAS_analysisContext constinArgument_inAnalysisContext,
                                  const GALGAS_prologueEpilogueList constinArgument_inPrologueList,
                                  GALGAS_semanticDeclarationSortedListForGeneration & ioArgument_ioDecoratedDeclarationListForGeneration,
                                  C_Compiler * inCompiler
                                  COMMA_UNUSED_LOCATION_ARGS) {
  GALGAS_semanticInstructionListForGeneration var_semanticInstructionListForGeneration = GALGAS_semanticInstructionListForGeneration::constructor_emptyList (SOURCE_FILE ("programComponentCompilation.gSemantics", 64)) ;
  cEnumerator_prologueEpilogueList enumerator_3236 (constinArgument_inPrologueList, kEnumeration_up) ;
  while (enumerator_3236.hasCurrentObject ()) {
    GALGAS_semanticInstructionListForGeneration var_blockSemanticInstructionListForGeneration ;
    {
    GALGAS_formalParameterListForGeneration joker_3719_0 ; // Joker input parameter
    routine_analyzeRoutineBody (constinArgument_inAnalysisContext, GALGAS_formalParameterListAST::constructor_emptyList (SOURCE_FILE ("programComponentCompilation.gSemantics", 68)), GALGAS_localConstantList::constructor_emptyList (SOURCE_FILE ("programComponentCompilation.gSemantics", 69)), GALGAS_typedAttributeList::constructor_emptyList (SOURCE_FILE ("programComponentCompilation.gSemantics", 70)), GALGAS_typedAttributeList::constructor_emptyList (SOURCE_FILE ("programComponentCompilation.gSemantics", 71)), GALGAS_string::makeEmptyString (), enumerator_3236.current_mInstructionList (HERE), enumerator_3236.current_mEndOfInstructionList (HERE), var_blockSemanticInstructionListForGeneration, joker_3719_0, inCompiler  COMMA_SOURCE_FILE ("programComponentCompilation.gSemantics", 66)) ;
    }
    var_semanticInstructionListForGeneration.addAssign_operation (GALGAS_semanticBlockInstructionForGeneration::constructor_new (var_blockSemanticInstructionListForGeneration  COMMA_SOURCE_FILE ("programComponentCompilation.gSemantics", 78))  COMMA_SOURCE_FILE ("programComponentCompilation.gSemantics", 78)) ;
    enumerator_3236.gotoNextObject () ;
  }
  ioArgument_ioDecoratedDeclarationListForGeneration.addAssign_operation (GALGAS_string ("before"), GALGAS_routineImplementationForGeneration::constructor_new (GALGAS_bool (false), GALGAS_string ("proc-before"), GALGAS_string ("before"), GALGAS_formalParameterListForGeneration::constructor_emptyList (SOURCE_FILE ("programComponentCompilation.gSemantics", 89)), GALGAS_bool (false), var_semanticInstructionListForGeneration  COMMA_SOURCE_FILE ("programComponentCompilation.gSemantics", 85)), GALGAS_string::makeEmptyString ()  COMMA_SOURCE_FILE ("programComponentCompilation.gSemantics", 83)) ;
}


//---------------------------------------------------------------------------------------------------------------------*
//                                                                                                                     *
//                                        Routine 'compileBeforeClauseGalgas3'                                         *
//                                                                                                                     *
//---------------------------------------------------------------------------------------------------------------------*

void routine_compileBeforeClauseGalgas_33_ (const GALGAS_analysisContext constinArgument_inAnalysisContext,
                                            const GALGAS_prologueEpilogueList constinArgument_inPrologueList,
                                            GALGAS_programListForGeneration & ioArgument_ioDecoratedDeclarationListForGeneration,
                                            C_Compiler * inCompiler
                                            COMMA_UNUSED_LOCATION_ARGS) {
  GALGAS_semanticInstructionListForGeneration var_semanticInstructionListForGeneration = GALGAS_semanticInstructionListForGeneration::constructor_emptyList (SOURCE_FILE ("programComponentCompilation.gSemantics", 105)) ;
  cEnumerator_prologueEpilogueList enumerator_4650 (constinArgument_inPrologueList, kEnumeration_up) ;
  while (enumerator_4650.hasCurrentObject ()) {
    GALGAS_semanticInstructionListForGeneration var_blockSemanticInstructionListForGeneration ;
    {
    GALGAS_formalParameterListForGeneration joker_5133_0 ; // Joker input parameter
    routine_analyzeRoutineBody (constinArgument_inAnalysisContext, GALGAS_formalParameterListAST::constructor_emptyList (SOURCE_FILE ("programComponentCompilation.gSemantics", 109)), GALGAS_localConstantList::constructor_emptyList (SOURCE_FILE ("programComponentCompilation.gSemantics", 110)), GALGAS_typedAttributeList::constructor_emptyList (SOURCE_FILE ("programComponentCompilation.gSemantics", 111)), GALGAS_typedAttributeList::constructor_emptyList (SOURCE_FILE ("programComponentCompilation.gSemantics", 112)), GALGAS_string::makeEmptyString (), enumerator_4650.current_mInstructionList (HERE), enumerator_4650.current_mEndOfInstructionList (HERE), var_blockSemanticInstructionListForGeneration, joker_5133_0, inCompiler  COMMA_SOURCE_FILE ("programComponentCompilation.gSemantics", 107)) ;
    }
    var_semanticInstructionListForGeneration.addAssign_operation (GALGAS_semanticBlockInstructionForGeneration::constructor_new (var_blockSemanticInstructionListForGeneration  COMMA_SOURCE_FILE ("programComponentCompilation.gSemantics", 119))  COMMA_SOURCE_FILE ("programComponentCompilation.gSemantics", 119)) ;
    enumerator_4650.gotoNextObject () ;
  }
  ioArgument_ioDecoratedDeclarationListForGeneration.addAssign_operation (GALGAS_routineImplementationForGeneration::constructor_new (GALGAS_bool (false), GALGAS_string ("proc-before"), GALGAS_string ("before"), GALGAS_formalParameterListForGeneration::constructor_emptyList (SOURCE_FILE ("programComponentCompilation.gSemantics", 129)), GALGAS_bool (true), var_semanticInstructionListForGeneration  COMMA_SOURCE_FILE ("programComponentCompilation.gSemantics", 125))  COMMA_SOURCE_FILE ("programComponentCompilation.gSemantics", 124)) ;
}


//---------------------------------------------------------------------------------------------------------------------*
//                                                                                                                     *
//                                            Routine 'compileProgramRules'                                            *
//                                                                                                                     *
//---------------------------------------------------------------------------------------------------------------------*

void routine_compileProgramRules (const GALGAS_analysisContext constinArgument_inAnalysisContext,
                                  const GALGAS_programRuleList constinArgument_inProgramRules,
                                  GALGAS_semanticDeclarationSortedListForGeneration & ioArgument_ioDecoratedDeclarationListForGeneration,
                                  GALGAS_bool & ioArgument_ioHasIndexing,
                                  C_Compiler * inCompiler
                                  COMMA_UNUSED_LOCATION_ARGS) {
  GALGAS_uint var_ruleIndex = GALGAS_uint ((uint32_t) 0U) ;
  cEnumerator_programRuleList enumerator_6270 (constinArgument_inProgramRules, kEnumeration_up) ;
  while (enumerator_6270.hasCurrentObject ()) {
    const enumGalgasBool test_0 = GALGAS_bool (kIsNotEqual, enumerator_6270.current_mIndexingGrammar (HERE).mAttribute_string.objectCompare (GALGAS_string::makeEmptyString ())).boolEnum () ;
    if (kBoolTrue == test_0) {
      ioArgument_ioHasIndexing = GALGAS_bool (true) ;
      GALGAS_bool var_hasIndexing ;
      GALGAS_grammarLabelMap joker_6432_0 ; // Joker input parameter
      GALGAS_bool joker_6455_0 ; // Joker input parameter
      constinArgument_inAnalysisContext.mAttribute_mSemanticContext.mAttribute_mGrammarMap.method_searchKey (enumerator_6270.current_mIndexingGrammar (HERE), joker_6432_0, var_hasIndexing, joker_6455_0, inCompiler COMMA_SOURCE_FILE ("programComponentCompilation.gSemantics", 152)) ;
      const enumGalgasBool test_1 = var_hasIndexing.operator_not (SOURCE_FILE ("programComponentCompilation.gSemantics", 153)).boolEnum () ;
      if (kBoolTrue == test_1) {
        GALGAS_location location_2 (enumerator_6270.current_mIndexingGrammar (HERE).reader_location (HERE)) ; // Implicit use of 'location' reader
        inCompiler->emitSemanticError (location_2, GALGAS_string ("the '").operator_concat (enumerator_6270.current_mIndexingGrammar (HERE).reader_string (SOURCE_FILE ("programComponentCompilation.gSemantics", 154))  COMMA_SOURCE_FILE ("programComponentCompilation.gSemantics", 154)).operator_concat (GALGAS_string ("' grammar does not enable indexing")  COMMA_SOURCE_FILE ("programComponentCompilation.gSemantics", 154))  COMMA_SOURCE_FILE ("programComponentCompilation.gSemantics", 154)) ;
      }
    }
    GALGAS_formalParameterListAST temp_3 = GALGAS_formalParameterListAST::constructor_emptyList (SOURCE_FILE ("programComponentCompilation.gSemantics", 162)) ;
    temp_3.addAssign_operation (GALGAS_string::makeEmptyString ().reader_nowhere (SOURCE_FILE ("programComponentCompilation.gSemantics", 158)), GALGAS_formalArgumentPassingModeAST::constructor_argumentConstantIn (SOURCE_FILE ("programComponentCompilation.gSemantics", 159)), GALGAS_lstring::constructor_new (GALGAS_string ("lstring"), inCompiler->here ()  COMMA_SOURCE_FILE ("programComponentCompilation.gSemantics", 160)), enumerator_6270.current_mSourceFileVariableName (HERE), enumerator_6270.current_mSourceFileVariableNameIsUnused (HERE)  COMMA_SOURCE_FILE ("programComponentCompilation.gSemantics", 162)) ;
    GALGAS_formalParameterListAST var_argumentList = temp_3 ;
    GALGAS_semanticInstructionListForGeneration var_semanticInstructionListForGeneration ;
    GALGAS_formalParameterListForGeneration var_routineSignature ;
    {
    routine_analyzeRoutineBody (constinArgument_inAnalysisContext, var_argumentList, GALGAS_localConstantList::constructor_emptyList (SOURCE_FILE ("programComponentCompilation.gSemantics", 169)), GALGAS_typedAttributeList::constructor_emptyList (SOURCE_FILE ("programComponentCompilation.gSemantics", 170)), GALGAS_typedAttributeList::constructor_emptyList (SOURCE_FILE ("programComponentCompilation.gSemantics", 171)), GALGAS_string::makeEmptyString (), enumerator_6270.current_mInstructionList (HERE), enumerator_6270.current_mEndOfInstructionList (HERE), var_semanticInstructionListForGeneration, var_routineSignature, inCompiler  COMMA_SOURCE_FILE ("programComponentCompilation.gSemantics", 166)) ;
    }
    ioArgument_ioDecoratedDeclarationListForGeneration.addAssign_operation (GALGAS_string ("source rule ").operator_concat (var_ruleIndex.reader_string (SOURCE_FILE ("programComponentCompilation.gSemantics", 179))  COMMA_SOURCE_FILE ("programComponentCompilation.gSemantics", 179)), GALGAS_routineImplementationForGeneration::constructor_new (GALGAS_bool (false), GALGAS_string ("proc-programrule"), GALGAS_string ("programRule_").operator_concat (var_ruleIndex.reader_string (SOURCE_FILE ("programComponentCompilation.gSemantics", 183))  COMMA_SOURCE_FILE ("programComponentCompilation.gSemantics", 183)), var_routineSignature, GALGAS_bool (false), var_semanticInstructionListForGeneration  COMMA_SOURCE_FILE ("programComponentCompilation.gSemantics", 180)), GALGAS_string::makeEmptyString ()  COMMA_SOURCE_FILE ("programComponentCompilation.gSemantics", 178)) ;
    var_ruleIndex.increment_operation (inCompiler  COMMA_SOURCE_FILE ("programComponentCompilation.gSemantics", 190)) ;
    enumerator_6270.gotoNextObject () ;
  }
}


//---------------------------------------------------------------------------------------------------------------------*
//                                                                                                                     *
//                                        Routine 'compileProgramRulesGalgas3'                                         *
//                                                                                                                     *
//---------------------------------------------------------------------------------------------------------------------*

void routine_compileProgramRulesGalgas_33_ (const GALGAS_analysisContext constinArgument_inAnalysisContext,
                                            const GALGAS_programRuleList constinArgument_inProgramRules,
                                            GALGAS_programListForGeneration & ioArgument_ioDecoratedDeclarationListForGeneration,
                                            GALGAS_bool & ioArgument_ioHasIndexing,
                                            C_Compiler * inCompiler
                                            COMMA_UNUSED_LOCATION_ARGS) {
  GALGAS_uint var_ruleIndex = GALGAS_uint ((uint32_t) 0U) ;
  cEnumerator_programRuleList enumerator_8162 (constinArgument_inProgramRules, kEnumeration_up) ;
  while (enumerator_8162.hasCurrentObject ()) {
    const enumGalgasBool test_0 = GALGAS_bool (kIsNotEqual, enumerator_8162.current_mIndexingGrammar (HERE).mAttribute_string.objectCompare (GALGAS_string::makeEmptyString ())).boolEnum () ;
    if (kBoolTrue == test_0) {
      ioArgument_ioHasIndexing = GALGAS_bool (true) ;
      GALGAS_bool var_hasIndexing ;
      GALGAS_grammarLabelMap joker_8324_0 ; // Joker input parameter
      GALGAS_bool joker_8347_0 ; // Joker input parameter
      constinArgument_inAnalysisContext.mAttribute_mSemanticContext.mAttribute_mGrammarMap.method_searchKey (enumerator_8162.current_mIndexingGrammar (HERE), joker_8324_0, var_hasIndexing, joker_8347_0, inCompiler COMMA_SOURCE_FILE ("programComponentCompilation.gSemantics", 206)) ;
      const enumGalgasBool test_1 = var_hasIndexing.operator_not (SOURCE_FILE ("programComponentCompilation.gSemantics", 207)).boolEnum () ;
      if (kBoolTrue == test_1) {
        GALGAS_location location_2 (enumerator_8162.current_mIndexingGrammar (HERE).reader_location (HERE)) ; // Implicit use of 'location' reader
        inCompiler->emitSemanticError (location_2, GALGAS_string ("the '").operator_concat (enumerator_8162.current_mIndexingGrammar (HERE).reader_string (SOURCE_FILE ("programComponentCompilation.gSemantics", 208))  COMMA_SOURCE_FILE ("programComponentCompilation.gSemantics", 208)).operator_concat (GALGAS_string ("' grammar does not enable indexing")  COMMA_SOURCE_FILE ("programComponentCompilation.gSemantics", 208))  COMMA_SOURCE_FILE ("programComponentCompilation.gSemantics", 208)) ;
      }
    }
    GALGAS_formalParameterListAST temp_3 = GALGAS_formalParameterListAST::constructor_emptyList (SOURCE_FILE ("programComponentCompilation.gSemantics", 216)) ;
    temp_3.addAssign_operation (GALGAS_string::makeEmptyString ().reader_nowhere (SOURCE_FILE ("programComponentCompilation.gSemantics", 212)), GALGAS_formalArgumentPassingModeAST::constructor_argumentConstantIn (SOURCE_FILE ("programComponentCompilation.gSemantics", 213)), GALGAS_lstring::constructor_new (GALGAS_string ("lstring"), inCompiler->here ()  COMMA_SOURCE_FILE ("programComponentCompilation.gSemantics", 214)), enumerator_8162.current_mSourceFileVariableName (HERE), enumerator_8162.current_mSourceFileVariableNameIsUnused (HERE)  COMMA_SOURCE_FILE ("programComponentCompilation.gSemantics", 216)) ;
    GALGAS_formalParameterListAST var_argumentList = temp_3 ;
    GALGAS_semanticInstructionListForGeneration var_semanticInstructionListForGeneration ;
    GALGAS_formalParameterListForGeneration var_routineSignature ;
    {
    routine_analyzeRoutineBody (constinArgument_inAnalysisContext, var_argumentList, GALGAS_localConstantList::constructor_emptyList (SOURCE_FILE ("programComponentCompilation.gSemantics", 223)), GALGAS_typedAttributeList::constructor_emptyList (SOURCE_FILE ("programComponentCompilation.gSemantics", 224)), GALGAS_typedAttributeList::constructor_emptyList (SOURCE_FILE ("programComponentCompilation.gSemantics", 225)), GALGAS_string::makeEmptyString (), enumerator_8162.current_mInstructionList (HERE), enumerator_8162.current_mEndOfInstructionList (HERE), var_semanticInstructionListForGeneration, var_routineSignature, inCompiler  COMMA_SOURCE_FILE ("programComponentCompilation.gSemantics", 220)) ;
    }
    ioArgument_ioDecoratedDeclarationListForGeneration.addAssign_operation (GALGAS_routineImplementationForGeneration::constructor_new (GALGAS_bool (false), GALGAS_string ("proc-programrule"), GALGAS_string ("programRule_").operator_concat (var_ruleIndex.reader_string (SOURCE_FILE ("programComponentCompilation.gSemantics", 236))  COMMA_SOURCE_FILE ("programComponentCompilation.gSemantics", 236)), var_routineSignature, GALGAS_bool (true), var_semanticInstructionListForGeneration  COMMA_SOURCE_FILE ("programComponentCompilation.gSemantics", 233))  COMMA_SOURCE_FILE ("programComponentCompilation.gSemantics", 232)) ;
    var_ruleIndex.increment_operation (inCompiler  COMMA_SOURCE_FILE ("programComponentCompilation.gSemantics", 242)) ;
    enumerator_8162.gotoNextObject () ;
  }
}


//---------------------------------------------------------------------------------------------------------------------*
//                                                                                                                     *
//                                            Routine 'compileAfterClause'                                             *
//                                                                                                                     *
//---------------------------------------------------------------------------------------------------------------------*

void routine_compileAfterClause (const GALGAS_analysisContext constinArgument_inAnalysisContext,
                                 const GALGAS_prologueEpilogueList constinArgument_inEpilogueList,
                                 GALGAS_semanticDeclarationSortedListForGeneration & ioArgument_ioDecoratedDeclarationListForGeneration,
                                 C_Compiler * inCompiler
                                 COMMA_UNUSED_LOCATION_ARGS) {
  GALGAS_semanticInstructionListForGeneration var_semanticInstructionListForGeneration = GALGAS_semanticInstructionListForGeneration::constructor_emptyList (SOURCE_FILE ("programComponentCompilation.gSemantics", 258)) ;
  cEnumerator_prologueEpilogueList enumerator_10407 (constinArgument_inEpilogueList, kEnumeration_up) ;
  while (enumerator_10407.hasCurrentObject ()) {
    GALGAS_semanticInstructionListForGeneration var_blockSemanticInstructionListForGeneration ;
    {
    GALGAS_formalParameterListForGeneration joker_10890_0 ; // Joker input parameter
    routine_analyzeRoutineBody (constinArgument_inAnalysisContext, GALGAS_formalParameterListAST::constructor_emptyList (SOURCE_FILE ("programComponentCompilation.gSemantics", 262)), GALGAS_localConstantList::constructor_emptyList (SOURCE_FILE ("programComponentCompilation.gSemantics", 263)), GALGAS_typedAttributeList::constructor_emptyList (SOURCE_FILE ("programComponentCompilation.gSemantics", 264)), GALGAS_typedAttributeList::constructor_emptyList (SOURCE_FILE ("programComponentCompilation.gSemantics", 265)), GALGAS_string::makeEmptyString (), enumerator_10407.current_mInstructionList (HERE), enumerator_10407.current_mEndOfInstructionList (HERE), var_blockSemanticInstructionListForGeneration, joker_10890_0, inCompiler  COMMA_SOURCE_FILE ("programComponentCompilation.gSemantics", 260)) ;
    }
    var_semanticInstructionListForGeneration.addAssign_operation (GALGAS_semanticBlockInstructionForGeneration::constructor_new (var_blockSemanticInstructionListForGeneration  COMMA_SOURCE_FILE ("programComponentCompilation.gSemantics", 272))  COMMA_SOURCE_FILE ("programComponentCompilation.gSemantics", 272)) ;
    enumerator_10407.gotoNextObject () ;
  }
  ioArgument_ioDecoratedDeclarationListForGeneration.addAssign_operation (GALGAS_string ("after"), GALGAS_routineImplementationForGeneration::constructor_new (GALGAS_bool (false), GALGAS_string ("proc-after"), GALGAS_string ("after"), GALGAS_formalParameterListForGeneration::constructor_emptyList (SOURCE_FILE ("programComponentCompilation.gSemantics", 283)), GALGAS_bool (false), var_semanticInstructionListForGeneration  COMMA_SOURCE_FILE ("programComponentCompilation.gSemantics", 279)), GALGAS_string::makeEmptyString ()  COMMA_SOURCE_FILE ("programComponentCompilation.gSemantics", 277)) ;
}


//---------------------------------------------------------------------------------------------------------------------*
//                                                                                                                     *
//                                         Routine 'compileAfterClauseGalgas3'                                         *
//                                                                                                                     *
//---------------------------------------------------------------------------------------------------------------------*

void routine_compileAfterClauseGalgas_33_ (const GALGAS_analysisContext constinArgument_inAnalysisContext,
                                           const GALGAS_prologueEpilogueList constinArgument_inEpilogueList,
                                           GALGAS_programListForGeneration & ioArgument_ioDecoratedDeclarationListForGeneration,
                                           C_Compiler * inCompiler
                                           COMMA_UNUSED_LOCATION_ARGS) {
  GALGAS_semanticInstructionListForGeneration var_semanticInstructionListForGeneration = GALGAS_semanticInstructionListForGeneration::constructor_emptyList (SOURCE_FILE ("programComponentCompilation.gSemantics", 299)) ;
  cEnumerator_prologueEpilogueList enumerator_11817 (constinArgument_inEpilogueList, kEnumeration_up) ;
  while (enumerator_11817.hasCurrentObject ()) {
    GALGAS_semanticInstructionListForGeneration var_blockSemanticInstructionListForGeneration ;
    {
    GALGAS_formalParameterListForGeneration joker_12300_0 ; // Joker input parameter
    routine_analyzeRoutineBody (constinArgument_inAnalysisContext, GALGAS_formalParameterListAST::constructor_emptyList (SOURCE_FILE ("programComponentCompilation.gSemantics", 303)), GALGAS_localConstantList::constructor_emptyList (SOURCE_FILE ("programComponentCompilation.gSemantics", 304)), GALGAS_typedAttributeList::constructor_emptyList (SOURCE_FILE ("programComponentCompilation.gSemantics", 305)), GALGAS_typedAttributeList::constructor_emptyList (SOURCE_FILE ("programComponentCompilation.gSemantics", 306)), GALGAS_string::makeEmptyString (), enumerator_11817.current_mInstructionList (HERE), enumerator_11817.current_mEndOfInstructionList (HERE), var_blockSemanticInstructionListForGeneration, joker_12300_0, inCompiler  COMMA_SOURCE_FILE ("programComponentCompilation.gSemantics", 301)) ;
    }
    var_semanticInstructionListForGeneration.addAssign_operation (GALGAS_semanticBlockInstructionForGeneration::constructor_new (var_blockSemanticInstructionListForGeneration  COMMA_SOURCE_FILE ("programComponentCompilation.gSemantics", 313))  COMMA_SOURCE_FILE ("programComponentCompilation.gSemantics", 313)) ;
    enumerator_11817.gotoNextObject () ;
  }
  ioArgument_ioDecoratedDeclarationListForGeneration.addAssign_operation (GALGAS_routineImplementationForGeneration::constructor_new (GALGAS_bool (false), GALGAS_string ("proc-after"), GALGAS_string ("after"), GALGAS_formalParameterListForGeneration::constructor_emptyList (SOURCE_FILE ("programComponentCompilation.gSemantics", 323)), GALGAS_bool (true), var_semanticInstructionListForGeneration  COMMA_SOURCE_FILE ("programComponentCompilation.gSemantics", 319))  COMMA_SOURCE_FILE ("programComponentCompilation.gSemantics", 318)) ;
}


//---------------------------------------------------------------------------------------------------------------------*
//                                                                                                                     *
//                                      Routine 'compileProgramComponentFromAST'                                       *
//                                                                                                                     *
//---------------------------------------------------------------------------------------------------------------------*

void routine_compileProgramComponentFromAST (const GALGAS_lstring constinArgument_inSourceFile,
                                             const GALGAS_string constinArgument_inProductDirectory,
                                             const GALGAS_programComponentAST constinArgument_inProgramComponentAST,
                                             GALGAS_parsedComponentStruct & ioArgument_ioParsedComponentStruct,
                                             C_Compiler * inCompiler
                                             COMMA_UNUSED_LOCATION_ARGS) {
  GALGAS_string var_basename = constinArgument_inSourceFile.mAttribute_string.reader_lastPathComponent (SOURCE_FILE ("programComponentCompilation.gSemantics", 342)).reader_stringByDeletingPathExtension (SOURCE_FILE ("programComponentCompilation.gSemantics", 342)) ;
  GALGAS_lstring var_componentName = constinArgument_inProgramComponentAST.reader_mProgramComponentName (SOURCE_FILE ("programComponentCompilation.gSemantics", 344)) ;
  const enumGalgasBool test_0 = GALGAS_bool (kIsNotEqual, var_componentName.reader_string (SOURCE_FILE ("programComponentCompilation.gSemantics", 345)).objectCompare (var_basename)).boolEnum () ;
  if (kBoolTrue == test_0) {
    GALGAS_location location_1 (var_componentName.reader_location (HERE)) ; // Implicit use of 'location' reader
    inCompiler->emitSemanticWarning (location_1, GALGAS_string ("GALGAS checks the component name ('").operator_concat (var_componentName.reader_string (SOURCE_FILE ("programComponentCompilation.gSemantics", 347))  COMMA_SOURCE_FILE ("programComponentCompilation.gSemantics", 347)).operator_concat (GALGAS_string ("') against the source file base name ('")  COMMA_SOURCE_FILE ("programComponentCompilation.gSemantics", 347)).operator_concat (var_basename  COMMA_SOURCE_FILE ("programComponentCompilation.gSemantics", 348)).operator_concat (GALGAS_string ("'): they should be identical")  COMMA_SOURCE_FILE ("programComponentCompilation.gSemantics", 348))  COMMA_SOURCE_FILE ("programComponentCompilation.gSemantics", 346)) ;
  }
  GALGAS_semanticDeclarationListAST var_semanticDeclarationList = constinArgument_inProgramComponentAST.reader_mSemanticDeclarationList (SOURCE_FILE ("programComponentCompilation.gSemantics", 352)) ;
  GALGAS_stringset var_parsedFileSet = GALGAS_stringset::constructor_setWithString (constinArgument_inSourceFile.reader_string (SOURCE_FILE ("programComponentCompilation.gSemantics", 353)) COMMA_SOURCE_FILE ("programComponentCompilation.gSemantics", 353)) ;
  GALGAS_lstringlist var_optionComponentFileNameList = GALGAS_lstringlist::constructor_emptyList (SOURCE_FILE ("programComponentCompilation.gSemantics", 354)) ;
  GALGAS_grammarComponentASTList var_grammarComponentASTList = GALGAS_grammarComponentASTList::constructor_emptyList (SOURCE_FILE ("programComponentCompilation.gSemantics", 355)) ;
  GALGAS_stringlist var_headerIncludeList = GALGAS_stringlist::constructor_emptyList (SOURCE_FILE ("programComponentCompilation.gSemantics", 356)) ;
  GALGAS_stringlist temp_2 = GALGAS_stringlist::constructor_emptyList (SOURCE_FILE ("programComponentCompilation.gSemantics", 357)) ;
  temp_2.addAssign_operation (var_componentName.mAttribute_string  COMMA_SOURCE_FILE ("programComponentCompilation.gSemantics", 357)) ;
  GALGAS_stringlist var_implementationIncludeList = temp_2 ;
  {
  routine_recursivelyImportSemanticComponentAndCheckNoCircularityInImportSemantics (constinArgument_inSourceFile, ioArgument_ioParsedComponentStruct, var_optionComponentFileNameList, var_grammarComponentASTList, var_semanticDeclarationList, var_parsedFileSet, var_headerIncludeList, var_implementationIncludeList, constinArgument_inProgramComponentAST.reader_mImportedComponentFileNameList (SOURCE_FILE ("programComponentCompilation.gSemantics", 367)), constinArgument_inSourceFile.mAttribute_string.reader_stringByDeletingLastPathComponent (SOURCE_FILE ("programComponentCompilation.gSemantics", 368)), inCompiler  COMMA_SOURCE_FILE ("programComponentCompilation.gSemantics", 358)) ;
  }
  GALGAS_semanticDeclarationListAST var_semanticDeclarationListWithPredefinedTypes = var_semanticDeclarationList ;
  {
  routine_appendPredefinedTypesASTs (var_semanticDeclarationListWithPredefinedTypes, inCompiler  COMMA_SOURCE_FILE ("programComponentCompilation.gSemantics", 372)) ;
  }
  GALGAS_semanticContext var_semanticContext ;
  {
  routine_buildSemanticContext (var_semanticDeclarationListWithPredefinedTypes, var_semanticContext, inCompiler  COMMA_SOURCE_FILE ("programComponentCompilation.gSemantics", 374)) ;
  }
  {
  routine_buildGrammarComponentMapForSemanticAnalysis (var_grammarComponentASTList, var_semanticContext, inCompiler  COMMA_SOURCE_FILE ("programComponentCompilation.gSemantics", 379)) ;
  }
  {
  routine_buildOptionComponentMapForSemanticAnalysis (var_optionComponentFileNameList, ioArgument_ioParsedComponentStruct, var_semanticContext.mAttribute_mOptionComponentMapForSemanticAnalysis, inCompiler  COMMA_SOURCE_FILE ("programComponentCompilation.gSemantics", 384)) ;
  }
  GALGAS_lexiqueComponentMapForSemanticAnalysis var_lexiqueMap ;
  {
  routine_buildLexiqueComponentMapForSemanticAnalysis (ioArgument_ioParsedComponentStruct, var_lexiqueMap, inCompiler  COMMA_SOURCE_FILE ("programComponentCompilation.gSemantics", 390)) ;
  }
  var_semanticContext.mAttribute_mLexiqueComponentMapForSemanticAnalysis = var_lexiqueMap ;
  GALGAS_semanticDeclarationSortedListForGeneration var_decoratedDeclarationListForGeneration ;
  {
  routine_performSemanticAnalysis (constinArgument_inProductDirectory, constinArgument_inProgramComponentAST.reader_mSemanticDeclarationList (SOURCE_FILE ("programComponentCompilation.gSemantics", 399)), var_semanticContext, var_decoratedDeclarationListForGeneration, inCompiler  COMMA_SOURCE_FILE ("programComponentCompilation.gSemantics", 397)) ;
  }
  GALGAS_analysisContext var_analysisContext = GALGAS_analysisContext::constructor_new (var_semanticContext, function_buildPredefinedTypes (var_semanticContext, inCompiler COMMA_SOURCE_FILE ("programComponentCompilation.gSemantics", 406)), GALGAS_unifiedTypeMap_2D_proxy::constructor_null (SOURCE_FILE ("programComponentCompilation.gSemantics", 407)), GALGAS_string::makeEmptyString (), GALGAS_unifiedTypeMap_2D_proxy::constructor_null (SOURCE_FILE ("programComponentCompilation.gSemantics", 409))  COMMA_SOURCE_FILE ("programComponentCompilation.gSemantics", 404)) ;
  {
  routine_compileBeforeClause (var_analysisContext, constinArgument_inProgramComponentAST.mAttribute_mPrologueList, var_decoratedDeclarationListForGeneration, inCompiler  COMMA_SOURCE_FILE ("programComponentCompilation.gSemantics", 412)) ;
  }
  GALGAS_bool var_hasIndexing = GALGAS_bool (false) ;
  {
  routine_compileProgramRules (var_analysisContext, constinArgument_inProgramComponentAST.mAttribute_mProgramRules, var_decoratedDeclarationListForGeneration, var_hasIndexing, inCompiler  COMMA_SOURCE_FILE ("programComponentCompilation.gSemantics", 419)) ;
  }
  {
  routine_compileAfterClause (var_analysisContext, constinArgument_inProgramComponentAST.mAttribute_mEpilogueList, var_decoratedDeclarationListForGeneration, inCompiler  COMMA_SOURCE_FILE ("programComponentCompilation.gSemantics", 426)) ;
  }
  const enumGalgasBool test_3 = GALGAS_bool (kIsEqual, GALGAS_uint::constructor_errorCount (SOURCE_FILE ("programComponentCompilation.gSemantics", 432)).objectCompare (GALGAS_uint ((uint32_t) 0U))).boolEnum () ;
  if (kBoolTrue == test_3) {
    GALGAS_string var_headerString = GALGAS_string (filewrapperTemplate_programFileGenerationTemplate_programFileHeader (inCompiler, var_componentName.reader_string (SOURCE_FILE ("programComponentCompilation.gSemantics", 434)), var_headerIncludeList COMMA_SOURCE_FILE ("programComponentCompilation.gSemantics", 433))) ;
    cEnumerator_semanticDeclarationSortedListForGeneration enumerator_17014 (var_decoratedDeclarationListForGeneration, kEnumeration_up) ;
    while (enumerator_17014.hasCurrentObject ()) {
      GALGAS_stringset var_unusedInclusionSet = GALGAS_stringset::constructor_emptySet (SOURCE_FILE ("programComponentCompilation.gSemantics", 438)) ;
      GALGAS_string var_code ;
      callCategoryMethod_appendDeclaration_31_ ((const cPtr_semanticDeclarationForGeneration *) enumerator_17014.current_mDeclaration (HERE).ptr (), var_unusedInclusionSet, var_code, inCompiler COMMA_SOURCE_FILE ("programComponentCompilation.gSemantics", 439)) ;
      var_headerString.dotAssign_operation (var_code  COMMA_SOURCE_FILE ("programComponentCompilation.gSemantics", 440)) ;
      enumerator_17014.gotoNextObject () ;
    }
    cEnumerator_semanticDeclarationSortedListForGeneration enumerator_17248 (var_decoratedDeclarationListForGeneration, kEnumeration_up) ;
    while (enumerator_17248.hasCurrentObject ()) {
      GALGAS_stringset var_inclusionSet_32_ = GALGAS_stringset::constructor_emptySet (SOURCE_FILE ("programComponentCompilation.gSemantics", 443)) ;
      GALGAS_string var_headerString_32_ ;
      callCategoryMethod_appendDeclaration_32_ ((const cPtr_semanticDeclarationForGeneration *) enumerator_17248.current_mDeclaration (HERE).ptr (), GALGAS_bool (false), constinArgument_inProductDirectory, var_inclusionSet_32_, var_headerString_32_, inCompiler COMMA_SOURCE_FILE ("programComponentCompilation.gSemantics", 444)) ;
      var_headerString.dotAssign_operation (var_headerString_32_  COMMA_SOURCE_FILE ("programComponentCompilation.gSemantics", 445)) ;
      enumerator_17248.gotoNextObject () ;
    }
    {
    GALGAS_string::class_method_generateFileWithPattern (constinArgument_inProductDirectory, var_componentName.reader_string (SOURCE_FILE ("programComponentCompilation.gSemantics", 449)).operator_concat (GALGAS_string (".h")  COMMA_SOURCE_FILE ("programComponentCompilation.gSemantics", 449)), GALGAS_string ("//"), GALGAS_string ("\n"
      "\n"), var_headerString, GALGAS_string ("\n"
      "\n"), GALGAS_string ("#endif\n"), inCompiler COMMA_SOURCE_FILE ("programComponentCompilation.gSemantics", 447)) ;
    }
  }
  const enumGalgasBool test_4 = GALGAS_bool (kIsEqual, GALGAS_uint::constructor_errorCount (SOURCE_FILE ("programComponentCompilation.gSemantics", 458)).objectCompare (GALGAS_uint ((uint32_t) 0U))).boolEnum () ;
  if (kBoolTrue == test_4) {
    GALGAS_string var_beforAfterRulesImplementationString = GALGAS_string::makeEmptyString () ;
    cEnumerator_semanticDeclarationSortedListForGeneration enumerator_17877 (var_decoratedDeclarationListForGeneration, kEnumeration_up) ;
    while (enumerator_17877.hasCurrentObject ()) {
      var_beforAfterRulesImplementationString.dotAssign_operation (callCategoryReader_appendTypeGenericImplementation ((const cPtr_semanticDeclarationForGeneration *) enumerator_17877.current_mDeclaration (HERE).ptr (), inCompiler COMMA_SOURCE_FILE ("programComponentCompilation.gSemantics", 461))  COMMA_SOURCE_FILE ("programComponentCompilation.gSemantics", 461)) ;
      GALGAS_stringset var_unusedInclusionSet = GALGAS_stringset::constructor_emptySet (SOURCE_FILE ("programComponentCompilation.gSemantics", 462)) ;
      GALGAS_string var_code ;
      callCategoryMethod_appendSpecificImplementation ((const cPtr_semanticDeclarationForGeneration *) enumerator_17877.current_mDeclaration (HERE).ptr (), var_semanticContext.mAttribute_mTypeMap, var_unusedInclusionSet, var_code, inCompiler COMMA_SOURCE_FILE ("programComponentCompilation.gSemantics", 463)) ;
      var_beforAfterRulesImplementationString.dotAssign_operation (var_code  COMMA_SOURCE_FILE ("programComponentCompilation.gSemantics", 464)) ;
      enumerator_17877.gotoNextObject () ;
    }
    GALGAS_string var_implementationString = GALGAS_string (filewrapperTemplate_programFileGenerationTemplate_programFileImplementation (inCompiler, var_componentName.reader_string (SOURCE_FILE ("programComponentCompilation.gSemantics", 467)), var_implementationIncludeList, var_beforAfterRulesImplementationString, constinArgument_inProgramComponentAST.reader_mProgramRules (SOURCE_FILE ("programComponentCompilation.gSemantics", 470)), var_hasIndexing COMMA_SOURCE_FILE ("programComponentCompilation.gSemantics", 466))) ;
    {
    GALGAS_string::class_method_generateFileWithPattern (constinArgument_inProductDirectory, var_componentName.reader_string (SOURCE_FILE ("programComponentCompilation.gSemantics", 475)).operator_concat (GALGAS_string (".cpp")  COMMA_SOURCE_FILE ("programComponentCompilation.gSemantics", 475)), GALGAS_string ("//"), GALGAS_string ("\n"
      "\n"), var_implementationString, GALGAS_string ("\n"
      "\n"), GALGAS_string ("\n"), inCompiler COMMA_SOURCE_FILE ("programComponentCompilation.gSemantics", 473)) ;
    }
  }
}


//---------------------------------------------------------------------------------------------------------------------*
//                                                                                                                     *
//                                   Routine 'compileProgramComponentFromSourceFile'                                   *
//                                                                                                                     *
//---------------------------------------------------------------------------------------------------------------------*

void routine_compileProgramComponentFromSourceFile (const GALGAS_lstring constinArgument_inSourceFile,
                                                    const GALGAS_string constinArgument_inProductDirectory,
                                                    GALGAS_parsedComponentStruct & ioArgument_ioParsedComponentStruct,
                                                    C_Compiler * inCompiler
                                                    COMMA_UNUSED_LOCATION_ARGS) {
  GALGAS_string var_basename = constinArgument_inSourceFile.mAttribute_string.reader_lastPathComponent (SOURCE_FILE ("programComponentCompilation.gSemantics", 493)).reader_stringByDeletingPathExtension (SOURCE_FILE ("programComponentCompilation.gSemantics", 493)) ;
  GALGAS_lstring var_basenameKey = GALGAS_lstring::constructor_new (var_basename, inCompiler->here ()  COMMA_SOURCE_FILE ("programComponentCompilation.gSemantics", 494)) ;
  GALGAS_programComponentAST var_programComponentAST ;
  const enumGalgasBool test_0 = ioArgument_ioParsedComponentStruct.mAttribute_mParsedProgramComponentMap.reader_hasKey (var_basename COMMA_SOURCE_FILE ("programComponentCompilation.gSemantics", 496)).boolEnum () ;
  if (kBoolTrue == test_0) {
    GALGAS_lstring joker_19361_0 ; // Joker input parameter
    ioArgument_ioParsedComponentStruct.mAttribute_mParsedProgramComponentMap.method_searchKey (var_basenameKey, joker_19361_0, var_programComponentAST, inCompiler COMMA_SOURCE_FILE ("programComponentCompilation.gSemantics", 497)) ;
  }else if (kBoolFalse == test_0) {
    var_programComponentAST.drop () ;
    C_String syntaxDirectedTranslationResult_19423 ;
    cGrammar_programSLRgrammar::_performSourceFileParsing_ (inCompiler, syntaxDirectedTranslationResult_19423, constinArgument_inSourceFile, var_programComponentAST  COMMA_SOURCE_FILE ("programComponentCompilation.gSemantics", 499)) ;
    {
    ioArgument_ioParsedComponentStruct.mAttribute_mParsedProgramComponentMap.modifier_insertKey (var_basenameKey, constinArgument_inSourceFile, var_programComponentAST, inCompiler COMMA_SOURCE_FILE ("programComponentCompilation.gSemantics", 500)) ;
    }
  }
  {
  routine_compileProgramComponentFromAST (constinArgument_inSourceFile, constinArgument_inProductDirectory, var_programComponentAST, ioArgument_ioParsedComponentStruct, inCompiler  COMMA_SOURCE_FILE ("programComponentCompilation.gSemantics", 503)) ;
  }
}


//---------------------------------------------------------------------------------------------------------------------*
//                                                                                                                     *
//                                      Routine 'compileProgramComponentGalgas3'                                       *
//                                                                                                                     *
//---------------------------------------------------------------------------------------------------------------------*

void routine_compileProgramComponentGalgas_33_ (const GALGAS_prologueEpilogueList constinArgument_inPrologueList,
                                                const GALGAS_programRuleList constinArgument_inProgramRules,
                                                const GALGAS_prologueEpilogueList constinArgument_inEpilogueList,
                                                const GALGAS_semanticContext constinArgument_inSemanticContext,
                                                GALGAS_programComponentForGeneration & outArgument_outProgramComponentForGeneration,
                                                C_Compiler * inCompiler
                                                COMMA_UNUSED_LOCATION_ARGS) {
  outArgument_outProgramComponentForGeneration.drop () ; // Release 'out' argument
  GALGAS_analysisContext var_analysisContext = GALGAS_analysisContext::constructor_new (constinArgument_inSemanticContext, function_buildPredefinedTypes (constinArgument_inSemanticContext, inCompiler COMMA_SOURCE_FILE ("programComponentCompilation.gSemantics", 528)), GALGAS_unifiedTypeMap_2D_proxy::constructor_null (SOURCE_FILE ("programComponentCompilation.gSemantics", 529)), GALGAS_string::makeEmptyString (), GALGAS_unifiedTypeMap_2D_proxy::constructor_null (SOURCE_FILE ("programComponentCompilation.gSemantics", 531))  COMMA_SOURCE_FILE ("programComponentCompilation.gSemantics", 526)) ;
  GALGAS_programListForGeneration var_decoratedDeclarationListForGeneration = GALGAS_programListForGeneration::constructor_emptyList (SOURCE_FILE ("programComponentCompilation.gSemantics", 534)) ;
  {
  routine_compileBeforeClauseGalgas_33_ (var_analysisContext, constinArgument_inPrologueList, var_decoratedDeclarationListForGeneration, inCompiler  COMMA_SOURCE_FILE ("programComponentCompilation.gSemantics", 535)) ;
  }
  {
  routine_compileAfterClauseGalgas_33_ (var_analysisContext, constinArgument_inEpilogueList, var_decoratedDeclarationListForGeneration, inCompiler  COMMA_SOURCE_FILE ("programComponentCompilation.gSemantics", 541)) ;
  }
  GALGAS_bool var_hasIndexing = GALGAS_bool (false) ;
  {
  routine_compileProgramRulesGalgas_33_ (var_analysisContext, constinArgument_inProgramRules, var_decoratedDeclarationListForGeneration, var_hasIndexing, inCompiler  COMMA_SOURCE_FILE ("programComponentCompilation.gSemantics", 548)) ;
  }
  GALGAS_stringset var_inclusionSet = GALGAS_stringset::constructor_emptySet (SOURCE_FILE ("programComponentCompilation.gSemantics", 555)) ;
  GALGAS_string var_beforeAfterRulesString = GALGAS_string::makeEmptyString () ;
  cEnumerator_programListForGeneration enumerator_21453 (var_decoratedDeclarationListForGeneration, kEnumeration_up) ;
  while (enumerator_21453.hasCurrentObject ()) {
    var_beforeAfterRulesString.dotAssign_operation (callCategoryReader_appendTypeGenericImplementation ((const cPtr_semanticDeclarationForGeneration *) enumerator_21453.current_mDeclaration (HERE).ptr (), inCompiler COMMA_SOURCE_FILE ("programComponentCompilation.gSemantics", 558))  COMMA_SOURCE_FILE ("programComponentCompilation.gSemantics", 558)) ;
    GALGAS_string var_code ;
    callCategoryMethod_appendSpecificImplementation ((const cPtr_semanticDeclarationForGeneration *) enumerator_21453.current_mDeclaration (HERE).ptr (), constinArgument_inSemanticContext.mAttribute_mTypeMap, var_inclusionSet, var_code, inCompiler COMMA_SOURCE_FILE ("programComponentCompilation.gSemantics", 559)) ;
    var_beforeAfterRulesString.dotAssign_operation (var_code  COMMA_SOURCE_FILE ("programComponentCompilation.gSemantics", 560)) ;
    enumerator_21453.gotoNextObject () ;
  }
  cEnumerator_programRuleList enumerator_22029 (constinArgument_inProgramRules, kEnumeration_up) ;
  while (enumerator_22029.hasCurrentObject ()) {
    const enumGalgasBool test_0 = GALGAS_bool (kIsNotEqual, enumerator_22029.current_mIndexingGrammar (HERE).mAttribute_string.objectCompare (GALGAS_string::makeEmptyString ())).boolEnum () ;
    if (kBoolTrue == test_0) {
      var_inclusionSet.addAssign_operation (GALGAS_string ("grammar-").add_operation (enumerator_22029.current_mIndexingGrammar (HERE).reader_string (SOURCE_FILE ("programComponentCompilation.gSemantics", 573)), inCompiler COMMA_SOURCE_FILE ("programComponentCompilation.gSemantics", 573))  COMMA_SOURCE_FILE ("programComponentCompilation.gSemantics", 573)) ;
    }
    enumerator_22029.gotoNextObject () ;
  }
  GALGAS_string var_cppContents = GALGAS_string (filewrapperTemplate_programFileGenerationTemplate_programFileImplementation (inCompiler, GALGAS_string ("program"), GALGAS_stringlist::constructor_emptyList (SOURCE_FILE ("programComponentCompilation.gSemantics", 578)), var_beforeAfterRulesString, constinArgument_inProgramRules, var_hasIndexing COMMA_SOURCE_FILE ("programComponentCompilation.gSemantics", 576))) ;
  outArgument_outProgramComponentForGeneration = GALGAS_programComponentForGeneration::constructor_new (GALGAS_bool (false), GALGAS_string ("program"), var_inclusionSet, var_cppContents  COMMA_SOURCE_FILE ("programComponentCompilation.gSemantics", 584)) ;
}


//---------------------------------------------------------------------------------------------------------------------*

GALGAS_programListForGeneration_2D_element::GALGAS_programListForGeneration_2D_element (void) :
mAttribute_mDeclaration () {
}

//---------------------------------------------------------------------------------------------------------------------*

GALGAS_programListForGeneration_2D_element::~ GALGAS_programListForGeneration_2D_element (void) {
}

//---------------------------------------------------------------------------------------------------------------------*

GALGAS_programListForGeneration_2D_element::GALGAS_programListForGeneration_2D_element (const GALGAS_semanticDeclarationForGeneration & inOperand0) :
mAttribute_mDeclaration (inOperand0) {
}

//---------------------------------------------------------------------------------------------------------------------*

GALGAS_programListForGeneration_2D_element GALGAS_programListForGeneration_2D_element::constructor_new (const GALGAS_semanticDeclarationForGeneration & inOperand0 
                                                                                                        COMMA_UNUSED_LOCATION_ARGS) {
  GALGAS_programListForGeneration_2D_element result ;
  if (inOperand0.isValid ()) {
    result = GALGAS_programListForGeneration_2D_element (inOperand0) ;
  }
  return result ;
}

//---------------------------------------------------------------------------------------------------------------------*

typeComparisonResult GALGAS_programListForGeneration_2D_element::objectCompare (const GALGAS_programListForGeneration_2D_element & inOperand) const {
   typeComparisonResult result = kOperandEqual ;
  if (result == kOperandEqual) {
    result = mAttribute_mDeclaration.objectCompare (inOperand.mAttribute_mDeclaration) ;
  }
  return result ;
}

//---------------------------------------------------------------------------------------------------------------------*

bool GALGAS_programListForGeneration_2D_element::isValid (void) const {
  return mAttribute_mDeclaration.isValid () ;
}

//---------------------------------------------------------------------------------------------------------------------*

void GALGAS_programListForGeneration_2D_element::drop (void) {
  mAttribute_mDeclaration.drop () ;
}

//---------------------------------------------------------------------------------------------------------------------*

void GALGAS_programListForGeneration_2D_element::description (C_String & ioString,
                                                              const int32_t inIndentation) const {
  ioString << "<struct @programListForGeneration-element:" ;
  if (! isValid ()) {
    ioString << " not built" ;
  }else{
    mAttribute_mDeclaration.description (ioString, inIndentation+1) ;
  }
  ioString << ">" ;
}

//---------------------------------------------------------------------------------------------------------------------*

GALGAS_semanticDeclarationForGeneration GALGAS_programListForGeneration_2D_element::reader_mDeclaration (UNUSED_LOCATION_ARGS) const {
  return mAttribute_mDeclaration ;
}



//---------------------------------------------------------------------------------------------------------------------*
//                                                                                                                     *
//                                       @programListForGeneration-element type                                        *
//                                                                                                                     *
//---------------------------------------------------------------------------------------------------------------------*

const C_galgas_type_descriptor
kTypeDescriptor_GALGAS_programListForGeneration_2D_element ("programListForGeneration-element",
                                                            NULL) ;

//---------------------------------------------------------------------------------------------------------------------*

const C_galgas_type_descriptor * GALGAS_programListForGeneration_2D_element::staticTypeDescriptor (void) const {
  return & kTypeDescriptor_GALGAS_programListForGeneration_2D_element ;
}

//---------------------------------------------------------------------------------------------------------------------*

AC_GALGAS_root * GALGAS_programListForGeneration_2D_element::clonedObject (void) const {
  AC_GALGAS_root * result = NULL ;
  if (isValid ()) {
    macroMyNew (result, GALGAS_programListForGeneration_2D_element (*this)) ;
  }
  return result ;
}

//---------------------------------------------------------------------------------------------------------------------*

GALGAS_programListForGeneration_2D_element GALGAS_programListForGeneration_2D_element::extractObject (const GALGAS_object & inObject,
                                                                                                      C_Compiler * inCompiler
                                                                                                      COMMA_LOCATION_ARGS) {
  GALGAS_programListForGeneration_2D_element result ;
  const GALGAS_programListForGeneration_2D_element * p = (const GALGAS_programListForGeneration_2D_element *) inObject.embeddedObject () ;
  if (NULL != p) {
    if (NULL != dynamic_cast <const GALGAS_programListForGeneration_2D_element *> (p)) {
      result = *p ;
    }else{
      inCompiler->castError ("programListForGeneration-element", p->dynamicTypeDescriptor () COMMA_THERE) ;
    }  
  }
  return result ;
}

//--- START OF USER ZONE 2


//--- END OF USER ZONE 2


