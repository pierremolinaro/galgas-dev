//---------------------------------------------------------------------------------------------------------------------*
//                                                                                                                     *
//                                         File 'XcodeProjectGeneration.cpp'                                           *
//                                             Generated by version 2.7.0                                              *
//                                           august 9th, 2014, at 18h57'21"                                            *
//                                                                                                                     *
//---------------------------------------------------------------------------------------------------------------------*

//--- START OF USER ZONE 1


//--- END OF USER ZONE 1

#include "galgas2/C_Compiler.h"
#include "galgas2/C_galgas_io.h"
#include "galgas2/C_galgas_CLI_Options.h"
#include "utilities/C_PrologueEpilogue.h"

//---------------------------------------------------------------------------------------------------------------------*

#include "XcodeProjectGeneration.h"


//---------------------------------------------------------------------------------------------------------------------*
//                                                                                                                     *
//                                           Routine 'build_LIBPM_BDD_group'                                           *
//                                                                                                                     *
//---------------------------------------------------------------------------------------------------------------------*

void routine_build_5F_LIBPM_5F_BDD_5F_group (GALGAS_XcodeProjectDescription & ioArgument_ioXcodeProjectDescription,
                                             GALGAS_XcodeObjectReferenceList & ioArgument_ioFileListForGroup,
                                             C_Compiler * inCompiler
                                             COMMA_UNUSED_LOCATION_ARGS) {
  GALGAS_stringlist var_fileList = GALGAS_stringlist::constructor_emptyList (SOURCE_FILE ("XcodeProjectGeneration.gSemantics", 13)) ;
  {
  routine_append_5F_cpp_5F_h_5F_files (var_fileList, GALGAS_string ("C_BDD"), inCompiler  COMMA_SOURCE_FILE ("XcodeProjectGeneration.gSemantics", 14)) ;
  }
  {
  routine_append_5F_cpp_5F_h_5F_files (var_fileList, GALGAS_string ("C_RelationSingleType"), inCompiler  COMMA_SOURCE_FILE ("XcodeProjectGeneration.gSemantics", 15)) ;
  }
  {
  routine_append_5F_cpp_5F_h_5F_files (var_fileList, GALGAS_string ("C_RelationConfiguration"), inCompiler  COMMA_SOURCE_FILE ("XcodeProjectGeneration.gSemantics", 16)) ;
  }
  {
  routine_append_5F_cpp_5F_h_5F_files (var_fileList, GALGAS_string ("C_Relation"), inCompiler  COMMA_SOURCE_FILE ("XcodeProjectGeneration.gSemantics", 17)) ;
  }
  var_fileList.addAssign_operation (GALGAS_string ("C_BDD-find-or-add.cpp")  COMMA_SOURCE_FILE ("XcodeProjectGeneration.gSemantics", 18)) ;
  var_fileList.addAssign_operation (GALGAS_string ("C_BDD-and-operation.cpp")  COMMA_SOURCE_FILE ("XcodeProjectGeneration.gSemantics", 19)) ;
  var_fileList.addAssign_operation (GALGAS_string ("C_BDD-single-operand-ops.cpp")  COMMA_SOURCE_FILE ("XcodeProjectGeneration.gSemantics", 20)) ;
  var_fileList.addAssign_operation (GALGAS_string ("C_BDD-node.h")  COMMA_SOURCE_FILE ("XcodeProjectGeneration.gSemantics", 21)) ;
  {
  routine_enter_5F_files_5F_in_5F_group (ioArgument_ioXcodeProjectDescription, var_fileList, ioArgument_ioFileListForGroup, inCompiler  COMMA_SOURCE_FILE ("XcodeProjectGeneration.gSemantics", 23)) ;
  }
}


//---------------------------------------------------------------------------------------------------------------------*
//                                                                                                                     *
//                           Routine 'build_LIBPM_BDD_source_files_for_sources_build_phase'                            *
//                                                                                                                     *
//---------------------------------------------------------------------------------------------------------------------*

void routine_build_5F_LIBPM_5F_BDD_5F_source_5F_files_5F_for_5F_sources_5F_build_5F_phase (GALGAS_XcodeProjectDescription & ioArgument_ioXcodeProjectDescription,
                                                                                           GALGAS_Xcode_5F_PBXBuildFile_5F_list & ioArgument_ioBuildPhaseList,
                                                                                           C_Compiler * inCompiler
                                                                                           COMMA_UNUSED_LOCATION_ARGS) {
  GALGAS_stringlist var_fileList = GALGAS_stringlist::constructor_emptyList (SOURCE_FILE ("XcodeProjectGeneration.gSemantics", 36)) ;
  var_fileList.addAssign_operation (GALGAS_string ("C_BDD.cpp")  COMMA_SOURCE_FILE ("XcodeProjectGeneration.gSemantics", 37)) ;
  var_fileList.addAssign_operation (GALGAS_string ("C_BDD-find-or-add.cpp")  COMMA_SOURCE_FILE ("XcodeProjectGeneration.gSemantics", 38)) ;
  var_fileList.addAssign_operation (GALGAS_string ("C_BDD-and-operation.cpp")  COMMA_SOURCE_FILE ("XcodeProjectGeneration.gSemantics", 39)) ;
  var_fileList.addAssign_operation (GALGAS_string ("C_BDD-single-operand-ops.cpp")  COMMA_SOURCE_FILE ("XcodeProjectGeneration.gSemantics", 40)) ;
  var_fileList.addAssign_operation (GALGAS_string ("C_RelationSingleType.cpp")  COMMA_SOURCE_FILE ("XcodeProjectGeneration.gSemantics", 41)) ;
  var_fileList.addAssign_operation (GALGAS_string ("C_RelationConfiguration.cpp")  COMMA_SOURCE_FILE ("XcodeProjectGeneration.gSemantics", 42)) ;
  var_fileList.addAssign_operation (GALGAS_string ("C_Relation.cpp")  COMMA_SOURCE_FILE ("XcodeProjectGeneration.gSemantics", 43)) ;
  {
  routine_enter_5F_file_5F_list_5F_for_5F_sources_5F_build_5F_phase (ioArgument_ioXcodeProjectDescription, var_fileList, ioArgument_ioBuildPhaseList, inCompiler  COMMA_SOURCE_FILE ("XcodeProjectGeneration.gSemantics", 45)) ;
  }
}


//---------------------------------------------------------------------------------------------------------------------*
//                                                                                                                     *
//                                       Routine 'getGALGAS_2_source_file_list'                                        *
//                                                                                                                     *
//---------------------------------------------------------------------------------------------------------------------*

void routine_getGALGAS_5F__32__5F_source_5F_file_5F_list (GALGAS_stringlist & outArgument_out_5F_fileList,
                                                          C_Compiler * /* inCompiler */
                                                          COMMA_UNUSED_LOCATION_ARGS) {
  outArgument_out_5F_fileList.drop () ; // Release 'out' argument
  outArgument_out_5F_fileList = GALGAS_stringlist::constructor_emptyList (SOURCE_FILE ("XcodeProjectGeneration.gSemantics", 58)) ;
  outArgument_out_5F_fileList.addAssign_operation (GALGAS_string ("typeComparisonResult.cpp")  COMMA_SOURCE_FILE ("XcodeProjectGeneration.gSemantics", 59)) ;
  outArgument_out_5F_fileList.addAssign_operation (GALGAS_string ("typeComparisonResult.h")  COMMA_SOURCE_FILE ("XcodeProjectGeneration.gSemantics", 60)) ;
  outArgument_out_5F_fileList.addAssign_operation (GALGAS_string ("cIndexingDictionary.cpp")  COMMA_SOURCE_FILE ("XcodeProjectGeneration.gSemantics", 61)) ;
  outArgument_out_5F_fileList.addAssign_operation (GALGAS_string ("cIndexingDictionary.h")  COMMA_SOURCE_FILE ("XcodeProjectGeneration.gSemantics", 62)) ;
  outArgument_out_5F_fileList.addAssign_operation (GALGAS_string ("C_Compiler.cpp")  COMMA_SOURCE_FILE ("XcodeProjectGeneration.gSemantics", 63)) ;
  outArgument_out_5F_fileList.addAssign_operation (GALGAS_string ("C_Compiler.h")  COMMA_SOURCE_FILE ("XcodeProjectGeneration.gSemantics", 64)) ;
  outArgument_out_5F_fileList.addAssign_operation (GALGAS_string ("C_Lexique.cpp")  COMMA_SOURCE_FILE ("XcodeProjectGeneration.gSemantics", 65)) ;
  outArgument_out_5F_fileList.addAssign_operation (GALGAS_string ("C_Lexique.h")  COMMA_SOURCE_FILE ("XcodeProjectGeneration.gSemantics", 66)) ;
  outArgument_out_5F_fileList.addAssign_operation (GALGAS_string ("scanner_actions.cpp")  COMMA_SOURCE_FILE ("XcodeProjectGeneration.gSemantics", 67)) ;
  outArgument_out_5F_fileList.addAssign_operation (GALGAS_string ("scanner_actions.h")  COMMA_SOURCE_FILE ("XcodeProjectGeneration.gSemantics", 68)) ;
  outArgument_out_5F_fileList.addAssign_operation (GALGAS_string ("C_galgas_io.cpp")  COMMA_SOURCE_FILE ("XcodeProjectGeneration.gSemantics", 69)) ;
  outArgument_out_5F_fileList.addAssign_operation (GALGAS_string ("C_galgas_io.h")  COMMA_SOURCE_FILE ("XcodeProjectGeneration.gSemantics", 70)) ;
  outArgument_out_5F_fileList.addAssign_operation (GALGAS_string ("C_LocationInSource.cpp")  COMMA_SOURCE_FILE ("XcodeProjectGeneration.gSemantics", 71)) ;
  outArgument_out_5F_fileList.addAssign_operation (GALGAS_string ("C_LocationInSource.h")  COMMA_SOURCE_FILE ("XcodeProjectGeneration.gSemantics", 72)) ;
  outArgument_out_5F_fileList.addAssign_operation (GALGAS_string ("C_SourceTextInString.cpp")  COMMA_SOURCE_FILE ("XcodeProjectGeneration.gSemantics", 73)) ;
  outArgument_out_5F_fileList.addAssign_operation (GALGAS_string ("cCollectionElement.cpp")  COMMA_SOURCE_FILE ("XcodeProjectGeneration.gSemantics", 74)) ;
  outArgument_out_5F_fileList.addAssign_operation (GALGAS_string ("cCollectionElement.h")  COMMA_SOURCE_FILE ("XcodeProjectGeneration.gSemantics", 75)) ;
  outArgument_out_5F_fileList.addAssign_operation (GALGAS_string ("capCollectionElementArray.cpp")  COMMA_SOURCE_FILE ("XcodeProjectGeneration.gSemantics", 76)) ;
  outArgument_out_5F_fileList.addAssign_operation (GALGAS_string ("capCollectionElementArray.h")  COMMA_SOURCE_FILE ("XcodeProjectGeneration.gSemantics", 77)) ;
  outArgument_out_5F_fileList.addAssign_operation (GALGAS_string ("C_galgas_function_descriptor.cpp")  COMMA_SOURCE_FILE ("XcodeProjectGeneration.gSemantics", 78)) ;
  outArgument_out_5F_fileList.addAssign_operation (GALGAS_string ("C_galgas_function_descriptor.h")  COMMA_SOURCE_FILE ("XcodeProjectGeneration.gSemantics", 79)) ;
  outArgument_out_5F_fileList.addAssign_operation (GALGAS_string ("C_galgas_class_inspector.cpp")  COMMA_SOURCE_FILE ("XcodeProjectGeneration.gSemantics", 80)) ;
  outArgument_out_5F_fileList.addAssign_operation (GALGAS_string ("C_galgas_class_inspector.h")  COMMA_SOURCE_FILE ("XcodeProjectGeneration.gSemantics", 81)) ;
  outArgument_out_5F_fileList.addAssign_operation (GALGAS_string ("C_galgas_type_descriptor.cpp")  COMMA_SOURCE_FILE ("XcodeProjectGeneration.gSemantics", 82)) ;
  outArgument_out_5F_fileList.addAssign_operation (GALGAS_string ("C_galgas_type_descriptor.h")  COMMA_SOURCE_FILE ("XcodeProjectGeneration.gSemantics", 83)) ;
  outArgument_out_5F_fileList.addAssign_operation (GALGAS_string ("C_galgas_CLI_Options.cpp")  COMMA_SOURCE_FILE ("XcodeProjectGeneration.gSemantics", 84)) ;
  outArgument_out_5F_fileList.addAssign_operation (GALGAS_string ("C_galgas_CLI_Options.h")  COMMA_SOURCE_FILE ("XcodeProjectGeneration.gSemantics", 85)) ;
  outArgument_out_5F_fileList.addAssign_operation (GALGAS_string ("cGenericAbstractEnumerator.cpp")  COMMA_SOURCE_FILE ("XcodeProjectGeneration.gSemantics", 86)) ;
  outArgument_out_5F_fileList.addAssign_operation (GALGAS_string ("cGenericAbstractEnumerator.h")  COMMA_SOURCE_FILE ("XcodeProjectGeneration.gSemantics", 87)) ;
  outArgument_out_5F_fileList.addAssign_operation (GALGAS_string ("cEnumerator_range.cpp")  COMMA_SOURCE_FILE ("XcodeProjectGeneration.gSemantics", 88)) ;
  outArgument_out_5F_fileList.addAssign_operation (GALGAS_string ("cEnumerator_range.h")  COMMA_SOURCE_FILE ("XcodeProjectGeneration.gSemantics", 89)) ;
  outArgument_out_5F_fileList.addAssign_operation (GALGAS_string ("capSortedListElement.cpp")  COMMA_SOURCE_FILE ("XcodeProjectGeneration.gSemantics", 90)) ;
  outArgument_out_5F_fileList.addAssign_operation (GALGAS_string ("capSortedListElement.h")  COMMA_SOURCE_FILE ("XcodeProjectGeneration.gSemantics", 91)) ;
  outArgument_out_5F_fileList.addAssign_operation (GALGAS_string ("capCollectionElement.cpp")  COMMA_SOURCE_FILE ("XcodeProjectGeneration.gSemantics", 92)) ;
  outArgument_out_5F_fileList.addAssign_operation (GALGAS_string ("capCollectionElement.h")  COMMA_SOURCE_FILE ("XcodeProjectGeneration.gSemantics", 93)) ;
  outArgument_out_5F_fileList.addAssign_operation (GALGAS_string ("cObjectArray.cpp")  COMMA_SOURCE_FILE ("XcodeProjectGeneration.gSemantics", 94)) ;
  outArgument_out_5F_fileList.addAssign_operation (GALGAS_string ("cObjectArray.h")  COMMA_SOURCE_FILE ("XcodeProjectGeneration.gSemantics", 95)) ;
  outArgument_out_5F_fileList.addAssign_operation (GALGAS_string ("cSortedListElement.cpp")  COMMA_SOURCE_FILE ("XcodeProjectGeneration.gSemantics", 96)) ;
  outArgument_out_5F_fileList.addAssign_operation (GALGAS_string ("cSortedListElement.h")  COMMA_SOURCE_FILE ("XcodeProjectGeneration.gSemantics", 97)) ;
  outArgument_out_5F_fileList.addAssign_operation (GALGAS_string ("AC_GALGAS_root.cpp")  COMMA_SOURCE_FILE ("XcodeProjectGeneration.gSemantics", 98)) ;
  outArgument_out_5F_fileList.addAssign_operation (GALGAS_string ("AC_GALGAS_root.h")  COMMA_SOURCE_FILE ("XcodeProjectGeneration.gSemantics", 99)) ;
  outArgument_out_5F_fileList.addAssign_operation (GALGAS_string ("AC_GALGAS_graph.cpp")  COMMA_SOURCE_FILE ("XcodeProjectGeneration.gSemantics", 100)) ;
  outArgument_out_5F_fileList.addAssign_operation (GALGAS_string ("AC_GALGAS_graph.h")  COMMA_SOURCE_FILE ("XcodeProjectGeneration.gSemantics", 101)) ;
  outArgument_out_5F_fileList.addAssign_operation (GALGAS_string ("AC_GALGAS_list.cpp")  COMMA_SOURCE_FILE ("XcodeProjectGeneration.gSemantics", 102)) ;
  outArgument_out_5F_fileList.addAssign_operation (GALGAS_string ("AC_GALGAS_list.h")  COMMA_SOURCE_FILE ("XcodeProjectGeneration.gSemantics", 103)) ;
  outArgument_out_5F_fileList.addAssign_operation (GALGAS_string ("AC_GALGAS_sortedlist.cpp")  COMMA_SOURCE_FILE ("XcodeProjectGeneration.gSemantics", 104)) ;
  outArgument_out_5F_fileList.addAssign_operation (GALGAS_string ("AC_GALGAS_sortedlist.h")  COMMA_SOURCE_FILE ("XcodeProjectGeneration.gSemantics", 105)) ;
  outArgument_out_5F_fileList.addAssign_operation (GALGAS_string ("AC_GALGAS_map.cpp")  COMMA_SOURCE_FILE ("XcodeProjectGeneration.gSemantics", 106)) ;
  outArgument_out_5F_fileList.addAssign_operation (GALGAS_string ("AC_GALGAS_map.h")  COMMA_SOURCE_FILE ("XcodeProjectGeneration.gSemantics", 107)) ;
  outArgument_out_5F_fileList.addAssign_operation (GALGAS_string ("AC_GALGAS_uniqueMap.cpp")  COMMA_SOURCE_FILE ("XcodeProjectGeneration.gSemantics", 108)) ;
  outArgument_out_5F_fileList.addAssign_operation (GALGAS_string ("AC_GALGAS_uniqueMap.h")  COMMA_SOURCE_FILE ("XcodeProjectGeneration.gSemantics", 109)) ;
  outArgument_out_5F_fileList.addAssign_operation (GALGAS_string ("AC_GALGAS_class.cpp")  COMMA_SOURCE_FILE ("XcodeProjectGeneration.gSemantics", 110)) ;
  outArgument_out_5F_fileList.addAssign_operation (GALGAS_string ("AC_GALGAS_class.h")  COMMA_SOURCE_FILE ("XcodeProjectGeneration.gSemantics", 111)) ;
  outArgument_out_5F_fileList.addAssign_operation (GALGAS_string ("acPtr_class.cpp")  COMMA_SOURCE_FILE ("XcodeProjectGeneration.gSemantics", 112)) ;
  outArgument_out_5F_fileList.addAssign_operation (GALGAS_string ("acPtr_class.h")  COMMA_SOURCE_FILE ("XcodeProjectGeneration.gSemantics", 113)) ;
  outArgument_out_5F_fileList.addAssign_operation (GALGAS_string ("cPtr_object.cpp")  COMMA_SOURCE_FILE ("XcodeProjectGeneration.gSemantics", 114)) ;
  outArgument_out_5F_fileList.addAssign_operation (GALGAS_string ("cPtr_object.h")  COMMA_SOURCE_FILE ("XcodeProjectGeneration.gSemantics", 115)) ;
  outArgument_out_5F_fileList.addAssign_operation (GALGAS_string ("GALGAS_application.cpp")  COMMA_SOURCE_FILE ("XcodeProjectGeneration.gSemantics", 116)) ;
  outArgument_out_5F_fileList.addAssign_operation (GALGAS_string ("GALGAS_binaryset.cpp")  COMMA_SOURCE_FILE ("XcodeProjectGeneration.gSemantics", 117)) ;
  outArgument_out_5F_fileList.addAssign_operation (GALGAS_string ("GALGAS_bool.cpp")  COMMA_SOURCE_FILE ("XcodeProjectGeneration.gSemantics", 118)) ;
  outArgument_out_5F_fileList.addAssign_operation (GALGAS_string ("GALGAS_char.cpp")  COMMA_SOURCE_FILE ("XcodeProjectGeneration.gSemantics", 119)) ;
  outArgument_out_5F_fileList.addAssign_operation (GALGAS_string ("GALGAS_data.cpp")  COMMA_SOURCE_FILE ("XcodeProjectGeneration.gSemantics", 120)) ;
  outArgument_out_5F_fileList.addAssign_operation (GALGAS_string ("GALGAS_double.cpp")  COMMA_SOURCE_FILE ("XcodeProjectGeneration.gSemantics", 121)) ;
  outArgument_out_5F_fileList.addAssign_operation (GALGAS_string ("GALGAS_filewrapper.cpp")  COMMA_SOURCE_FILE ("XcodeProjectGeneration.gSemantics", 122)) ;
  outArgument_out_5F_fileList.addAssign_operation (GALGAS_string ("GALGAS_function.cpp")  COMMA_SOURCE_FILE ("XcodeProjectGeneration.gSemantics", 123)) ;
  outArgument_out_5F_fileList.addAssign_operation (GALGAS_string ("GALGAS_location.cpp")  COMMA_SOURCE_FILE ("XcodeProjectGeneration.gSemantics", 124)) ;
  outArgument_out_5F_fileList.addAssign_operation (GALGAS_string ("GALGAS_object.cpp")  COMMA_SOURCE_FILE ("XcodeProjectGeneration.gSemantics", 125)) ;
  outArgument_out_5F_fileList.addAssign_operation (GALGAS_string ("GALGAS_sint.cpp")  COMMA_SOURCE_FILE ("XcodeProjectGeneration.gSemantics", 126)) ;
  outArgument_out_5F_fileList.addAssign_operation (GALGAS_string ("GALGAS_sint_36__34_.cpp")  COMMA_SOURCE_FILE ("XcodeProjectGeneration.gSemantics", 127)) ;
  outArgument_out_5F_fileList.addAssign_operation (GALGAS_string ("GALGAS_string.cpp")  COMMA_SOURCE_FILE ("XcodeProjectGeneration.gSemantics", 128)) ;
  outArgument_out_5F_fileList.addAssign_operation (GALGAS_string ("GALGAS_stringset.cpp")  COMMA_SOURCE_FILE ("XcodeProjectGeneration.gSemantics", 129)) ;
  outArgument_out_5F_fileList.addAssign_operation (GALGAS_string ("GALGAS_type.cpp")  COMMA_SOURCE_FILE ("XcodeProjectGeneration.gSemantics", 130)) ;
  outArgument_out_5F_fileList.addAssign_operation (GALGAS_string ("GALGAS_uint.cpp")  COMMA_SOURCE_FILE ("XcodeProjectGeneration.gSemantics", 131)) ;
  outArgument_out_5F_fileList.addAssign_operation (GALGAS_string ("GALGAS_uint_36__34_.cpp")  COMMA_SOURCE_FILE ("XcodeProjectGeneration.gSemantics", 132)) ;
  outArgument_out_5F_fileList.addAssign_operation (GALGAS_string ("predefined-types.cpp")  COMMA_SOURCE_FILE ("XcodeProjectGeneration.gSemantics", 133)) ;
  outArgument_out_5F_fileList.addAssign_operation (GALGAS_string ("predefined-types.h")  COMMA_SOURCE_FILE ("XcodeProjectGeneration.gSemantics", 134)) ;
}


//---------------------------------------------------------------------------------------------------------------------*
//                                                                                                                     *
//                                        Routine 'build_LIBPM_GALGAS_2_group'                                         *
//                                                                                                                     *
//---------------------------------------------------------------------------------------------------------------------*

void routine_build_5F_LIBPM_5F_GALGAS_5F__32__5F_group (GALGAS_XcodeProjectDescription & ioArgument_ioXcodeProjectDescription,
                                                        GALGAS_XcodeObjectReferenceList & ioArgument_ioFileListForGroup,
                                                        C_Compiler * inCompiler
                                                        COMMA_UNUSED_LOCATION_ARGS) {
  GALGAS_stringlist var_fileList ;
  {
  routine_getGALGAS_5F__32__5F_source_5F_file_5F_list (var_fileList, inCompiler  COMMA_SOURCE_FILE ("XcodeProjectGeneration.gSemantics", 144)) ;
  }
  {
  routine_enter_5F_files_5F_in_5F_group (ioArgument_ioXcodeProjectDescription, var_fileList, ioArgument_ioFileListForGroup, inCompiler  COMMA_SOURCE_FILE ("XcodeProjectGeneration.gSemantics", 146)) ;
  }
}


//---------------------------------------------------------------------------------------------------------------------*
//                                                                                                                     *
//                            Routine 'build_LIBPM_GALGAS_2_files_for_sources_build_phase'                             *
//                                                                                                                     *
//---------------------------------------------------------------------------------------------------------------------*

void routine_build_5F_LIBPM_5F_GALGAS_5F__32__5F_files_5F_for_5F_sources_5F_build_5F_phase (GALGAS_XcodeProjectDescription & ioArgument_ioXcodeProjectDescription,
                                                                                            GALGAS_Xcode_5F_PBXBuildFile_5F_list & ioArgument_ioBuildPhaseList,
                                                                                            C_Compiler * inCompiler
                                                                                            COMMA_UNUSED_LOCATION_ARGS) {
  GALGAS_stringlist var_fileList ;
  {
  routine_getGALGAS_5F__32__5F_source_5F_file_5F_list (var_fileList, inCompiler  COMMA_SOURCE_FILE ("XcodeProjectGeneration.gSemantics", 160)) ;
  }
  GALGAS_stringlist var_cppFileList = GALGAS_stringlist::constructor_emptyList (SOURCE_FILE ("XcodeProjectGeneration.gSemantics", 161)) ;
  cEnumerator_stringlist enumerator_5917 (var_fileList, kEnumeration_up) ;
  while (enumerator_5917.hasCurrentObject ()) {
    const enumGalgasBool test_0 = GALGAS_bool (kIsEqual, enumerator_5917.current_mValue (HERE).reader_pathExtension (SOURCE_FILE ("XcodeProjectGeneration.gSemantics", 163)).objectCompare (GALGAS_string ("cpp"))).boolEnum () ;
    if (kBoolTrue == test_0) {
      var_cppFileList.addAssign_operation (enumerator_5917.current_mValue (HERE)  COMMA_SOURCE_FILE ("XcodeProjectGeneration.gSemantics", 164)) ;
    }
    enumerator_5917.gotoNextObject () ;
  }
  {
  routine_enter_5F_file_5F_list_5F_for_5F_sources_5F_build_5F_phase (ioArgument_ioXcodeProjectDescription, var_cppFileList, ioArgument_ioBuildPhaseList, inCompiler  COMMA_SOURCE_FILE ("XcodeProjectGeneration.gSemantics", 168)) ;
  }
}


//---------------------------------------------------------------------------------------------------------------------*
//                                                                                                                     *
//                                      Routine 'build_LIBPM_COCOA_GALGAS_group'                                       *
//                                                                                                                     *
//---------------------------------------------------------------------------------------------------------------------*

void routine_build_5F_LIBPM_5F_COCOA_5F_GALGAS_5F_group (GALGAS_XcodeProjectDescription & ioArgument_ioXcodeProjectDescription,
                                                         GALGAS_XcodeObjectReferenceList & ioArgument_ioFileListForGroup,
                                                         C_Compiler * inCompiler
                                                         COMMA_UNUSED_LOCATION_ARGS) {
  GALGAS_stringlist var_fileList = GALGAS_stringlist::constructor_emptyList (SOURCE_FILE ("XcodeProjectGeneration.gSemantics", 181)) ;
  {
  routine_append_5F_m_5F_h_5F_files (var_fileList, GALGAS_string ("PMSearchResultDescriptor"), inCompiler  COMMA_SOURCE_FILE ("XcodeProjectGeneration.gSemantics", 182)) ;
  }
  {
  routine_append_5F_m_5F_h_5F_files (var_fileList, GALGAS_string ("PMDebug"), inCompiler  COMMA_SOURCE_FILE ("XcodeProjectGeneration.gSemantics", 183)) ;
  }
  {
  routine_append_5F_m_5F_h_5F_files (var_fileList, GALGAS_string ("PMFontButton"), inCompiler  COMMA_SOURCE_FILE ("XcodeProjectGeneration.gSemantics", 184)) ;
  }
  {
  routine_append_5F_m_5F_h_5F_files (var_fileList, GALGAS_string ("OC_Token"), inCompiler  COMMA_SOURCE_FILE ("XcodeProjectGeneration.gSemantics", 185)) ;
  }
  {
  routine_append_5F_m_5F_h_5F_files (var_fileList, GALGAS_string ("OC_Lexique"), inCompiler  COMMA_SOURCE_FILE ("XcodeProjectGeneration.gSemantics", 186)) ;
  }
  {
  routine_append_5F_m_5F_h_5F_files (var_fileList, GALGAS_string ("OC_GGS_CommandLineOption"), inCompiler  COMMA_SOURCE_FILE ("XcodeProjectGeneration.gSemantics", 187)) ;
  }
  {
  routine_append_5F_m_5F_h_5F_files (var_fileList, GALGAS_string ("enterDefaultCommandLineOptions"), inCompiler  COMMA_SOURCE_FILE ("XcodeProjectGeneration.gSemantics", 188)) ;
  }
  {
  routine_append_5F_m_5F_h_5F_files (var_fileList, GALGAS_string ("OC_GGS_Document"), inCompiler  COMMA_SOURCE_FILE ("XcodeProjectGeneration.gSemantics", 189)) ;
  }
  {
  routine_append_5F_m_5F_h_5F_files (var_fileList, GALGAS_string ("OC_GGS_DocumentData"), inCompiler  COMMA_SOURCE_FILE ("XcodeProjectGeneration.gSemantics", 190)) ;
  }
  {
  routine_append_5F_m_5F_h_5F_files (var_fileList, GALGAS_string ("OC_GGS_ApplicationDelegate"), inCompiler  COMMA_SOURCE_FILE ("XcodeProjectGeneration.gSemantics", 191)) ;
  }
  {
  routine_append_5F_m_5F_h_5F_files (var_fileList, GALGAS_string ("PMIssueDescriptor"), inCompiler  COMMA_SOURCE_FILE ("XcodeProjectGeneration.gSemantics", 192)) ;
  }
  {
  routine_append_5F_m_5F_h_5F_files (var_fileList, GALGAS_string ("OC_GGS_TextDisplayDescriptor"), inCompiler  COMMA_SOURCE_FILE ("XcodeProjectGeneration.gSemantics", 193)) ;
  }
  {
  routine_append_5F_m_5F_h_5F_files (var_fileList, GALGAS_string ("OC_GGS_TextSyntaxColoring"), inCompiler  COMMA_SOURCE_FILE ("XcodeProjectGeneration.gSemantics", 194)) ;
  }
  {
  routine_append_5F_m_5F_h_5F_files (var_fileList, GALGAS_string ("OC_GGS_TextView"), inCompiler  COMMA_SOURCE_FILE ("XcodeProjectGeneration.gSemantics", 195)) ;
  }
  {
  routine_append_5F_m_5F_h_5F_files (var_fileList, GALGAS_string ("OC_GGS_RulerViewForBuildOutput"), inCompiler  COMMA_SOURCE_FILE ("XcodeProjectGeneration.gSemantics", 196)) ;
  }
  {
  routine_append_5F_m_5F_h_5F_files (var_fileList, GALGAS_string ("OC_GGS_RulerViewForTextView"), inCompiler  COMMA_SOURCE_FILE ("XcodeProjectGeneration.gSemantics", 197)) ;
  }
  {
  routine_append_5F_m_5F_h_5F_files (var_fileList, GALGAS_string ("OC_GGS_Scroller"), inCompiler  COMMA_SOURCE_FILE ("XcodeProjectGeneration.gSemantics", 198)) ;
  }
  {
  routine_append_5F_m_5F_h_5F_files (var_fileList, GALGAS_string ("PMIssueInRuler"), inCompiler  COMMA_SOURCE_FILE ("XcodeProjectGeneration.gSemantics", 199)) ;
  }
  {
  routine_append_5F_m_5F_h_5F_files (var_fileList, GALGAS_string ("OC_GGS_BuildTask"), inCompiler  COMMA_SOURCE_FILE ("XcodeProjectGeneration.gSemantics", 200)) ;
  }
  {
  routine_append_5F_m_5F_h_5F_files (var_fileList, GALGAS_string ("PMUndoManager"), inCompiler  COMMA_SOURCE_FILE ("XcodeProjectGeneration.gSemantics", 201)) ;
  }
  {
  routine_append_5F_m_5F_h_5F_files (var_fileList, GALGAS_string ("PMTableViewRefusesFirstResponder"), inCompiler  COMMA_SOURCE_FILE ("XcodeProjectGeneration.gSemantics", 202)) ;
  }
  var_fileList.addAssign_operation (GALGAS_string ("I_Stop.tiff")  COMMA_SOURCE_FILE ("XcodeProjectGeneration.gSemantics", 203)) ;
  var_fileList.addAssign_operation (GALGAS_string ("closeSourceFile.tiff")  COMMA_SOURCE_FILE ("XcodeProjectGeneration.gSemantics", 204)) ;
  var_fileList.addAssign_operation (GALGAS_string ("F_CocoaWrapperForGalgas.h")  COMMA_SOURCE_FILE ("XcodeProjectGeneration.gSemantics", 205)) ;
  {
  routine_enter_5F_xib_5F_file_5F_in_5F_group (ioArgument_ioXcodeProjectDescription, GALGAS_string ("English.lproj"), GALGAS_string ("MainMenu.xib"), ioArgument_ioFileListForGroup, inCompiler  COMMA_SOURCE_FILE ("XcodeProjectGeneration.gSemantics", 207)) ;
  }
  {
  routine_enter_5F_xib_5F_file_5F_in_5F_group (ioArgument_ioXcodeProjectDescription, GALGAS_string ("English.lproj"), GALGAS_string ("PMDebug.xib"), ioArgument_ioFileListForGroup, inCompiler  COMMA_SOURCE_FILE ("XcodeProjectGeneration.gSemantics", 213)) ;
  }
  {
  routine_enter_5F_xib_5F_file_5F_in_5F_group (ioArgument_ioXcodeProjectDescription, GALGAS_string ("English.lproj"), GALGAS_string ("OC_GGS_Document.xib"), ioArgument_ioFileListForGroup, inCompiler  COMMA_SOURCE_FILE ("XcodeProjectGeneration.gSemantics", 220)) ;
  }
  {
  routine_enter_5F_files_5F_in_5F_group (ioArgument_ioXcodeProjectDescription, var_fileList, ioArgument_ioFileListForGroup, inCompiler  COMMA_SOURCE_FILE ("XcodeProjectGeneration.gSemantics", 227)) ;
  }
}


//---------------------------------------------------------------------------------------------------------------------*
//                                                                                                                     *
//                                     Routine 'build_LIBPM_COCOA_UTILITIES_group'                                     *
//                                                                                                                     *
//---------------------------------------------------------------------------------------------------------------------*

void routine_build_5F_LIBPM_5F_COCOA_5F_UTILITIES_5F_group (GALGAS_XcodeProjectDescription & ioArgument_ioXcodeProjectDescription,
                                                            GALGAS_XcodeObjectReferenceList & ioArgument_ioFileListForGroup,
                                                            C_Compiler * inCompiler
                                                            COMMA_UNUSED_LOCATION_ARGS) {
  GALGAS_stringlist var_fileList = GALGAS_stringlist::constructor_emptyList (SOURCE_FILE ("XcodeProjectGeneration.gSemantics", 241)) ;
  var_fileList.addAssign_operation (GALGAS_string ("main.m")  COMMA_SOURCE_FILE ("XcodeProjectGeneration.gSemantics", 242)) ;
  var_fileList.addAssign_operation (GALGAS_string ("PMCancelButtonForPanel.m")  COMMA_SOURCE_FILE ("XcodeProjectGeneration.gSemantics", 243)) ;
  var_fileList.addAssign_operation (GALGAS_string ("PMOkButtonForPanel.m")  COMMA_SOURCE_FILE ("XcodeProjectGeneration.gSemantics", 244)) ;
  {
  routine_enter_5F_files_5F_in_5F_group (ioArgument_ioXcodeProjectDescription, var_fileList, ioArgument_ioFileListForGroup, inCompiler  COMMA_SOURCE_FILE ("XcodeProjectGeneration.gSemantics", 246)) ;
  }
}


//---------------------------------------------------------------------------------------------------------------------*
//                                                                                                                     *
//                                          Routine 'build_LIBPM_FILES_group'                                          *
//                                                                                                                     *
//---------------------------------------------------------------------------------------------------------------------*

void routine_build_5F_LIBPM_5F_FILES_5F_group (GALGAS_XcodeProjectDescription & ioArgument_ioXcodeProjectDescription,
                                               GALGAS_XcodeObjectReferenceList & ioArgument_ioFileListForGroup,
                                               C_Compiler * inCompiler
                                               COMMA_UNUSED_LOCATION_ARGS) {
  GALGAS_stringlist var_fileList = GALGAS_stringlist::constructor_emptyList (SOURCE_FILE ("XcodeProjectGeneration.gSemantics", 259)) ;
  {
  routine_append_5F_cpp_5F_h_5F_files (var_fileList, GALGAS_string ("C_FileManager"), inCompiler  COMMA_SOURCE_FILE ("XcodeProjectGeneration.gSemantics", 260)) ;
  }
  {
  routine_append_5F_cpp_5F_h_5F_files (var_fileList, GALGAS_string ("AC_FileHandle"), inCompiler  COMMA_SOURCE_FILE ("XcodeProjectGeneration.gSemantics", 261)) ;
  }
  {
  routine_append_5F_cpp_5F_h_5F_files (var_fileList, GALGAS_string ("AC_FileHandleForWriting"), inCompiler  COMMA_SOURCE_FILE ("XcodeProjectGeneration.gSemantics", 262)) ;
  }
  {
  routine_append_5F_cpp_5F_h_5F_files (var_fileList, GALGAS_string ("C_TextFileWrite"), inCompiler  COMMA_SOURCE_FILE ("XcodeProjectGeneration.gSemantics", 263)) ;
  }
  {
  routine_append_5F_cpp_5F_h_5F_files (var_fileList, GALGAS_string ("C_HTML_FileWrite"), inCompiler  COMMA_SOURCE_FILE ("XcodeProjectGeneration.gSemantics", 264)) ;
  }
  {
  routine_append_5F_cpp_5F_h_5F_files (var_fileList, GALGAS_string ("C_BinaryFileWrite"), inCompiler  COMMA_SOURCE_FILE ("XcodeProjectGeneration.gSemantics", 265)) ;
  }
  {
  routine_enter_5F_files_5F_in_5F_group (ioArgument_ioXcodeProjectDescription, var_fileList, ioArgument_ioFileListForGroup, inCompiler  COMMA_SOURCE_FILE ("XcodeProjectGeneration.gSemantics", 267)) ;
  }
}


//---------------------------------------------------------------------------------------------------------------------*
//                                                                                                                     *
//                              Routine 'build_LIBPM_FILES_files_for_sources_build_phase'                              *
//                                                                                                                     *
//---------------------------------------------------------------------------------------------------------------------*

void routine_build_5F_LIBPM_5F_FILES_5F_files_5F_for_5F_sources_5F_build_5F_phase (GALGAS_XcodeProjectDescription & ioArgument_ioXcodeProjectDescription,
                                                                                   GALGAS_Xcode_5F_PBXBuildFile_5F_list & ioArgument_ioBuildPhaseList,
                                                                                   C_Compiler * inCompiler
                                                                                   COMMA_UNUSED_LOCATION_ARGS) {
  GALGAS_stringlist var_fileList = GALGAS_stringlist::constructor_emptyList (SOURCE_FILE ("XcodeProjectGeneration.gSemantics", 280)) ;
  var_fileList.addAssign_operation (GALGAS_string ("C_FileManager.cpp")  COMMA_SOURCE_FILE ("XcodeProjectGeneration.gSemantics", 281)) ;
  var_fileList.addAssign_operation (GALGAS_string ("AC_FileHandle.cpp")  COMMA_SOURCE_FILE ("XcodeProjectGeneration.gSemantics", 282)) ;
  var_fileList.addAssign_operation (GALGAS_string ("AC_FileHandleForWriting.cpp")  COMMA_SOURCE_FILE ("XcodeProjectGeneration.gSemantics", 283)) ;
  var_fileList.addAssign_operation (GALGAS_string ("C_TextFileWrite.cpp")  COMMA_SOURCE_FILE ("XcodeProjectGeneration.gSemantics", 284)) ;
  var_fileList.addAssign_operation (GALGAS_string ("C_HTML_FileWrite.cpp")  COMMA_SOURCE_FILE ("XcodeProjectGeneration.gSemantics", 285)) ;
  var_fileList.addAssign_operation (GALGAS_string ("C_BinaryFileWrite.cpp")  COMMA_SOURCE_FILE ("XcodeProjectGeneration.gSemantics", 286)) ;
  {
  routine_enter_5F_file_5F_list_5F_for_5F_sources_5F_build_5F_phase (ioArgument_ioXcodeProjectDescription, var_fileList, ioArgument_ioBuildPhaseList, inCompiler  COMMA_SOURCE_FILE ("XcodeProjectGeneration.gSemantics", 288)) ;
  }
}


//---------------------------------------------------------------------------------------------------------------------*
//                                                                                                                     *
//                                 Routine 'build_LIBPM_COMMAND_LINE_INTERFACE_group'                                  *
//                                                                                                                     *
//---------------------------------------------------------------------------------------------------------------------*

void routine_build_5F_LIBPM_5F_COMMAND_5F_LINE_5F_INTERFACE_5F_group (GALGAS_XcodeProjectDescription & ioArgument_ioXcodeProjectDescription,
                                                                      GALGAS_XcodeObjectReferenceList & ioArgument_ioFileListForGroup,
                                                                      C_Compiler * inCompiler
                                                                      COMMA_UNUSED_LOCATION_ARGS) {
  GALGAS_stringlist var_fileList = GALGAS_stringlist::constructor_emptyList (SOURCE_FILE ("XcodeProjectGeneration.gSemantics", 301)) ;
  {
  routine_append_5F_cpp_5F_h_5F_files (var_fileList, GALGAS_string ("C_CommandLineOption"), inCompiler  COMMA_SOURCE_FILE ("XcodeProjectGeneration.gSemantics", 302)) ;
  }
  {
  routine_append_5F_cpp_5F_h_5F_files (var_fileList, GALGAS_string ("C_BoolCommandLineOption"), inCompiler  COMMA_SOURCE_FILE ("XcodeProjectGeneration.gSemantics", 303)) ;
  }
  {
  routine_append_5F_cpp_5F_h_5F_files (var_fileList, GALGAS_string ("C_UIntCommandLineOption"), inCompiler  COMMA_SOURCE_FILE ("XcodeProjectGeneration.gSemantics", 304)) ;
  }
  {
  routine_append_5F_cpp_5F_h_5F_files (var_fileList, GALGAS_string ("C_StringCommandLineOption"), inCompiler  COMMA_SOURCE_FILE ("XcodeProjectGeneration.gSemantics", 305)) ;
  }
  {
  routine_append_5F_cpp_5F_h_5F_files (var_fileList, GALGAS_string ("C_builtin_CLI_Options"), inCompiler  COMMA_SOURCE_FILE ("XcodeProjectGeneration.gSemantics", 306)) ;
  }
  {
  routine_append_5F_cpp_5F_h_5F_files (var_fileList, GALGAS_string ("F_Analyze_CLI_Options"), inCompiler  COMMA_SOURCE_FILE ("XcodeProjectGeneration.gSemantics", 307)) ;
  }
  {
  routine_append_5F_cpp_5F_h_5F_files (var_fileList, GALGAS_string ("F_mainForLIBPM"), inCompiler  COMMA_SOURCE_FILE ("XcodeProjectGeneration.gSemantics", 308)) ;
  }
  {
  routine_enter_5F_files_5F_in_5F_group (ioArgument_ioXcodeProjectDescription, var_fileList, ioArgument_ioFileListForGroup, inCompiler  COMMA_SOURCE_FILE ("XcodeProjectGeneration.gSemantics", 310)) ;
  }
}


//---------------------------------------------------------------------------------------------------------------------*
//                                                                                                                     *
//                     Routine 'build_LIBPM_COMMAND_LINE_INTERFACE_files_for_sources_build_phase'                      *
//                                                                                                                     *
//---------------------------------------------------------------------------------------------------------------------*

void routine_build_5F_LIBPM_5F_COMMAND_5F_LINE_5F_INTERFACE_5F_files_5F_for_5F_sources_5F_build_5F_phase (GALGAS_XcodeProjectDescription & ioArgument_ioXcodeProjectDescription,
                                                                                                          GALGAS_Xcode_5F_PBXBuildFile_5F_list & ioArgument_ioBuildPhaseList,
                                                                                                          C_Compiler * inCompiler
                                                                                                          COMMA_UNUSED_LOCATION_ARGS) {
  GALGAS_stringlist var_fileList = GALGAS_stringlist::constructor_emptyList (SOURCE_FILE ("XcodeProjectGeneration.gSemantics", 323)) ;
  var_fileList.addAssign_operation (GALGAS_string ("C_builtin_CLI_Options.cpp")  COMMA_SOURCE_FILE ("XcodeProjectGeneration.gSemantics", 324)) ;
  var_fileList.addAssign_operation (GALGAS_string ("C_CommandLineOption.cpp")  COMMA_SOURCE_FILE ("XcodeProjectGeneration.gSemantics", 325)) ;
  var_fileList.addAssign_operation (GALGAS_string ("C_BoolCommandLineOption.cpp")  COMMA_SOURCE_FILE ("XcodeProjectGeneration.gSemantics", 326)) ;
  var_fileList.addAssign_operation (GALGAS_string ("C_UIntCommandLineOption.cpp")  COMMA_SOURCE_FILE ("XcodeProjectGeneration.gSemantics", 327)) ;
  var_fileList.addAssign_operation (GALGAS_string ("C_StringCommandLineOption.cpp")  COMMA_SOURCE_FILE ("XcodeProjectGeneration.gSemantics", 328)) ;
  var_fileList.addAssign_operation (GALGAS_string ("F_Analyze_CLI_Options.cpp")  COMMA_SOURCE_FILE ("XcodeProjectGeneration.gSemantics", 329)) ;
  var_fileList.addAssign_operation (GALGAS_string ("F_mainForLIBPM.cpp")  COMMA_SOURCE_FILE ("XcodeProjectGeneration.gSemantics", 330)) ;
  {
  routine_enter_5F_file_5F_list_5F_for_5F_sources_5F_build_5F_phase (ioArgument_ioXcodeProjectDescription, var_fileList, ioArgument_ioBuildPhaseList, inCompiler  COMMA_SOURCE_FILE ("XcodeProjectGeneration.gSemantics", 332)) ;
  }
}


//---------------------------------------------------------------------------------------------------------------------*
//                                                                                                                     *
//                                       Routine 'build_LIBPM_COLLECTIONS_group'                                       *
//                                                                                                                     *
//---------------------------------------------------------------------------------------------------------------------*

void routine_build_5F_LIBPM_5F_COLLECTIONS_5F_group (GALGAS_XcodeProjectDescription & ioArgument_ioXcodeProjectDescription,
                                                     GALGAS_XcodeObjectReferenceList & ioArgument_ioFileListForGroup,
                                                     C_Compiler * inCompiler
                                                     COMMA_UNUSED_LOCATION_ARGS) {
  GALGAS_stringlist var_fileList = GALGAS_stringlist::constructor_emptyList (SOURCE_FILE ("XcodeProjectGeneration.gSemantics", 345)) ;
  var_fileList.addAssign_operation (GALGAS_string ("TC_FIFO.h")  COMMA_SOURCE_FILE ("XcodeProjectGeneration.gSemantics", 346)) ;
  var_fileList.addAssign_operation (GALGAS_string ("TC_LinkedList.h")  COMMA_SOURCE_FILE ("XcodeProjectGeneration.gSemantics", 347)) ;
  var_fileList.addAssign_operation (GALGAS_string ("TC_Array.h")  COMMA_SOURCE_FILE ("XcodeProjectGeneration.gSemantics", 348)) ;
  var_fileList.addAssign_operation (GALGAS_string ("TC_Array2.h")  COMMA_SOURCE_FILE ("XcodeProjectGeneration.gSemantics", 349)) ;
  var_fileList.addAssign_operation (GALGAS_string ("TC_UniqueArray.h")  COMMA_SOURCE_FILE ("XcodeProjectGeneration.gSemantics", 350)) ;
  var_fileList.addAssign_operation (GALGAS_string ("TC_UniqueArray2.h")  COMMA_SOURCE_FILE ("XcodeProjectGeneration.gSemantics", 351)) ;
  {
  routine_enter_5F_files_5F_in_5F_group (ioArgument_ioXcodeProjectDescription, var_fileList, ioArgument_ioFileListForGroup, inCompiler  COMMA_SOURCE_FILE ("XcodeProjectGeneration.gSemantics", 353)) ;
  }
}


//---------------------------------------------------------------------------------------------------------------------*
//                                                                                                                     *
//                                       Routine 'build_PROJECT_RESOURCES_group'                                       *
//                                                                                                                     *
//---------------------------------------------------------------------------------------------------------------------*

void routine_build_5F_PROJECT_5F_RESOURCES_5F_group (GALGAS_XcodeProjectDescription & ioArgument_ioXcodeProjectDescription,
                                                     GALGAS_XcodeObjectReferenceList & ioArgument_ioFileListForGroup,
                                                     C_Compiler * inCompiler
                                                     COMMA_UNUSED_LOCATION_ARGS) {
  {
  routine_enter_5F_xib_5F_file_5F_in_5F_group (ioArgument_ioXcodeProjectDescription, GALGAS_string ("English.lproj"), GALGAS_string ("Credits.rtf"), ioArgument_ioFileListForGroup, inCompiler  COMMA_SOURCE_FILE ("XcodeProjectGeneration.gSemantics", 367)) ;
  }
  {
  routine_enter_5F_plist_5F_strings_5F_in_5F_group (ioArgument_ioXcodeProjectDescription, GALGAS_string ("English.lproj"), GALGAS_string ("InfoPlist.strings"), ioArgument_ioFileListForGroup, inCompiler  COMMA_SOURCE_FILE ("XcodeProjectGeneration.gSemantics", 373)) ;
  }
  {
  routine_enter_5F_files_5F_in_5F_group (ioArgument_ioXcodeProjectDescription, GALGAS_stringlist::constructor_listWithValue (GALGAS_string ("Info.plist")  COMMA_SOURCE_FILE ("XcodeProjectGeneration.gSemantics", 382)), ioArgument_ioFileListForGroup, inCompiler  COMMA_SOURCE_FILE ("XcodeProjectGeneration.gSemantics", 380)) ;
  }
}


//---------------------------------------------------------------------------------------------------------------------*
//                                                                                                                     *
//                                         Routine 'build_LIBPM_STRINGS_group'                                         *
//                                                                                                                     *
//---------------------------------------------------------------------------------------------------------------------*

void routine_build_5F_LIBPM_5F_STRINGS_5F_group (GALGAS_XcodeProjectDescription & ioArgument_ioXcodeProjectDescription,
                                                 GALGAS_XcodeObjectReferenceList & ioArgument_ioFileListForGroup,
                                                 C_Compiler * inCompiler
                                                 COMMA_UNUSED_LOCATION_ARGS) {
  GALGAS_stringlist var_fileList = GALGAS_stringlist::constructor_emptyList (SOURCE_FILE ("XcodeProjectGeneration.gSemantics", 393)) ;
  {
  routine_append_5F_cpp_5F_h_5F_files (var_fileList, GALGAS_string ("C_String"), inCompiler  COMMA_SOURCE_FILE ("XcodeProjectGeneration.gSemantics", 394)) ;
  }
  {
  routine_append_5F_cpp_5F_h_5F_files (var_fileList, GALGAS_string ("C_HTMLString"), inCompiler  COMMA_SOURCE_FILE ("XcodeProjectGeneration.gSemantics", 395)) ;
  }
  {
  routine_append_5F_cpp_5F_h_5F_files (var_fileList, GALGAS_string ("unicode_character_cpp"), inCompiler  COMMA_SOURCE_FILE ("XcodeProjectGeneration.gSemantics", 396)) ;
  }
  {
  routine_append_5F_cpp_5F_h_5F_files (var_fileList, GALGAS_string ("unicode_string_routines"), inCompiler  COMMA_SOURCE_FILE ("XcodeProjectGeneration.gSemantics", 397)) ;
  }
  {
  routine_append_5F_m_5F_h_5F_files (var_fileList, GALGAS_string ("unicode_character_m"), inCompiler  COMMA_SOURCE_FILE ("XcodeProjectGeneration.gSemantics", 398)) ;
  }
  var_fileList.addAssign_operation (GALGAS_string ("cUnicodeData.h")  COMMA_SOURCE_FILE ("XcodeProjectGeneration.gSemantics", 399)) ;
  {
  routine_enter_5F_files_5F_in_5F_group (ioArgument_ioXcodeProjectDescription, var_fileList, ioArgument_ioFileListForGroup, inCompiler  COMMA_SOURCE_FILE ("XcodeProjectGeneration.gSemantics", 401)) ;
  }
}


//---------------------------------------------------------------------------------------------------------------------*
//                                                                                                                     *
//                             Routine 'build_LIBPM_STRINGS_files_for_sources_build_phase'                             *
//                                                                                                                     *
//---------------------------------------------------------------------------------------------------------------------*

void routine_build_5F_LIBPM_5F_STRINGS_5F_files_5F_for_5F_sources_5F_build_5F_phase (GALGAS_XcodeProjectDescription & ioArgument_ioXcodeProjectDescription,
                                                                                     GALGAS_Xcode_5F_PBXBuildFile_5F_list & ioArgument_ioBuildPhaseList,
                                                                                     C_Compiler * inCompiler
                                                                                     COMMA_UNUSED_LOCATION_ARGS) {
  GALGAS_stringlist var_fileList = GALGAS_stringlist::constructor_emptyList (SOURCE_FILE ("XcodeProjectGeneration.gSemantics", 414)) ;
  var_fileList.addAssign_operation (GALGAS_string ("C_String.cpp")  COMMA_SOURCE_FILE ("XcodeProjectGeneration.gSemantics", 415)) ;
  var_fileList.addAssign_operation (GALGAS_string ("C_HTMLString.cpp")  COMMA_SOURCE_FILE ("XcodeProjectGeneration.gSemantics", 416)) ;
  var_fileList.addAssign_operation (GALGAS_string ("unicode_character_cpp.cpp")  COMMA_SOURCE_FILE ("XcodeProjectGeneration.gSemantics", 417)) ;
  var_fileList.addAssign_operation (GALGAS_string ("unicode_string_routines.cpp")  COMMA_SOURCE_FILE ("XcodeProjectGeneration.gSemantics", 418)) ;
  {
  routine_enter_5F_file_5F_list_5F_for_5F_sources_5F_build_5F_phase (ioArgument_ioXcodeProjectDescription, var_fileList, ioArgument_ioBuildPhaseList, inCompiler  COMMA_SOURCE_FILE ("XcodeProjectGeneration.gSemantics", 420)) ;
  }
}


//---------------------------------------------------------------------------------------------------------------------*
//                                                                                                                     *
//                                        Routine 'build_LIBPM_UTILITIES_group'                                        *
//                                                                                                                     *
//---------------------------------------------------------------------------------------------------------------------*

void routine_build_5F_LIBPM_5F_UTILITIES_5F_group (GALGAS_XcodeProjectDescription & ioArgument_ioXcodeProjectDescription,
                                                   GALGAS_XcodeObjectReferenceList & ioArgument_ioFileListForGroup,
                                                   C_Compiler * inCompiler
                                                   COMMA_UNUSED_LOCATION_ARGS) {
  GALGAS_stringlist var_fileList = GALGAS_stringlist::constructor_emptyList (SOURCE_FILE ("XcodeProjectGeneration.gSemantics", 433)) ;
  var_fileList.addAssign_operation (GALGAS_string ("M_Threads.h")  COMMA_SOURCE_FILE ("XcodeProjectGeneration.gSemantics", 434)) ;
  {
  routine_append_5F_cpp_5F_h_5F_files (var_fileList, GALGAS_string ("C_SharedObject"), inCompiler  COMMA_SOURCE_FILE ("XcodeProjectGeneration.gSemantics", 435)) ;
  }
  {
  routine_append_5F_cpp_5F_h_5F_files (var_fileList, GALGAS_string ("C_Data"), inCompiler  COMMA_SOURCE_FILE ("XcodeProjectGeneration.gSemantics", 436)) ;
  }
  {
  routine_append_5F_cpp_5F_h_5F_files (var_fileList, GALGAS_string ("md5"), inCompiler  COMMA_SOURCE_FILE ("XcodeProjectGeneration.gSemantics", 437)) ;
  }
  {
  routine_append_5F_cpp_5F_h_5F_files (var_fileList, GALGAS_string ("F_GetPrime"), inCompiler  COMMA_SOURCE_FILE ("XcodeProjectGeneration.gSemantics", 438)) ;
  }
  {
  routine_append_5F_cpp_5F_h_5F_files (var_fileList, GALGAS_string ("F_DisplayException"), inCompiler  COMMA_SOURCE_FILE ("XcodeProjectGeneration.gSemantics", 439)) ;
  }
  {
  routine_append_5F_cpp_5F_h_5F_files (var_fileList, GALGAS_string ("MF_Assert"), inCompiler  COMMA_SOURCE_FILE ("XcodeProjectGeneration.gSemantics", 440)) ;
  }
  {
  routine_append_5F_cpp_5F_h_5F_files (var_fileList, GALGAS_string ("cpp-allocation"), inCompiler  COMMA_SOURCE_FILE ("XcodeProjectGeneration.gSemantics", 441)) ;
  }
  {
  routine_append_5F_cpp_5F_h_5F_files (var_fileList, GALGAS_string ("basic-allocation"), inCompiler  COMMA_SOURCE_FILE ("XcodeProjectGeneration.gSemantics", 442)) ;
  }
  {
  routine_append_5F_cpp_5F_h_5F_files (var_fileList, GALGAS_string ("MF_MemoryControl"), inCompiler  COMMA_SOURCE_FILE ("XcodeProjectGeneration.gSemantics", 443)) ;
  }
  {
  routine_append_5F_cpp_5F_h_5F_files (var_fileList, GALGAS_string ("C_PrologueEpilogue"), inCompiler  COMMA_SOURCE_FILE ("XcodeProjectGeneration.gSemantics", 444)) ;
  }
  {
  routine_append_5F_cpp_5F_h_5F_files (var_fileList, GALGAS_string ("PMUInt128"), inCompiler  COMMA_SOURCE_FILE ("XcodeProjectGeneration.gSemantics", 445)) ;
  }
  {
  routine_append_5F_cpp_5F_h_5F_files (var_fileList, GALGAS_string ("C_UIntSet"), inCompiler  COMMA_SOURCE_FILE ("XcodeProjectGeneration.gSemantics", 446)) ;
  }
  {
  routine_append_5F_cpp_5F_h_5F_files (var_fileList, GALGAS_string ("C_DirectedGraph"), inCompiler  COMMA_SOURCE_FILE ("XcodeProjectGeneration.gSemantics", 447)) ;
  }
  var_fileList.addAssign_operation (GALGAS_string ("M_SourceLocation.h")  COMMA_SOURCE_FILE ("XcodeProjectGeneration.gSemantics", 448)) ;
  var_fileList.addAssign_operation (GALGAS_string ("M_machine.h")  COMMA_SOURCE_FILE ("XcodeProjectGeneration.gSemantics", 449)) ;
  var_fileList.addAssign_operation (GALGAS_string ("TF_inf.h")  COMMA_SOURCE_FILE ("XcodeProjectGeneration.gSemantics", 450)) ;
  var_fileList.addAssign_operation (GALGAS_string ("TF_sup.h")  COMMA_SOURCE_FILE ("XcodeProjectGeneration.gSemantics", 451)) ;
  var_fileList.addAssign_operation (GALGAS_string ("TF_Swap.h")  COMMA_SOURCE_FILE ("XcodeProjectGeneration.gSemantics", 452)) ;
  {
  routine_enter_5F_files_5F_in_5F_group (ioArgument_ioXcodeProjectDescription, var_fileList, ioArgument_ioFileListForGroup, inCompiler  COMMA_SOURCE_FILE ("XcodeProjectGeneration.gSemantics", 454)) ;
  }
}


//---------------------------------------------------------------------------------------------------------------------*
//                                                                                                                     *
//                            Routine 'build_LIBPM_UTILITIES_files_for_sources_build_phase'                            *
//                                                                                                                     *
//---------------------------------------------------------------------------------------------------------------------*

void routine_build_5F_LIBPM_5F_UTILITIES_5F_files_5F_for_5F_sources_5F_build_5F_phase (GALGAS_XcodeProjectDescription & ioArgument_ioXcodeProjectDescription,
                                                                                       GALGAS_Xcode_5F_PBXBuildFile_5F_list & ioArgument_ioBuildPhaseList,
                                                                                       C_Compiler * inCompiler
                                                                                       COMMA_UNUSED_LOCATION_ARGS) {
  GALGAS_stringlist var_fileList = GALGAS_stringlist::constructor_emptyList (SOURCE_FILE ("XcodeProjectGeneration.gSemantics", 467)) ;
  var_fileList.addAssign_operation (GALGAS_string ("C_SharedObject.cpp")  COMMA_SOURCE_FILE ("XcodeProjectGeneration.gSemantics", 468)) ;
  var_fileList.addAssign_operation (GALGAS_string ("C_Data.cpp")  COMMA_SOURCE_FILE ("XcodeProjectGeneration.gSemantics", 469)) ;
  var_fileList.addAssign_operation (GALGAS_string ("PMUInt128.cpp")  COMMA_SOURCE_FILE ("XcodeProjectGeneration.gSemantics", 470)) ;
  var_fileList.addAssign_operation (GALGAS_string ("C_UIntSet.cpp")  COMMA_SOURCE_FILE ("XcodeProjectGeneration.gSemantics", 471)) ;
  var_fileList.addAssign_operation (GALGAS_string ("C_DirectedGraph.cpp")  COMMA_SOURCE_FILE ("XcodeProjectGeneration.gSemantics", 472)) ;
  var_fileList.addAssign_operation (GALGAS_string ("C_PrologueEpilogue.cpp")  COMMA_SOURCE_FILE ("XcodeProjectGeneration.gSemantics", 473)) ;
  var_fileList.addAssign_operation (GALGAS_string ("md5.cpp")  COMMA_SOURCE_FILE ("XcodeProjectGeneration.gSemantics", 474)) ;
  var_fileList.addAssign_operation (GALGAS_string ("F_GetPrime.cpp")  COMMA_SOURCE_FILE ("XcodeProjectGeneration.gSemantics", 475)) ;
  var_fileList.addAssign_operation (GALGAS_string ("F_DisplayException.cpp")  COMMA_SOURCE_FILE ("XcodeProjectGeneration.gSemantics", 476)) ;
  var_fileList.addAssign_operation (GALGAS_string ("MF_Assert.cpp")  COMMA_SOURCE_FILE ("XcodeProjectGeneration.gSemantics", 477)) ;
  var_fileList.addAssign_operation (GALGAS_string ("MF_MemoryControl.cpp")  COMMA_SOURCE_FILE ("XcodeProjectGeneration.gSemantics", 478)) ;
  var_fileList.addAssign_operation (GALGAS_string ("cpp-allocation.cpp")  COMMA_SOURCE_FILE ("XcodeProjectGeneration.gSemantics", 479)) ;
  var_fileList.addAssign_operation (GALGAS_string ("basic-allocation.cpp")  COMMA_SOURCE_FILE ("XcodeProjectGeneration.gSemantics", 480)) ;
  {
  routine_enter_5F_file_5F_list_5F_for_5F_sources_5F_build_5F_phase (ioArgument_ioXcodeProjectDescription, var_fileList, ioArgument_ioBuildPhaseList, inCompiler  COMMA_SOURCE_FILE ("XcodeProjectGeneration.gSemantics", 482)) ;
  }
}


//---------------------------------------------------------------------------------------------------------------------*
//                                                                                                                     *
//                                         Routine 'build_LIBPM_STREAMS_group'                                         *
//                                                                                                                     *
//---------------------------------------------------------------------------------------------------------------------*

void routine_build_5F_LIBPM_5F_STREAMS_5F_group (GALGAS_XcodeProjectDescription & ioArgument_ioXcodeProjectDescription,
                                                 GALGAS_XcodeObjectReferenceList & ioArgument_ioFileListForGroup,
                                                 C_Compiler * inCompiler
                                                 COMMA_UNUSED_LOCATION_ARGS) {
  GALGAS_stringlist var_fileList = GALGAS_stringlist::constructor_emptyList (SOURCE_FILE ("XcodeProjectGeneration.gSemantics", 495)) ;
  {
  routine_append_5F_cpp_5F_h_5F_files (var_fileList, GALGAS_string ("C_ErrorOut"), inCompiler  COMMA_SOURCE_FILE ("XcodeProjectGeneration.gSemantics", 496)) ;
  }
  {
  routine_append_5F_cpp_5F_h_5F_files (var_fileList, GALGAS_string ("AC_OutputStream"), inCompiler  COMMA_SOURCE_FILE ("XcodeProjectGeneration.gSemantics", 497)) ;
  }
  {
  routine_append_5F_cpp_5F_h_5F_files (var_fileList, GALGAS_string ("C_ConsoleOut"), inCompiler  COMMA_SOURCE_FILE ("XcodeProjectGeneration.gSemantics", 498)) ;
  }
  {
  routine_append_5F_cpp_5F_h_5F_files (var_fileList, GALGAS_string ("C_ColoredConsole"), inCompiler  COMMA_SOURCE_FILE ("XcodeProjectGeneration.gSemantics", 499)) ;
  }
  {
  routine_append_5F_cpp_5F_h_5F_files (var_fileList, GALGAS_string ("C_TCPSocketOut"), inCompiler  COMMA_SOURCE_FILE ("XcodeProjectGeneration.gSemantics", 500)) ;
  }
  {
  routine_enter_5F_files_5F_in_5F_group (ioArgument_ioXcodeProjectDescription, var_fileList, ioArgument_ioFileListForGroup, inCompiler  COMMA_SOURCE_FILE ("XcodeProjectGeneration.gSemantics", 502)) ;
  }
}


//---------------------------------------------------------------------------------------------------------------------*
//                                                                                                                     *
//                             Routine 'build_LIBPM_STREAMS_files_for_sources_build_phase'                             *
//                                                                                                                     *
//---------------------------------------------------------------------------------------------------------------------*

void routine_build_5F_LIBPM_5F_STREAMS_5F_files_5F_for_5F_sources_5F_build_5F_phase (GALGAS_XcodeProjectDescription & ioArgument_ioXcodeProjectDescription,
                                                                                     GALGAS_Xcode_5F_PBXBuildFile_5F_list & ioArgument_ioBuildPhaseList,
                                                                                     C_Compiler * inCompiler
                                                                                     COMMA_UNUSED_LOCATION_ARGS) {
  GALGAS_stringlist var_fileList = GALGAS_stringlist::constructor_emptyList (SOURCE_FILE ("XcodeProjectGeneration.gSemantics", 515)) ;
  var_fileList.addAssign_operation (GALGAS_string ("AC_OutputStream.cpp")  COMMA_SOURCE_FILE ("XcodeProjectGeneration.gSemantics", 516)) ;
  var_fileList.addAssign_operation (GALGAS_string ("C_ColoredConsole.cpp")  COMMA_SOURCE_FILE ("XcodeProjectGeneration.gSemantics", 517)) ;
  var_fileList.addAssign_operation (GALGAS_string ("C_ErrorOut.cpp")  COMMA_SOURCE_FILE ("XcodeProjectGeneration.gSemantics", 518)) ;
  var_fileList.addAssign_operation (GALGAS_string ("C_ConsoleOut.cpp")  COMMA_SOURCE_FILE ("XcodeProjectGeneration.gSemantics", 519)) ;
  var_fileList.addAssign_operation (GALGAS_string ("C_TCPSocketOut.cpp")  COMMA_SOURCE_FILE ("XcodeProjectGeneration.gSemantics", 520)) ;
  {
  routine_enter_5F_file_5F_list_5F_for_5F_sources_5F_build_5F_phase (ioArgument_ioXcodeProjectDescription, var_fileList, ioArgument_ioBuildPhaseList, inCompiler  COMMA_SOURCE_FILE ("XcodeProjectGeneration.gSemantics", 522)) ;
  }
}


//---------------------------------------------------------------------------------------------------------------------*
//                                                                                                                     *
//                                          Routine 'build_LIBPM_TIME_group'                                           *
//                                                                                                                     *
//---------------------------------------------------------------------------------------------------------------------*

void routine_build_5F_LIBPM_5F_TIME_5F_group (GALGAS_XcodeProjectDescription & ioArgument_ioXcodeProjectDescription,
                                              GALGAS_XcodeObjectReferenceList & ioArgument_ioFileListForGroup,
                                              C_Compiler * inCompiler
                                              COMMA_UNUSED_LOCATION_ARGS) {
  GALGAS_stringlist var_fileList = GALGAS_stringlist::constructor_emptyList (SOURCE_FILE ("XcodeProjectGeneration.gSemantics", 535)) ;
  {
  routine_append_5F_cpp_5F_h_5F_files (var_fileList, GALGAS_string ("C_DateTime"), inCompiler  COMMA_SOURCE_FILE ("XcodeProjectGeneration.gSemantics", 536)) ;
  }
  {
  routine_append_5F_cpp_5F_h_5F_files (var_fileList, GALGAS_string ("C_Timer"), inCompiler  COMMA_SOURCE_FILE ("XcodeProjectGeneration.gSemantics", 537)) ;
  }
  {
  routine_enter_5F_files_5F_in_5F_group (ioArgument_ioXcodeProjectDescription, var_fileList, ioArgument_ioFileListForGroup, inCompiler  COMMA_SOURCE_FILE ("XcodeProjectGeneration.gSemantics", 539)) ;
  }
}


//---------------------------------------------------------------------------------------------------------------------*
//                                                                                                                     *
//                              Routine 'build_LIBPM_TIME_files_for_sources_build_phase'                               *
//                                                                                                                     *
//---------------------------------------------------------------------------------------------------------------------*

void routine_build_5F_LIBPM_5F_TIME_5F_files_5F_for_5F_sources_5F_build_5F_phase (GALGAS_XcodeProjectDescription & ioArgument_ioXcodeProjectDescription,
                                                                                  GALGAS_Xcode_5F_PBXBuildFile_5F_list & ioArgument_ioBuildPhaseList,
                                                                                  C_Compiler * inCompiler
                                                                                  COMMA_UNUSED_LOCATION_ARGS) {
  GALGAS_stringlist var_fileList = GALGAS_stringlist::constructor_emptyList (SOURCE_FILE ("XcodeProjectGeneration.gSemantics", 552)) ;
  var_fileList.addAssign_operation (GALGAS_string ("C_DateTime.cpp")  COMMA_SOURCE_FILE ("XcodeProjectGeneration.gSemantics", 553)) ;
  var_fileList.addAssign_operation (GALGAS_string ("C_Timer.cpp")  COMMA_SOURCE_FILE ("XcodeProjectGeneration.gSemantics", 554)) ;
  {
  routine_enter_5F_file_5F_list_5F_for_5F_sources_5F_build_5F_phase (ioArgument_ioXcodeProjectDescription, var_fileList, ioArgument_ioBuildPhaseList, inCompiler  COMMA_SOURCE_FILE ("XcodeProjectGeneration.gSemantics", 556)) ;
  }
}


//---------------------------------------------------------------------------------------------------------------------*
//                                                                                                                     *
//                          Routine 'build_GENERATED_BY_GALGAS_files_for_sources_build_phase'                          *
//                                                                                                                     *
//---------------------------------------------------------------------------------------------------------------------*

void routine_build_5F_GENERATED_5F_BY_5F_GALGAS_5F_files_5F_for_5F_sources_5F_build_5F_phase (GALGAS_XcodeProjectDescription & ioArgument_ioXcodeProjectDescription,
                                                                                              const GALGAS_stringset constinArgument_inComponentNameSet,
                                                                                              GALGAS_Xcode_5F_PBXBuildFile_5F_list & ioArgument_ioBuildPhaseList,
                                                                                              C_Compiler * inCompiler
                                                                                              COMMA_UNUSED_LOCATION_ARGS) {
  GALGAS_stringlist var_fileList = GALGAS_stringlist::constructor_emptyList (SOURCE_FILE ("XcodeProjectGeneration.gSemantics", 570)) ;
  cEnumerator_stringset enumerator_18656 (constinArgument_inComponentNameSet, kEnumeration_up) ;
  while (enumerator_18656.hasCurrentObject ()) {
    const enumGalgasBool test_0 = GALGAS_bool (kIsNotEqual, enumerator_18656.current_key (HERE).reader_pathExtension (SOURCE_FILE ("XcodeProjectGeneration.gSemantics", 572)).objectCompare (GALGAS_string ("h"))).boolEnum () ;
    if (kBoolTrue == test_0) {
      var_fileList.addAssign_operation (enumerator_18656.current_key (HERE)  COMMA_SOURCE_FILE ("XcodeProjectGeneration.gSemantics", 573)) ;
    }
    enumerator_18656.gotoNextObject () ;
  }
  {
  routine_enter_5F_file_5F_list_5F_for_5F_sources_5F_build_5F_phase (ioArgument_ioXcodeProjectDescription, var_fileList, ioArgument_ioBuildPhaseList, inCompiler  COMMA_SOURCE_FILE ("XcodeProjectGeneration.gSemantics", 577)) ;
  }
}


//---------------------------------------------------------------------------------------------------------------------*
//                                                                                                                     *
//                                      Routine 'build_GENERATED_BY_GALGAS_group'                                      *
//                                                                                                                     *
//---------------------------------------------------------------------------------------------------------------------*

void routine_build_5F_GENERATED_5F_BY_5F_GALGAS_5F_group (GALGAS_XcodeProjectDescription & ioArgument_ioXcodeProjectDescription,
                                                          const GALGAS_stringset constinArgument_inComponentNameSet,
                                                          const GALGAS_stringset constinArgument_inGUISourceNameSet,
                                                          GALGAS_XcodeObjectReferenceList & ioArgument_ioFileListForGroup,
                                                          C_Compiler * inCompiler
                                                          COMMA_UNUSED_LOCATION_ARGS) {
  GALGAS_stringlist var_fileList = GALGAS_stringlist::constructor_emptyList (SOURCE_FILE ("XcodeProjectGeneration.gSemantics", 592)) ;
  cEnumerator_stringset enumerator_19244 (constinArgument_inComponentNameSet, kEnumeration_up) ;
  while (enumerator_19244.hasCurrentObject ()) {
    var_fileList.addAssign_operation (enumerator_19244.current (HERE)  COMMA_SOURCE_FILE ("XcodeProjectGeneration.gSemantics", 594)) ;
    enumerator_19244.gotoNextObject () ;
  }
  cEnumerator_stringset enumerator_19309 (constinArgument_inGUISourceNameSet, kEnumeration_up) ;
  while (enumerator_19309.hasCurrentObject ()) {
    var_fileList.addAssign_operation (enumerator_19309.current_key (HERE)  COMMA_SOURCE_FILE ("XcodeProjectGeneration.gSemantics", 597)) ;
    enumerator_19309.gotoNextObject () ;
  }
  {
  routine_enter_5F_files_5F_in_5F_group (ioArgument_ioXcodeProjectDescription, var_fileList, ioArgument_ioFileListForGroup, inCompiler  COMMA_SOURCE_FILE ("XcodeProjectGeneration.gSemantics", 600)) ;
  }
}


//---------------------------------------------------------------------------------------------------------------------*
//                                                                                                                     *
//                        Routine 'build_HAND_CODED_source_files_for_sources_tool_build_phase'                         *
//                                                                                                                     *
//---------------------------------------------------------------------------------------------------------------------*

void routine_build_5F_HAND_5F_CODED_5F_source_5F_files_5F_for_5F_sources_5F_tool_5F_build_5F_phase (GALGAS_XcodeProjectDescription & ioArgument_ioXcodeProjectDescription,
                                                                                                    const GALGAS_stringset constinArgument_inExternSourceNameSet,
                                                                                                    GALGAS_Xcode_5F_PBXBuildFile_5F_list & ioArgument_ioBuildPhaseList,
                                                                                                    C_Compiler * inCompiler
                                                                                                    COMMA_UNUSED_LOCATION_ARGS) {
  GALGAS_stringlist var_fileList = GALGAS_stringlist::constructor_emptyList (SOURCE_FILE ("XcodeProjectGeneration.gSemantics", 614)) ;
  cEnumerator_stringset enumerator_19821 (constinArgument_inExternSourceNameSet, kEnumeration_up) ;
  while (enumerator_19821.hasCurrentObject ()) {
    GALGAS_string var_extension = enumerator_19821.current_key (HERE).reader_pathExtension (SOURCE_FILE ("XcodeProjectGeneration.gSemantics", 616)) ;
    const enumGalgasBool test_0 = GALGAS_bool (kIsEqual, var_extension.objectCompare (GALGAS_string ("cpp"))).operator_or (GALGAS_bool (kIsEqual, var_extension.objectCompare (GALGAS_string ("c"))) COMMA_SOURCE_FILE ("XcodeProjectGeneration.gSemantics", 617)).operator_or (GALGAS_bool (kIsEqual, var_extension.objectCompare (GALGAS_string ("m"))) COMMA_SOURCE_FILE ("XcodeProjectGeneration.gSemantics", 617)).operator_or (GALGAS_bool (kIsEqual, var_extension.objectCompare (GALGAS_string ("mm"))) COMMA_SOURCE_FILE ("XcodeProjectGeneration.gSemantics", 617)).boolEnum () ;
    if (kBoolTrue == test_0) {
      var_fileList.addAssign_operation (enumerator_19821.current_key (HERE)  COMMA_SOURCE_FILE ("XcodeProjectGeneration.gSemantics", 618)) ;
    }
    enumerator_19821.gotoNextObject () ;
  }
  {
  routine_enter_5F_file_5F_list_5F_for_5F_sources_5F_build_5F_phase (ioArgument_ioXcodeProjectDescription, var_fileList, ioArgument_ioBuildPhaseList, inCompiler  COMMA_SOURCE_FILE ("XcodeProjectGeneration.gSemantics", 622)) ;
  }
}


//---------------------------------------------------------------------------------------------------------------------*
//                                                                                                                     *
//                        Routine 'build_HAND_CODED_source_files_for_sources_cocoa_build_phase'                        *
//                                                                                                                     *
//---------------------------------------------------------------------------------------------------------------------*

void routine_build_5F_HAND_5F_CODED_5F_source_5F_files_5F_for_5F_sources_5F_cocoa_5F_build_5F_phase (GALGAS_XcodeProjectDescription & ioArgument_ioXcodeProjectDescription,
                                                                                                     const GALGAS_stringset constinArgument_inExternSourceNameSet,
                                                                                                     GALGAS_Xcode_5F_PBXBuildFile_5F_list & ioArgument_ioBuildPhaseList,
                                                                                                     C_Compiler * inCompiler
                                                                                                     COMMA_UNUSED_LOCATION_ARGS) {
  GALGAS_stringlist var_fileList = GALGAS_stringlist::constructor_emptyList (SOURCE_FILE ("XcodeProjectGeneration.gSemantics", 636)) ;
  cEnumerator_stringset enumerator_20510 (constinArgument_inExternSourceNameSet, kEnumeration_up) ;
  while (enumerator_20510.hasCurrentObject ()) {
    GALGAS_string var_extension = enumerator_20510.current_key (HERE).reader_pathExtension (SOURCE_FILE ("XcodeProjectGeneration.gSemantics", 638)) ;
    const enumGalgasBool test_0 = GALGAS_bool (kIsEqual, var_extension.objectCompare (GALGAS_string ("cpp"))).operator_or (GALGAS_bool (kIsEqual, var_extension.objectCompare (GALGAS_string ("c"))) COMMA_SOURCE_FILE ("XcodeProjectGeneration.gSemantics", 639)).operator_or (GALGAS_bool (kIsEqual, var_extension.objectCompare (GALGAS_string ("m"))) COMMA_SOURCE_FILE ("XcodeProjectGeneration.gSemantics", 639)).operator_or (GALGAS_bool (kIsEqual, var_extension.objectCompare (GALGAS_string ("mm"))) COMMA_SOURCE_FILE ("XcodeProjectGeneration.gSemantics", 639)).operator_or (GALGAS_bool (kIsEqual, var_extension.objectCompare (GALGAS_string ("xib"))) COMMA_SOURCE_FILE ("XcodeProjectGeneration.gSemantics", 639)).boolEnum () ;
    if (kBoolTrue == test_0) {
      var_fileList.addAssign_operation (enumerator_20510.current_key (HERE)  COMMA_SOURCE_FILE ("XcodeProjectGeneration.gSemantics", 640)) ;
    }
    enumerator_20510.gotoNextObject () ;
  }
  {
  routine_enter_5F_file_5F_list_5F_for_5F_sources_5F_build_5F_phase (ioArgument_ioXcodeProjectDescription, var_fileList, ioArgument_ioBuildPhaseList, inCompiler  COMMA_SOURCE_FILE ("XcodeProjectGeneration.gSemantics", 644)) ;
  }
}


//---------------------------------------------------------------------------------------------------------------------*
//                                                                                                                     *
//                                      Routine 'build_HAND_CODED_SOURCES_group'                                       *
//                                                                                                                     *
//---------------------------------------------------------------------------------------------------------------------*

void routine_build_5F_HAND_5F_CODED_5F_SOURCES_5F_group (GALGAS_XcodeProjectDescription & ioArgument_ioXcodeProjectDescription,
                                                         const GALGAS_stringset constinArgument_inExternSourceNameSet,
                                                         GALGAS_XcodeObjectReferenceList & ioArgument_ioFileListForGroup,
                                                         C_Compiler * inCompiler
                                                         COMMA_UNUSED_LOCATION_ARGS) {
  GALGAS_stringlist var_fileList = GALGAS_stringlist::constructor_emptyList (SOURCE_FILE ("XcodeProjectGeneration.gSemantics", 658)) ;
  cEnumerator_stringset enumerator_21190 (constinArgument_inExternSourceNameSet, kEnumeration_up) ;
  while (enumerator_21190.hasCurrentObject ()) {
    GALGAS_string var_extension = enumerator_21190.current_key (HERE).reader_pathExtension (SOURCE_FILE ("XcodeProjectGeneration.gSemantics", 660)) ;
    const enumGalgasBool test_0 = GALGAS_bool (kIsEqual, var_extension.objectCompare (GALGAS_string ("cpp"))).operator_or (GALGAS_bool (kIsEqual, var_extension.objectCompare (GALGAS_string ("c"))) COMMA_SOURCE_FILE ("XcodeProjectGeneration.gSemantics", 661)).operator_or (GALGAS_bool (kIsEqual, var_extension.objectCompare (GALGAS_string ("h"))) COMMA_SOURCE_FILE ("XcodeProjectGeneration.gSemantics", 661)).operator_or (GALGAS_bool (kIsEqual, var_extension.objectCompare (GALGAS_string ("m"))) COMMA_SOURCE_FILE ("XcodeProjectGeneration.gSemantics", 661)).operator_or (GALGAS_bool (kIsEqual, var_extension.objectCompare (GALGAS_string ("mm"))) COMMA_SOURCE_FILE ("XcodeProjectGeneration.gSemantics", 661)).operator_or (GALGAS_bool (kIsEqual, var_extension.objectCompare (GALGAS_string ("xib"))) COMMA_SOURCE_FILE ("XcodeProjectGeneration.gSemantics", 661)).boolEnum () ;
    if (kBoolTrue == test_0) {
      var_fileList.addAssign_operation (enumerator_21190.current_key (HERE)  COMMA_SOURCE_FILE ("XcodeProjectGeneration.gSemantics", 662)) ;
    }
    enumerator_21190.gotoNextObject () ;
  }
  {
  routine_enter_5F_files_5F_in_5F_group (ioArgument_ioXcodeProjectDescription, var_fileList, ioArgument_ioFileListForGroup, inCompiler  COMMA_SOURCE_FILE ("XcodeProjectGeneration.gSemantics", 666)) ;
  }
}


//---------------------------------------------------------------------------------------------------------------------*
//                                                                                                                     *
//                                          Routine 'build_FRAMEWORKS_group'                                           *
//                                                                                                                     *
//---------------------------------------------------------------------------------------------------------------------*

void routine_build_5F_FRAMEWORKS_5F_group (GALGAS_XcodeProjectDescription & ioArgument_ioXcodeProjectDescription,
                                           GALGAS_XcodeObjectReferenceList & ioArgument_ioFileListForGroup,
                                           const GALGAS_stringset constinArgument_inExternSourceForTool,
                                           const GALGAS_stringset constinArgument_inExternSourceForApp,
                                           const GALGAS_bool constinArgument_inHandleUpdateFromInternet,
                                           C_Compiler * inCompiler
                                           COMMA_UNUSED_LOCATION_ARGS) {
  GALGAS_stringset var_fileSet = GALGAS_stringset::constructor_emptySet (SOURCE_FILE ("XcodeProjectGeneration.gSemantics", 682)) ;
  var_fileSet.addAssign_operation (GALGAS_string ("AppKit.framework")  COMMA_SOURCE_FILE ("XcodeProjectGeneration.gSemantics", 683)) ;
  var_fileSet.addAssign_operation (GALGAS_string ("Cocoa.framework")  COMMA_SOURCE_FILE ("XcodeProjectGeneration.gSemantics", 684)) ;
  const enumGalgasBool test_0 = constinArgument_inHandleUpdateFromInternet.boolEnum () ;
  if (kBoolTrue == test_0) {
    var_fileSet.addAssign_operation (GALGAS_string ("WebKit.framework")  COMMA_SOURCE_FILE ("XcodeProjectGeneration.gSemantics", 686)) ;
    var_fileSet.addAssign_operation (GALGAS_string ("Foundation.framework")  COMMA_SOURCE_FILE ("XcodeProjectGeneration.gSemantics", 687)) ;
    var_fileSet.addAssign_operation (GALGAS_string ("Security.framework")  COMMA_SOURCE_FILE ("XcodeProjectGeneration.gSemantics", 688)) ;
    var_fileSet.addAssign_operation (GALGAS_string ("ServiceManagement.framework")  COMMA_SOURCE_FILE ("XcodeProjectGeneration.gSemantics", 689)) ;
  }
  cEnumerator_stringset enumerator_22224 (constinArgument_inExternSourceForTool, kEnumeration_up) ;
  while (enumerator_22224.hasCurrentObject ()) {
    const enumGalgasBool test_1 = GALGAS_bool (kIsEqual, enumerator_22224.current_key (HERE).reader_pathExtension (SOURCE_FILE ("XcodeProjectGeneration.gSemantics", 692)).objectCompare (GALGAS_string ("framework"))).boolEnum () ;
    if (kBoolTrue == test_1) {
      var_fileSet.addAssign_operation (enumerator_22224.current_key (HERE)  COMMA_SOURCE_FILE ("XcodeProjectGeneration.gSemantics", 693)) ;
    }
    enumerator_22224.gotoNextObject () ;
  }
  cEnumerator_stringset enumerator_22358 (constinArgument_inExternSourceForApp, kEnumeration_up) ;
  while (enumerator_22358.hasCurrentObject ()) {
    const enumGalgasBool test_2 = GALGAS_bool (kIsEqual, enumerator_22358.current_key (HERE).reader_pathExtension (SOURCE_FILE ("XcodeProjectGeneration.gSemantics", 697)).objectCompare (GALGAS_string ("framework"))).boolEnum () ;
    if (kBoolTrue == test_2) {
      var_fileSet.addAssign_operation (enumerator_22358.current_key (HERE)  COMMA_SOURCE_FILE ("XcodeProjectGeneration.gSemantics", 698)) ;
    }
    enumerator_22358.gotoNextObject () ;
  }
  {
  routine_enter_5F_files_5F_in_5F_group (ioArgument_ioXcodeProjectDescription, var_fileSet.reader_stringList (SOURCE_FILE ("XcodeProjectGeneration.gSemantics", 704)), ioArgument_ioFileListForGroup, inCompiler  COMMA_SOURCE_FILE ("XcodeProjectGeneration.gSemantics", 702)) ;
  }
}


//---------------------------------------------------------------------------------------------------------------------*
//                                                                                                                     *
//                                Routine 'build_FRAMEWORKS_for_frameworks_build_phase'                                *
//                                                                                                                     *
//---------------------------------------------------------------------------------------------------------------------*

void routine_build_5F_FRAMEWORKS_5F_for_5F_frameworks_5F_build_5F_phase (GALGAS_XcodeProjectDescription & ioArgument_ioXcodeProjectDescription,
                                                                         const GALGAS_stringset constinArgument_inExternFileSet,
                                                                         GALGAS_Xcode_5F_PBXBuildFile_5F_list & ioArgument_ioBuildPhaseList,
                                                                         C_Compiler * inCompiler
                                                                         COMMA_UNUSED_LOCATION_ARGS) {
  GALGAS_stringlist var_fileList = GALGAS_stringlist::constructor_emptyList (SOURCE_FILE ("XcodeProjectGeneration.gSemantics", 716)) ;
  cEnumerator_stringset enumerator_22916 (constinArgument_inExternFileSet, kEnumeration_up) ;
  while (enumerator_22916.hasCurrentObject ()) {
    const enumGalgasBool test_0 = GALGAS_bool (kIsEqual, enumerator_22916.current_key (HERE).reader_pathExtension (SOURCE_FILE ("XcodeProjectGeneration.gSemantics", 718)).objectCompare (GALGAS_string ("framework"))).boolEnum () ;
    if (kBoolTrue == test_0) {
      var_fileList.addAssign_operation (enumerator_22916.current_key (HERE)  COMMA_SOURCE_FILE ("XcodeProjectGeneration.gSemantics", 719)) ;
    }
    enumerator_22916.gotoNextObject () ;
  }
  {
  routine_enter_5F_files_5F_for_5F_frameworks_5F_build_5F_phase (ioArgument_ioXcodeProjectDescription, var_fileList, ioArgument_ioBuildPhaseList, inCompiler  COMMA_SOURCE_FILE ("XcodeProjectGeneration.gSemantics", 723)) ;
  }
}


//---------------------------------------------------------------------------------------------------------------------*
//                                                                                                                     *
//                                 Routine 'build_RESOURCES_for_resources_build_phase'                                 *
//                                                                                                                     *
//---------------------------------------------------------------------------------------------------------------------*

void routine_build_5F_RESOURCES_5F_for_5F_resources_5F_build_5F_phase (GALGAS_XcodeProjectDescription & ioArgument_ioXcodeProjectDescription,
                                                                       const GALGAS_string constinArgument_inBundleBaseName,
                                                                       const GALGAS_string constinArgument_inProjectName,
                                                                       const GALGAS_stringlist constinArgument_inResourceFiles,
                                                                       const GALGAS_bool constinArgument_inAddApplicationUpdateXib,
                                                                       GALGAS_Xcode_5F_PBXBuildFile_5F_list & ioArgument_ioBuildPhaseList,
                                                                       C_Compiler * inCompiler
                                                                       COMMA_UNUSED_LOCATION_ARGS) {
  GALGAS_stringlist var_fileList = constinArgument_inResourceFiles ;
  var_fileList.addAssign_operation (constinArgument_inProjectName  COMMA_SOURCE_FILE ("XcodeProjectGeneration.gSemantics", 741)) ;
  var_fileList.addAssign_operation (constinArgument_inProjectName.operator_concat (GALGAS_string ("_debug")  COMMA_SOURCE_FILE ("XcodeProjectGeneration.gSemantics", 742))  COMMA_SOURCE_FILE ("XcodeProjectGeneration.gSemantics", 742)) ;
  var_fileList.addAssign_operation (GALGAS_string ("I_Stop.tiff")  COMMA_SOURCE_FILE ("XcodeProjectGeneration.gSemantics", 743)) ;
  var_fileList.addAssign_operation (GALGAS_string ("closeSourceFile.tiff")  COMMA_SOURCE_FILE ("XcodeProjectGeneration.gSemantics", 744)) ;
  var_fileList.addAssign_operation (GALGAS_string ("PMDebug.xib")  COMMA_SOURCE_FILE ("XcodeProjectGeneration.gSemantics", 745)) ;
  var_fileList.addAssign_operation (GALGAS_string ("MainMenu.xib")  COMMA_SOURCE_FILE ("XcodeProjectGeneration.gSemantics", 746)) ;
  var_fileList.addAssign_operation (GALGAS_string ("OC_GGS_Document.xib")  COMMA_SOURCE_FILE ("XcodeProjectGeneration.gSemantics", 747)) ;
  const enumGalgasBool test_0 = constinArgument_inAddApplicationUpdateXib.boolEnum () ;
  if (kBoolTrue == test_0) {
    var_fileList.addAssign_operation (constinArgument_inBundleBaseName.operator_concat (GALGAS_string (".")  COMMA_SOURCE_FILE ("XcodeProjectGeneration.gSemantics", 749)).operator_concat (constinArgument_inProjectName  COMMA_SOURCE_FILE ("XcodeProjectGeneration.gSemantics", 749)).operator_concat (GALGAS_string (".updaterApp")  COMMA_SOURCE_FILE ("XcodeProjectGeneration.gSemantics", 749))  COMMA_SOURCE_FILE ("XcodeProjectGeneration.gSemantics", 749)) ;
    var_fileList.addAssign_operation (GALGAS_string ("PMApplicationUpdate.xib")  COMMA_SOURCE_FILE ("XcodeProjectGeneration.gSemantics", 750)) ;
  }
  var_fileList.addAssign_operation (GALGAS_string ("InfoPlist.strings")  COMMA_SOURCE_FILE ("XcodeProjectGeneration.gSemantics", 752)) ;
  var_fileList.addAssign_operation (GALGAS_string ("Credits.rtf")  COMMA_SOURCE_FILE ("XcodeProjectGeneration.gSemantics", 753)) ;
  {
  routine_enter_5F_files_5F_for_5F_frameworks_5F_build_5F_phase (ioArgument_ioXcodeProjectDescription, var_fileList, ioArgument_ioBuildPhaseList, inCompiler  COMMA_SOURCE_FILE ("XcodeProjectGeneration.gSemantics", 755)) ;
  }
}


//---------------------------------------------------------------------------------------------------------------------*
//                                                                                                                     *
//                               Routine 'build_COCOA_APP_files_for_sources_build_phase'                               *
//                                                                                                                     *
//---------------------------------------------------------------------------------------------------------------------*

void routine_build_5F_COCOA_5F_APP_5F_files_5F_for_5F_sources_5F_build_5F_phase (GALGAS_XcodeProjectDescription & ioArgument_ioXcodeProjectDescription,
                                                                                 const GALGAS_stringset constinArgument_inGUISourceNameSet,
                                                                                 const GALGAS_bool constinArgument_inImplementsUpdate,
                                                                                 GALGAS_Xcode_5F_PBXBuildFile_5F_list & ioArgument_ioBuildPhaseList,
                                                                                 C_Compiler * inCompiler
                                                                                 COMMA_UNUSED_LOCATION_ARGS) {
  GALGAS_stringlist var_fileList = GALGAS_stringlist::constructor_emptyList (SOURCE_FILE ("XcodeProjectGeneration.gSemantics", 771)) ;
  var_fileList.addAssign_operation (GALGAS_string ("main.m")  COMMA_SOURCE_FILE ("XcodeProjectGeneration.gSemantics", 772)) ;
  var_fileList.addAssign_operation (GALGAS_string ("PMDebug.m")  COMMA_SOURCE_FILE ("XcodeProjectGeneration.gSemantics", 773)) ;
  var_fileList.addAssign_operation (GALGAS_string ("PMCancelButtonForPanel.m")  COMMA_SOURCE_FILE ("XcodeProjectGeneration.gSemantics", 774)) ;
  var_fileList.addAssign_operation (GALGAS_string ("PMOkButtonForPanel.m")  COMMA_SOURCE_FILE ("XcodeProjectGeneration.gSemantics", 775)) ;
  var_fileList.addAssign_operation (GALGAS_string ("unicode_character_m.m")  COMMA_SOURCE_FILE ("XcodeProjectGeneration.gSemantics", 776)) ;
  var_fileList.addAssign_operation (GALGAS_string ("PMSearchResultDescriptor.m")  COMMA_SOURCE_FILE ("XcodeProjectGeneration.gSemantics", 777)) ;
  var_fileList.addAssign_operation (GALGAS_string ("PMFontButton.m")  COMMA_SOURCE_FILE ("XcodeProjectGeneration.gSemantics", 778)) ;
  var_fileList.addAssign_operation (GALGAS_string ("OC_Token.m")  COMMA_SOURCE_FILE ("XcodeProjectGeneration.gSemantics", 779)) ;
  var_fileList.addAssign_operation (GALGAS_string ("OC_Lexique.m")  COMMA_SOURCE_FILE ("XcodeProjectGeneration.gSemantics", 780)) ;
  var_fileList.addAssign_operation (GALGAS_string ("OC_GGS_CommandLineOption.m")  COMMA_SOURCE_FILE ("XcodeProjectGeneration.gSemantics", 781)) ;
  var_fileList.addAssign_operation (GALGAS_string ("enterDefaultCommandLineOptions.m")  COMMA_SOURCE_FILE ("XcodeProjectGeneration.gSemantics", 782)) ;
  var_fileList.addAssign_operation (GALGAS_string ("OC_GGS_Document.m")  COMMA_SOURCE_FILE ("XcodeProjectGeneration.gSemantics", 783)) ;
  var_fileList.addAssign_operation (GALGAS_string ("OC_GGS_DocumentData.m")  COMMA_SOURCE_FILE ("XcodeProjectGeneration.gSemantics", 784)) ;
  var_fileList.addAssign_operation (GALGAS_string ("OC_GGS_ApplicationDelegate.m")  COMMA_SOURCE_FILE ("XcodeProjectGeneration.gSemantics", 785)) ;
  var_fileList.addAssign_operation (GALGAS_string ("PMIssueDescriptor.m")  COMMA_SOURCE_FILE ("XcodeProjectGeneration.gSemantics", 786)) ;
  var_fileList.addAssign_operation (GALGAS_string ("OC_GGS_TextDisplayDescriptor.m")  COMMA_SOURCE_FILE ("XcodeProjectGeneration.gSemantics", 787)) ;
  var_fileList.addAssign_operation (GALGAS_string ("OC_GGS_TextSyntaxColoring.m")  COMMA_SOURCE_FILE ("XcodeProjectGeneration.gSemantics", 788)) ;
  var_fileList.addAssign_operation (GALGAS_string ("OC_GGS_TextView.m")  COMMA_SOURCE_FILE ("XcodeProjectGeneration.gSemantics", 789)) ;
  var_fileList.addAssign_operation (GALGAS_string ("OC_GGS_RulerViewForTextView.m")  COMMA_SOURCE_FILE ("XcodeProjectGeneration.gSemantics", 790)) ;
  var_fileList.addAssign_operation (GALGAS_string ("OC_GGS_RulerViewForBuildOutput.m")  COMMA_SOURCE_FILE ("XcodeProjectGeneration.gSemantics", 791)) ;
  var_fileList.addAssign_operation (GALGAS_string ("OC_GGS_Scroller.m")  COMMA_SOURCE_FILE ("XcodeProjectGeneration.gSemantics", 792)) ;
  var_fileList.addAssign_operation (GALGAS_string ("PMIssueInRuler.m")  COMMA_SOURCE_FILE ("XcodeProjectGeneration.gSemantics", 793)) ;
  var_fileList.addAssign_operation (GALGAS_string ("OC_GGS_BuildTask.m")  COMMA_SOURCE_FILE ("XcodeProjectGeneration.gSemantics", 794)) ;
  var_fileList.addAssign_operation (GALGAS_string ("PMUndoManager.m")  COMMA_SOURCE_FILE ("XcodeProjectGeneration.gSemantics", 795)) ;
  var_fileList.addAssign_operation (GALGAS_string ("PMTableViewRefusesFirstResponder.m")  COMMA_SOURCE_FILE ("XcodeProjectGeneration.gSemantics", 796)) ;
  const enumGalgasBool test_0 = constinArgument_inImplementsUpdate.boolEnum () ;
  if (kBoolTrue == test_0) {
    var_fileList.addAssign_operation (GALGAS_string ("PMApplicationUpdate.m")  COMMA_SOURCE_FILE ("XcodeProjectGeneration.gSemantics", 799)) ;
    var_fileList.addAssign_operation (GALGAS_string ("PMDownloadData.m")  COMMA_SOURCE_FILE ("XcodeProjectGeneration.gSemantics", 800)) ;
    var_fileList.addAssign_operation (GALGAS_string ("PMDownloadFile.m")  COMMA_SOURCE_FILE ("XcodeProjectGeneration.gSemantics", 801)) ;
  }
  cEnumerator_stringset enumerator_25817 (constinArgument_inGUISourceNameSet, kEnumeration_up) ;
  while (enumerator_25817.hasCurrentObject ()) {
    const enumGalgasBool test_1 = GALGAS_bool (kIsNotEqual, enumerator_25817.current_key (HERE).reader_pathExtension (SOURCE_FILE ("XcodeProjectGeneration.gSemantics", 805)).objectCompare (GALGAS_string ("h"))).boolEnum () ;
    if (kBoolTrue == test_1) {
      var_fileList.addAssign_operation (enumerator_25817.current_key (HERE)  COMMA_SOURCE_FILE ("XcodeProjectGeneration.gSemantics", 806)) ;
    }
    enumerator_25817.gotoNextObject () ;
  }
  {
  routine_enter_5F_file_5F_list_5F_for_5F_sources_5F_build_5F_phase (ioArgument_ioXcodeProjectDescription, var_fileList, ioArgument_ioBuildPhaseList, inCompiler  COMMA_SOURCE_FILE ("XcodeProjectGeneration.gSemantics", 817)) ;
  }
}


//---------------------------------------------------------------------------------------------------------------------*

cMapElement_projectQualifiedFeatureMap::cMapElement_projectQualifiedFeatureMap (const GALGAS_lstring & inKey,
                                                                                const GALGAS_lstring & in_mFeatureValue
                                                                                COMMA_LOCATION_ARGS) :
cMapElement (inKey COMMA_THERE),
mAttribute_mFeatureValue (in_mFeatureValue) {
}

//---------------------------------------------------------------------------------------------------------------------*

bool cMapElement_projectQualifiedFeatureMap::isValid (void) const {
  return mAttribute_lkey.isValid () && mAttribute_mFeatureValue.isValid () ;
}

//---------------------------------------------------------------------------------------------------------------------*

cMapElement * cMapElement_projectQualifiedFeatureMap::copy (void) {
  cMapElement * result = NULL ;
  macroMyNew (result, cMapElement_projectQualifiedFeatureMap (mAttribute_lkey, mAttribute_mFeatureValue COMMA_HERE)) ;
  return result ;
}

//---------------------------------------------------------------------------------------------------------------------*

void cMapElement_projectQualifiedFeatureMap::description (C_String & ioString, const int32_t inIndentation) const {
  ioString << "\n" ;
  ioString.writeStringMultiple ("| ", inIndentation) ;
  ioString << "mFeatureValue" ":" ;
  mAttribute_mFeatureValue.description (ioString, inIndentation) ;
}

//---------------------------------------------------------------------------------------------------------------------*

typeComparisonResult cMapElement_projectQualifiedFeatureMap::compare (const cCollectionElement * inOperand) const {
  cMapElement_projectQualifiedFeatureMap * operand = (cMapElement_projectQualifiedFeatureMap *) inOperand ;
  typeComparisonResult result = mAttribute_lkey.objectCompare (operand->mAttribute_lkey) ;
  if (kOperandEqual == result) {
    result = mAttribute_mFeatureValue.objectCompare (operand->mAttribute_mFeatureValue) ;
  }
  return result ;
}

//---------------------------------------------------------------------------------------------------------------------*

GALGAS_projectQualifiedFeatureMap::GALGAS_projectQualifiedFeatureMap (void) :
AC_GALGAS_map () {
}

//---------------------------------------------------------------------------------------------------------------------*

GALGAS_projectQualifiedFeatureMap::GALGAS_projectQualifiedFeatureMap (const GALGAS_projectQualifiedFeatureMap & inSource) :
AC_GALGAS_map (inSource) {
}

//---------------------------------------------------------------------------------------------------------------------*

GALGAS_projectQualifiedFeatureMap & GALGAS_projectQualifiedFeatureMap::operator = (const GALGAS_projectQualifiedFeatureMap & inSource) {
  * ((AC_GALGAS_map *) this) = inSource ;
  return * this ;
}

//---------------------------------------------------------------------------------------------------------------------*

GALGAS_projectQualifiedFeatureMap GALGAS_projectQualifiedFeatureMap::constructor_emptyMap (LOCATION_ARGS) {
  GALGAS_projectQualifiedFeatureMap result ;
  result.makeNewEmptyMap (THERE) ;
  return result ;
}

//---------------------------------------------------------------------------------------------------------------------*

GALGAS_projectQualifiedFeatureMap GALGAS_projectQualifiedFeatureMap::constructor_mapWithMapToOverride (const GALGAS_projectQualifiedFeatureMap & inMapToOverride
                                                                                                       COMMA_LOCATION_ARGS) {
  GALGAS_projectQualifiedFeatureMap result ;
  result.makeNewEmptyMapWithMapToOverride (inMapToOverride COMMA_THERE) ;
  return result ;
}

//---------------------------------------------------------------------------------------------------------------------*

GALGAS_projectQualifiedFeatureMap GALGAS_projectQualifiedFeatureMap::reader_overriddenMap (C_Compiler * inCompiler
                                                                                           COMMA_LOCATION_ARGS) const {
  GALGAS_projectQualifiedFeatureMap result ;
  getOverridenMap (result, inCompiler COMMA_THERE) ;
  return result ;
}

//---------------------------------------------------------------------------------------------------------------------*

void GALGAS_projectQualifiedFeatureMap::addAssign_operation (const GALGAS_lstring & inKey,
                                                             const GALGAS_lstring & inArgument0,
                                                             C_Compiler * inCompiler
                                                             COMMA_LOCATION_ARGS) {
  cMapElement_projectQualifiedFeatureMap * p = NULL ;
  macroMyNew (p, cMapElement_projectQualifiedFeatureMap (inKey, inArgument0 COMMA_HERE)) ;
  capCollectionElement attributes ;
  attributes.setPointer (p) ;
  macroDetachSharedObject (p) ;
  const char * kInsertErrorMessage = "@projectQualifiedFeatureMap insert error: '%K' already in map" ;
  const char * kShadowErrorMessage = "" ;
  performInsert (attributes, inCompiler, kInsertErrorMessage, kShadowErrorMessage COMMA_THERE) ;
}

//---------------------------------------------------------------------------------------------------------------------*

void GALGAS_projectQualifiedFeatureMap::modifier_insertKey (GALGAS_lstring inKey,
                                                            GALGAS_lstring inArgument0,
                                                            C_Compiler * inCompiler
                                                            COMMA_LOCATION_ARGS) {
  cMapElement_projectQualifiedFeatureMap * p = NULL ;
  macroMyNew (p, cMapElement_projectQualifiedFeatureMap (inKey, inArgument0 COMMA_HERE)) ;
  capCollectionElement attributes ;
  attributes.setPointer (p) ;
  macroDetachSharedObject (p) ;
  const char * kInsertErrorMessage = "the '%K' feature is already declared" ;
  const char * kShadowErrorMessage = "" ;
  performInsert (attributes, inCompiler, kInsertErrorMessage, kShadowErrorMessage COMMA_THERE) ;
}

//---------------------------------------------------------------------------------------------------------------------*

const char * kSearchErrorMessage_projectQualifiedFeatureMap_searchKey = "the '%K' feature is not declared" ;

//---------------------------------------------------------------------------------------------------------------------*

void GALGAS_projectQualifiedFeatureMap::method_searchKey (GALGAS_lstring inKey,
                                                          GALGAS_lstring & outArgument0,
                                                          C_Compiler * inCompiler
                                                          COMMA_LOCATION_ARGS) const {
  const cMapElement_projectQualifiedFeatureMap * p = (const cMapElement_projectQualifiedFeatureMap *) performSearch (inKey,
                                                                                                                       inCompiler,
                                                                                                                       kSearchErrorMessage_projectQualifiedFeatureMap_searchKey
                                                                                                                       COMMA_THERE) ;
  if (NULL == p) {
    outArgument0.drop () ;
  }else{
    macroValidSharedObject (p, cMapElement_projectQualifiedFeatureMap) ;
    outArgument0 = p->mAttribute_mFeatureValue ;
  }
}

//---------------------------------------------------------------------------------------------------------------------*

GALGAS_lstring GALGAS_projectQualifiedFeatureMap::reader_mFeatureValueForKey (const GALGAS_string & inKey,
                                                                              C_Compiler * inCompiler
                                                                              COMMA_LOCATION_ARGS) const {
  const cCollectionElement * attributes = searchForReadingAttribute (inKey, inCompiler COMMA_THERE) ;
  const cMapElement_projectQualifiedFeatureMap * p = (const cMapElement_projectQualifiedFeatureMap *) attributes ;
  GALGAS_lstring result ;
  if (NULL != p) {
    macroValidSharedObject (p, cMapElement_projectQualifiedFeatureMap) ;
    result = p->mAttribute_mFeatureValue ;
  }
  return result ;
}

//---------------------------------------------------------------------------------------------------------------------*

void GALGAS_projectQualifiedFeatureMap::modifier_setMFeatureValueForKey (GALGAS_lstring inAttributeValue,
                                                                         GALGAS_string inKey,
                                                                         C_Compiler * inCompiler
                                                                         COMMA_LOCATION_ARGS) {
  cCollectionElement * attributes = searchForReadWriteAttribute (inKey, inCompiler COMMA_THERE) ;
  cMapElement_projectQualifiedFeatureMap * p = (cMapElement_projectQualifiedFeatureMap *) attributes ;
  if (NULL != p) {
    macroValidSharedObject (p, cMapElement_projectQualifiedFeatureMap) ;
    p->mAttribute_mFeatureValue = inAttributeValue ;
  }
}

//---------------------------------------------------------------------------------------------------------------------*

cMapElement_projectQualifiedFeatureMap * GALGAS_projectQualifiedFeatureMap::readWriteAccessForWithInstruction (C_Compiler * inCompiler,
                                                                                                               const GALGAS_string & inKey
                                                                                                               COMMA_LOCATION_ARGS) {
  cMapElement_projectQualifiedFeatureMap * result = (cMapElement_projectQualifiedFeatureMap *) searchForReadWriteAttribute (inKey, inCompiler COMMA_THERE) ;
  macroNullOrValidSharedObject (result, cMapElement_projectQualifiedFeatureMap) ;
  return result ;
}

//---------------------------------------------------------------------------------------------------------------------*

cEnumerator_projectQualifiedFeatureMap::cEnumerator_projectQualifiedFeatureMap (const GALGAS_projectQualifiedFeatureMap & inEnumeratedObject,
                                                                                const typeEnumerationOrder inOrder) :
cGenericAbstractEnumerator () {
  inEnumeratedObject.populateEnumerationArray (mEnumerationArray, inOrder) ;
}

//---------------------------------------------------------------------------------------------------------------------*

GALGAS_projectQualifiedFeatureMap_2D_element cEnumerator_projectQualifiedFeatureMap::current (LOCATION_ARGS) const {
  const cMapElement_projectQualifiedFeatureMap * p = (const cMapElement_projectQualifiedFeatureMap *) currentObjectPtr (THERE) ;
  macroValidSharedObject (p, cMapElement_projectQualifiedFeatureMap) ;
  return GALGAS_projectQualifiedFeatureMap_2D_element (p->mAttribute_lkey, p->mAttribute_mFeatureValue) ;
}

//---------------------------------------------------------------------------------------------------------------------*

GALGAS_lstring cEnumerator_projectQualifiedFeatureMap::current_lkey (LOCATION_ARGS) const {
  const cMapElement * p = (const cMapElement *) currentObjectPtr (THERE) ;
  macroValidSharedObject (p, cMapElement) ;
  return p->mAttribute_lkey ;
}

//---------------------------------------------------------------------------------------------------------------------*

GALGAS_lstring cEnumerator_projectQualifiedFeatureMap::current_mFeatureValue (LOCATION_ARGS) const {
  const cMapElement_projectQualifiedFeatureMap * p = (const cMapElement_projectQualifiedFeatureMap *) currentObjectPtr (THERE) ;
  macroValidSharedObject (p, cMapElement_projectQualifiedFeatureMap) ;
  return p->mAttribute_mFeatureValue ;
}



//---------------------------------------------------------------------------------------------------------------------*
//                                                                                                                     *
//                                          @projectQualifiedFeatureMap type                                           *
//                                                                                                                     *
//---------------------------------------------------------------------------------------------------------------------*

const C_galgas_type_descriptor
kTypeDescriptor_GALGAS_projectQualifiedFeatureMap ("projectQualifiedFeatureMap",
                                                   NULL) ;

//---------------------------------------------------------------------------------------------------------------------*

const C_galgas_type_descriptor * GALGAS_projectQualifiedFeatureMap::staticTypeDescriptor (void) const {
  return & kTypeDescriptor_GALGAS_projectQualifiedFeatureMap ;
}

//---------------------------------------------------------------------------------------------------------------------*

AC_GALGAS_root * GALGAS_projectQualifiedFeatureMap::clonedObject (void) const {
  AC_GALGAS_root * result = NULL ;
  if (isValid ()) {
    macroMyNew (result, GALGAS_projectQualifiedFeatureMap (*this)) ;
  }
  return result ;
}

//---------------------------------------------------------------------------------------------------------------------*

GALGAS_projectQualifiedFeatureMap GALGAS_projectQualifiedFeatureMap::extractObject (const GALGAS_object & inObject,
                                                                                    C_Compiler * inCompiler
                                                                                    COMMA_LOCATION_ARGS) {
  GALGAS_projectQualifiedFeatureMap result ;
  const GALGAS_projectQualifiedFeatureMap * p = (const GALGAS_projectQualifiedFeatureMap *) inObject.embeddedObject () ;
  if (NULL != p) {
    if (NULL != dynamic_cast <const GALGAS_projectQualifiedFeatureMap *> (p)) {
      result = *p ;
    }else{
      inCompiler->castError ("projectQualifiedFeatureMap", p->dynamicTypeDescriptor () COMMA_THERE) ;
    }  
  }
  return result ;
}

//---------------------------------------------------------------------------------------------------------------------*
//                                                                                                                     *
//                                           Routine 'generateXcodeProject'                                            *
//                                                                                                                     *
//---------------------------------------------------------------------------------------------------------------------*

void routine_generateXcodeProject (const GALGAS_stringset constinArgument_inExternSourceNameSet_5F_tool,
                                   const GALGAS_stringset constinArgument_inSourceFileSetForTool,
                                   const GALGAS_string constinArgument_inGeneratedByGalgasSourcePath,
                                   const GALGAS_stringset constinArgument_inExternSourceNameSet_5F_app,
                                   const GALGAS_stringset constinArgument_inGUISourceNameSet_5F_app,
                                   const GALGAS_string constinArgument_inProjectName,
                                   const GALGAS_stringlist constinArgument_inHandCodedLinkAppFileList,
                                   const GALGAS_string constinArgument_in_5F_xcodeproj_5F_filePath,
                                   const GALGAS_stringlist constinArgument_inResourceFiles,
                                   const GALGAS_string constinArgument_inReferenceFilePath,
                                   const GALGAS_string constinArgument_inSDK,
                                   const GALGAS_string constinArgument_inLIBPMpath,
                                   const GALGAS_string constinArgument_inAdditionalPathForTool,
                                   const GALGAS_bool constinArgument_inMultiThreadingEnabled,
                                   const GALGAS_bool constinArgument_inUsesARC,
                                   const GALGAS_projectQualifiedFeatureMap constinArgument_inProjectQualifiedFeatureMap,
                                   C_Compiler * inCompiler
                                   COMMA_UNUSED_LOCATION_ARGS) {
  GALGAS_bool var_handleUpdateFromInternet = constinArgument_inProjectQualifiedFeatureMap.reader_hasKey (GALGAS_string ("repositoryURL") COMMA_SOURCE_FILE ("XcodeProjectGeneration.gSemantics", 852)) ;
  GALGAS_string var_bundleBaseName ;
  const cMapElement_projectQualifiedFeatureMap * objectArray_27405 = (const cMapElement_projectQualifiedFeatureMap *) constinArgument_inProjectQualifiedFeatureMap.readAccessForWithInstruction (GALGAS_string ("applicationBundleBase")) ;
  if (NULL != objectArray_27405) {
      macroValidSharedObject (objectArray_27405, cMapElement_projectQualifiedFeatureMap) ;
    var_bundleBaseName = objectArray_27405->mAttribute_mFeatureValue.mAttribute_string ;
  }else{
    var_bundleBaseName = GALGAS_string::makeEmptyString () ;
  }
  GALGAS_XcodeProjectDescription var_XcodeProjectDescription ;
  {
  routine_initXcodeProjectDescription (var_XcodeProjectDescription, inCompiler  COMMA_SOURCE_FILE ("XcodeProjectGeneration.gSemantics", 862)) ;
  }
  GALGAS_XcodeObjectReferenceList var_fileListOf_5F_HAND_5F_CODED_5F_SOURCES_5F_group = GALGAS_XcodeObjectReferenceList::constructor_emptyList (SOURCE_FILE ("XcodeProjectGeneration.gSemantics", 865)) ;
  GALGAS_stringset var_fileSet = constinArgument_inExternSourceNameSet_5F_tool.operator_or (constinArgument_inExternSourceNameSet_5F_app COMMA_SOURCE_FILE ("XcodeProjectGeneration.gSemantics", 866)) ;
  {
  var_fileSet.modifier_removeKey (GALGAS_string ("AppKit.framework") COMMA_SOURCE_FILE ("XcodeProjectGeneration.gSemantics", 867)) ;
  }
  {
  var_fileSet.modifier_removeKey (GALGAS_string ("Cocoa.framework") COMMA_SOURCE_FILE ("XcodeProjectGeneration.gSemantics", 868)) ;
  }
  const enumGalgasBool test_0 = GALGAS_bool (kIsStrictSup, var_fileSet.reader_count (SOURCE_FILE ("XcodeProjectGeneration.gSemantics", 869)).objectCompare (GALGAS_uint ((uint32_t) 0U))).boolEnum () ;
  if (kBoolTrue == test_0) {
    {
    routine_build_5F_HAND_5F_CODED_5F_SOURCES_5F_group (var_XcodeProjectDescription, var_fileSet, var_fileListOf_5F_HAND_5F_CODED_5F_SOURCES_5F_group, inCompiler  COMMA_SOURCE_FILE ("XcodeProjectGeneration.gSemantics", 870)) ;
    }
    {
    routine_enter_5F_group (var_XcodeProjectDescription, GALGAS_string ("Hand Coded Sources"), GALGAS_string ("../hand_coded_sources"), var_fileListOf_5F_HAND_5F_CODED_5F_SOURCES_5F_group, inCompiler  COMMA_SOURCE_FILE ("XcodeProjectGeneration.gSemantics", 876)) ;
    }
  }
  GALGAS_XcodeObjectReferenceList var_fileListOf_5F_GENERATED_5F_BY_5F_GALGAS_5F_group = GALGAS_XcodeObjectReferenceList::constructor_emptyList (SOURCE_FILE ("XcodeProjectGeneration.gSemantics", 884)) ;
  {
  routine_build_5F_GENERATED_5F_BY_5F_GALGAS_5F_group (var_XcodeProjectDescription, constinArgument_inSourceFileSetForTool, constinArgument_inGUISourceNameSet_5F_app, var_fileListOf_5F_GENERATED_5F_BY_5F_GALGAS_5F_group, inCompiler  COMMA_SOURCE_FILE ("XcodeProjectGeneration.gSemantics", 885)) ;
  }
  {
  routine_enter_5F_group (var_XcodeProjectDescription, GALGAS_string ("Generated by GALGAS"), constinArgument_inGeneratedByGalgasSourcePath, var_fileListOf_5F_GENERATED_5F_BY_5F_GALGAS_5F_group, inCompiler  COMMA_SOURCE_FILE ("XcodeProjectGeneration.gSemantics", 892)) ;
  }
  GALGAS_XcodeObjectReferenceList var_libpmGroupChildrenList = GALGAS_XcodeObjectReferenceList::constructor_emptyList (SOURCE_FILE ("XcodeProjectGeneration.gSemantics", 899)) ;
  GALGAS_XcodeObjectReferenceList var_fileListOf_5F_LIBPM_5F_BDD_5F_group = GALGAS_XcodeObjectReferenceList::constructor_emptyList (SOURCE_FILE ("XcodeProjectGeneration.gSemantics", 901)) ;
  {
  routine_build_5F_LIBPM_5F_BDD_5F_group (var_XcodeProjectDescription, var_fileListOf_5F_LIBPM_5F_BDD_5F_group, inCompiler  COMMA_SOURCE_FILE ("XcodeProjectGeneration.gSemantics", 902)) ;
  }
  {
  routine_enter_5F_subgroup (var_XcodeProjectDescription, GALGAS_string ("Binary Decision Diagrams"), GALGAS_string ("bdd"), var_fileListOf_5F_LIBPM_5F_BDD_5F_group, var_libpmGroupChildrenList, inCompiler  COMMA_SOURCE_FILE ("XcodeProjectGeneration.gSemantics", 907)) ;
  }
  GALGAS_XcodeObjectReferenceList var_fileListOf_5F_LIBPM_5F_COCOA_5F_GALGAS_5F_group = GALGAS_XcodeObjectReferenceList::constructor_emptyList (SOURCE_FILE ("XcodeProjectGeneration.gSemantics", 915)) ;
  {
  routine_build_5F_LIBPM_5F_COCOA_5F_GALGAS_5F_group (var_XcodeProjectDescription, var_fileListOf_5F_LIBPM_5F_COCOA_5F_GALGAS_5F_group, inCompiler  COMMA_SOURCE_FILE ("XcodeProjectGeneration.gSemantics", 916)) ;
  }
  {
  routine_enter_5F_subgroup (var_XcodeProjectDescription, GALGAS_string ("Cocoa GALGAS"), GALGAS_string ("cocoa_galgas"), var_fileListOf_5F_LIBPM_5F_COCOA_5F_GALGAS_5F_group, var_libpmGroupChildrenList, inCompiler  COMMA_SOURCE_FILE ("XcodeProjectGeneration.gSemantics", 920)) ;
  }
  GALGAS_XcodeObjectReferenceList var_fileListOf_5F_LIBPM_5F_COCOA_5F_UTILITIES_5F_group = GALGAS_XcodeObjectReferenceList::constructor_emptyList (SOURCE_FILE ("XcodeProjectGeneration.gSemantics", 928)) ;
  {
  routine_build_5F_LIBPM_5F_COCOA_5F_UTILITIES_5F_group (var_XcodeProjectDescription, var_fileListOf_5F_LIBPM_5F_COCOA_5F_UTILITIES_5F_group, inCompiler  COMMA_SOURCE_FILE ("XcodeProjectGeneration.gSemantics", 929)) ;
  }
  {
  routine_enter_5F_subgroup (var_XcodeProjectDescription, GALGAS_string ("Cocoa Utilities"), GALGAS_string ("cocoa_utilities"), var_fileListOf_5F_LIBPM_5F_COCOA_5F_UTILITIES_5F_group, var_libpmGroupChildrenList, inCompiler  COMMA_SOURCE_FILE ("XcodeProjectGeneration.gSemantics", 933)) ;
  }
  GALGAS_XcodeObjectReferenceList var_fileListOf_5F_LIBPM_5F_COLLECTIONS_5F_group = GALGAS_XcodeObjectReferenceList::constructor_emptyList (SOURCE_FILE ("XcodeProjectGeneration.gSemantics", 941)) ;
  {
  routine_build_5F_LIBPM_5F_COLLECTIONS_5F_group (var_XcodeProjectDescription, var_fileListOf_5F_LIBPM_5F_COLLECTIONS_5F_group, inCompiler  COMMA_SOURCE_FILE ("XcodeProjectGeneration.gSemantics", 942)) ;
  }
  {
  routine_enter_5F_subgroup (var_XcodeProjectDescription, GALGAS_string ("Collections"), GALGAS_string ("collections"), var_fileListOf_5F_LIBPM_5F_COLLECTIONS_5F_group, var_libpmGroupChildrenList, inCompiler  COMMA_SOURCE_FILE ("XcodeProjectGeneration.gSemantics", 947)) ;
  }
  GALGAS_XcodeObjectReferenceList var_fileListOf_5F_LIBPM_5F_COMMAND_5F_LINE_5F_INTERFACE_5F_group = GALGAS_XcodeObjectReferenceList::constructor_emptyList (SOURCE_FILE ("XcodeProjectGeneration.gSemantics", 955)) ;
  {
  routine_build_5F_LIBPM_5F_COMMAND_5F_LINE_5F_INTERFACE_5F_group (var_XcodeProjectDescription, var_fileListOf_5F_LIBPM_5F_COMMAND_5F_LINE_5F_INTERFACE_5F_group, inCompiler  COMMA_SOURCE_FILE ("XcodeProjectGeneration.gSemantics", 956)) ;
  }
  {
  routine_enter_5F_subgroup (var_XcodeProjectDescription, GALGAS_string ("Command Line Interface"), GALGAS_string ("command_line_interface"), var_fileListOf_5F_LIBPM_5F_COMMAND_5F_LINE_5F_INTERFACE_5F_group, var_libpmGroupChildrenList, inCompiler  COMMA_SOURCE_FILE ("XcodeProjectGeneration.gSemantics", 961)) ;
  }
  GALGAS_XcodeObjectReferenceList var_fileListOf_5F_LIBPM_5F_FILE_5F_group = GALGAS_XcodeObjectReferenceList::constructor_emptyList (SOURCE_FILE ("XcodeProjectGeneration.gSemantics", 969)) ;
  {
  routine_build_5F_LIBPM_5F_FILES_5F_group (var_XcodeProjectDescription, var_fileListOf_5F_LIBPM_5F_FILE_5F_group, inCompiler  COMMA_SOURCE_FILE ("XcodeProjectGeneration.gSemantics", 970)) ;
  }
  {
  routine_enter_5F_subgroup (var_XcodeProjectDescription, GALGAS_string ("Files"), GALGAS_string ("files"), var_fileListOf_5F_LIBPM_5F_FILE_5F_group, var_libpmGroupChildrenList, inCompiler  COMMA_SOURCE_FILE ("XcodeProjectGeneration.gSemantics", 975)) ;
  }
  GALGAS_XcodeObjectReferenceList var_fileListOf_5F_LIBPM_5F_GALGAS_5F__32__5F_group = GALGAS_XcodeObjectReferenceList::constructor_emptyList (SOURCE_FILE ("XcodeProjectGeneration.gSemantics", 983)) ;
  {
  routine_build_5F_LIBPM_5F_GALGAS_5F__32__5F_group (var_XcodeProjectDescription, var_fileListOf_5F_LIBPM_5F_GALGAS_5F__32__5F_group, inCompiler  COMMA_SOURCE_FILE ("XcodeProjectGeneration.gSemantics", 984)) ;
  }
  {
  routine_enter_5F_subgroup (var_XcodeProjectDescription, GALGAS_string ("GALGAS 2"), GALGAS_string ("galgas2"), var_fileListOf_5F_LIBPM_5F_GALGAS_5F__32__5F_group, var_libpmGroupChildrenList, inCompiler  COMMA_SOURCE_FILE ("XcodeProjectGeneration.gSemantics", 989)) ;
  }
  GALGAS_XcodeObjectReferenceList var_fileListOf_5F_LIBPM_5F_STREAMS_5F_group = GALGAS_XcodeObjectReferenceList::constructor_emptyList (SOURCE_FILE ("XcodeProjectGeneration.gSemantics", 997)) ;
  {
  routine_build_5F_LIBPM_5F_STREAMS_5F_group (var_XcodeProjectDescription, var_fileListOf_5F_LIBPM_5F_STREAMS_5F_group, inCompiler  COMMA_SOURCE_FILE ("XcodeProjectGeneration.gSemantics", 998)) ;
  }
  {
  routine_enter_5F_subgroup (var_XcodeProjectDescription, GALGAS_string ("Streams"), GALGAS_string ("streams"), var_fileListOf_5F_LIBPM_5F_STREAMS_5F_group, var_libpmGroupChildrenList, inCompiler  COMMA_SOURCE_FILE ("XcodeProjectGeneration.gSemantics", 1003)) ;
  }
  GALGAS_XcodeObjectReferenceList var_fileListOf_5F_LIBPM_5F_TIME_5F_group = GALGAS_XcodeObjectReferenceList::constructor_emptyList (SOURCE_FILE ("XcodeProjectGeneration.gSemantics", 1011)) ;
  {
  routine_build_5F_LIBPM_5F_TIME_5F_group (var_XcodeProjectDescription, var_fileListOf_5F_LIBPM_5F_TIME_5F_group, inCompiler  COMMA_SOURCE_FILE ("XcodeProjectGeneration.gSemantics", 1012)) ;
  }
  {
  routine_enter_5F_subgroup (var_XcodeProjectDescription, GALGAS_string ("Time"), GALGAS_string ("time"), var_fileListOf_5F_LIBPM_5F_TIME_5F_group, var_libpmGroupChildrenList, inCompiler  COMMA_SOURCE_FILE ("XcodeProjectGeneration.gSemantics", 1017)) ;
  }
  GALGAS_XcodeObjectReferenceList var_fileListOf_5F_LIBPM_5F_UTILITIES_5F_group = GALGAS_XcodeObjectReferenceList::constructor_emptyList (SOURCE_FILE ("XcodeProjectGeneration.gSemantics", 1025)) ;
  {
  routine_build_5F_LIBPM_5F_UTILITIES_5F_group (var_XcodeProjectDescription, var_fileListOf_5F_LIBPM_5F_UTILITIES_5F_group, inCompiler  COMMA_SOURCE_FILE ("XcodeProjectGeneration.gSemantics", 1026)) ;
  }
  {
  routine_enter_5F_subgroup (var_XcodeProjectDescription, GALGAS_string ("Utilities"), GALGAS_string ("utilities"), var_fileListOf_5F_LIBPM_5F_UTILITIES_5F_group, var_libpmGroupChildrenList, inCompiler  COMMA_SOURCE_FILE ("XcodeProjectGeneration.gSemantics", 1031)) ;
  }
  GALGAS_XcodeObjectReferenceList var_fileListOf_5F_LIBPM_5F_STRINGS_5F_group = GALGAS_XcodeObjectReferenceList::constructor_emptyList (SOURCE_FILE ("XcodeProjectGeneration.gSemantics", 1039)) ;
  {
  routine_build_5F_LIBPM_5F_STRINGS_5F_group (var_XcodeProjectDescription, var_fileListOf_5F_LIBPM_5F_STRINGS_5F_group, inCompiler  COMMA_SOURCE_FILE ("XcodeProjectGeneration.gSemantics", 1040)) ;
  }
  {
  routine_enter_5F_subgroup (var_XcodeProjectDescription, GALGAS_string ("Strings"), GALGAS_string ("strings"), var_fileListOf_5F_LIBPM_5F_STRINGS_5F_group, var_libpmGroupChildrenList, inCompiler  COMMA_SOURCE_FILE ("XcodeProjectGeneration.gSemantics", 1045)) ;
  }
  {
  routine_enter_5F_group (var_XcodeProjectDescription, GALGAS_string ("LIBPM"), constinArgument_inLIBPMpath, var_libpmGroupChildrenList, inCompiler  COMMA_SOURCE_FILE ("XcodeProjectGeneration.gSemantics", 1053)) ;
  }
  GALGAS_XcodeObjectReferenceList var_fileListOf_5F_PROJECT_5F_RESOURCES_5F_group = GALGAS_XcodeObjectReferenceList::constructor_emptyList (SOURCE_FILE ("XcodeProjectGeneration.gSemantics", 1060)) ;
  {
  routine_build_5F_PROJECT_5F_RESOURCES_5F_group (var_XcodeProjectDescription, var_fileListOf_5F_PROJECT_5F_RESOURCES_5F_group, inCompiler  COMMA_SOURCE_FILE ("XcodeProjectGeneration.gSemantics", 1061)) ;
  }
  {
  routine_enter_5F_group (var_XcodeProjectDescription, GALGAS_string ("Project Resources"), GALGAS_string::makeEmptyString (), var_fileListOf_5F_PROJECT_5F_RESOURCES_5F_group, inCompiler  COMMA_SOURCE_FILE ("XcodeProjectGeneration.gSemantics", 1065)) ;
  }
  GALGAS_XcodeObjectReferenceList var_fileListOf_5F_USER_5F_RESOURCES_5F_group = GALGAS_XcodeObjectReferenceList::constructor_emptyList (SOURCE_FILE ("XcodeProjectGeneration.gSemantics", 1072)) ;
  {
  routine_enter_5F_files_5F_in_5F_group (var_XcodeProjectDescription, constinArgument_inResourceFiles, var_fileListOf_5F_USER_5F_RESOURCES_5F_group, inCompiler  COMMA_SOURCE_FILE ("XcodeProjectGeneration.gSemantics", 1073)) ;
  }
  {
  routine_enter_5F_group (var_XcodeProjectDescription, GALGAS_string ("User Resources"), GALGAS_string ("userResources"), var_fileListOf_5F_USER_5F_RESOURCES_5F_group, inCompiler  COMMA_SOURCE_FILE ("XcodeProjectGeneration.gSemantics", 1078)) ;
  }
  GALGAS_XcodeObjectReferenceList var_fileListOf_5F_FRAMEWORKS_5F_group = GALGAS_XcodeObjectReferenceList::constructor_emptyList (SOURCE_FILE ("XcodeProjectGeneration.gSemantics", 1085)) ;
  {
  routine_build_5F_FRAMEWORKS_5F_group (var_XcodeProjectDescription, var_fileListOf_5F_FRAMEWORKS_5F_group, constinArgument_inExternSourceNameSet_5F_tool, constinArgument_inExternSourceNameSet_5F_app.operator_or (GALGAS_stringset::constructor_setWithStringList (constinArgument_inHandCodedLinkAppFileList  COMMA_SOURCE_FILE ("XcodeProjectGeneration.gSemantics", 1090)) COMMA_SOURCE_FILE ("XcodeProjectGeneration.gSemantics", 1090)), var_handleUpdateFromInternet, inCompiler  COMMA_SOURCE_FILE ("XcodeProjectGeneration.gSemantics", 1086)) ;
  }
  {
  routine_enter_5F_group (var_XcodeProjectDescription, GALGAS_string ("Frameworks"), GALGAS_string ("/System/Library/Frameworks"), var_fileListOf_5F_FRAMEWORKS_5F_group, inCompiler  COMMA_SOURCE_FILE ("XcodeProjectGeneration.gSemantics", 1094)) ;
  }
  const enumGalgasBool test_1 = var_handleUpdateFromInternet.boolEnum () ;
  if (kBoolTrue == test_1) {
    GALGAS_XcodeObjectReferenceList var_fileListOf_5F_APPLICATION_5F_UPDATE_5F_group = GALGAS_XcodeObjectReferenceList::constructor_emptyList (SOURCE_FILE ("XcodeProjectGeneration.gSemantics", 1103)) ;
    {
    routine_enter_5F_file_5F_in_5F_group (var_XcodeProjectDescription, GALGAS_string ("PMApplicationUpdate.h"), var_fileListOf_5F_APPLICATION_5F_UPDATE_5F_group, inCompiler  COMMA_SOURCE_FILE ("XcodeProjectGeneration.gSemantics", 1104)) ;
    }
    {
    routine_enter_5F_file_5F_in_5F_group (var_XcodeProjectDescription, GALGAS_string ("PMApplicationUpdate.m"), var_fileListOf_5F_APPLICATION_5F_UPDATE_5F_group, inCompiler  COMMA_SOURCE_FILE ("XcodeProjectGeneration.gSemantics", 1105)) ;
    }
    {
    routine_enter_5F_xib_5F_file_5F_in_5F_group (var_XcodeProjectDescription, GALGAS_string ("English.lproj"), GALGAS_string ("PMApplicationUpdate.xib"), var_fileListOf_5F_APPLICATION_5F_UPDATE_5F_group, inCompiler  COMMA_SOURCE_FILE ("XcodeProjectGeneration.gSemantics", 1106)) ;
    }
    {
    routine_enter_5F_file_5F_in_5F_group (var_XcodeProjectDescription, GALGAS_string ("PMDownloadData.h"), var_fileListOf_5F_APPLICATION_5F_UPDATE_5F_group, inCompiler  COMMA_SOURCE_FILE ("XcodeProjectGeneration.gSemantics", 1112)) ;
    }
    {
    routine_enter_5F_file_5F_in_5F_group (var_XcodeProjectDescription, GALGAS_string ("PMDownloadData.m"), var_fileListOf_5F_APPLICATION_5F_UPDATE_5F_group, inCompiler  COMMA_SOURCE_FILE ("XcodeProjectGeneration.gSemantics", 1113)) ;
    }
    {
    routine_enter_5F_file_5F_in_5F_group (var_XcodeProjectDescription, GALGAS_string ("PMDownloadFile.h"), var_fileListOf_5F_APPLICATION_5F_UPDATE_5F_group, inCompiler  COMMA_SOURCE_FILE ("XcodeProjectGeneration.gSemantics", 1114)) ;
    }
    {
    routine_enter_5F_file_5F_in_5F_group (var_XcodeProjectDescription, GALGAS_string ("PMDownloadFile.m"), var_fileListOf_5F_APPLICATION_5F_UPDATE_5F_group, inCompiler  COMMA_SOURCE_FILE ("XcodeProjectGeneration.gSemantics", 1115)) ;
    }
    {
    routine_enter_5F_file_5F_in_5F_group (var_XcodeProjectDescription, GALGAS_string ("PMSnowLeopardLionCompatibility.h"), var_fileListOf_5F_APPLICATION_5F_UPDATE_5F_group, inCompiler  COMMA_SOURCE_FILE ("XcodeProjectGeneration.gSemantics", 1116)) ;
    }
    {
    routine_enter_5F_group (var_XcodeProjectDescription, GALGAS_string ("Application Update"), GALGAS_string ("cocoa-application-update/application"), var_fileListOf_5F_APPLICATION_5F_UPDATE_5F_group, inCompiler  COMMA_SOURCE_FILE ("XcodeProjectGeneration.gSemantics", 1117)) ;
    }
    GALGAS_XcodeObjectReferenceList var_fileListOf_5F_UPDATER_5F_TOOL_5F_group = GALGAS_XcodeObjectReferenceList::constructor_emptyList (SOURCE_FILE ("XcodeProjectGeneration.gSemantics", 1124)) ;
    {
    routine_enter_5F_file_5F_in_5F_group (var_XcodeProjectDescription, GALGAS_string ("PMUpdaterServerObject.h"), var_fileListOf_5F_UPDATER_5F_TOOL_5F_group, inCompiler  COMMA_SOURCE_FILE ("XcodeProjectGeneration.gSemantics", 1125)) ;
    }
    {
    routine_enter_5F_file_5F_in_5F_group (var_XcodeProjectDescription, GALGAS_string ("PMUpdaterServerObject.m"), var_fileListOf_5F_UPDATER_5F_TOOL_5F_group, inCompiler  COMMA_SOURCE_FILE ("XcodeProjectGeneration.gSemantics", 1126)) ;
    }
    {
    routine_enter_5F_file_5F_in_5F_group (var_XcodeProjectDescription, GALGAS_string ("PMUpdaterServerProtocol.h"), var_fileListOf_5F_UPDATER_5F_TOOL_5F_group, inCompiler  COMMA_SOURCE_FILE ("XcodeProjectGeneration.gSemantics", 1127)) ;
    }
    {
    routine_enter_5F_file_5F_in_5F_group (var_XcodeProjectDescription, GALGAS_string ("updater-tool-Info.plist"), var_fileListOf_5F_UPDATER_5F_TOOL_5F_group, inCompiler  COMMA_SOURCE_FILE ("XcodeProjectGeneration.gSemantics", 1128)) ;
    }
    {
    routine_enter_5F_file_5F_in_5F_group (var_XcodeProjectDescription, GALGAS_string ("updater-tool-Launchd.plist"), var_fileListOf_5F_UPDATER_5F_TOOL_5F_group, inCompiler  COMMA_SOURCE_FILE ("XcodeProjectGeneration.gSemantics", 1129)) ;
    }
    {
    routine_enter_5F_file_5F_in_5F_group (var_XcodeProjectDescription, GALGAS_string ("updater-tool-main.m"), var_fileListOf_5F_UPDATER_5F_TOOL_5F_group, inCompiler  COMMA_SOURCE_FILE ("XcodeProjectGeneration.gSemantics", 1130)) ;
    }
    {
    routine_enter_5F_group (var_XcodeProjectDescription, GALGAS_string ("Updater Tool"), GALGAS_string ("cocoa-application-update/updater-tool"), var_fileListOf_5F_UPDATER_5F_TOOL_5F_group, inCompiler  COMMA_SOURCE_FILE ("XcodeProjectGeneration.gSemantics", 1131)) ;
    }
    GALGAS_XcodeObjectReferenceList var_fileListOf_5F_UPDATER_5F_APP_5F_group = GALGAS_XcodeObjectReferenceList::constructor_emptyList (SOURCE_FILE ("XcodeProjectGeneration.gSemantics", 1138)) ;
    {
    routine_enter_5F_file_5F_in_5F_group (var_XcodeProjectDescription, GALGAS_string ("PMUpdaterAppDelegate.h"), var_fileListOf_5F_UPDATER_5F_APP_5F_group, inCompiler  COMMA_SOURCE_FILE ("XcodeProjectGeneration.gSemantics", 1139)) ;
    }
    {
    routine_enter_5F_file_5F_in_5F_group (var_XcodeProjectDescription, GALGAS_string ("PMUpdaterAppDelegate.m"), var_fileListOf_5F_UPDATER_5F_APP_5F_group, inCompiler  COMMA_SOURCE_FILE ("XcodeProjectGeneration.gSemantics", 1140)) ;
    }
    {
    routine_enter_5F_file_5F_in_5F_group (var_XcodeProjectDescription, GALGAS_string ("updater-app-main.m"), var_fileListOf_5F_UPDATER_5F_APP_5F_group, inCompiler  COMMA_SOURCE_FILE ("XcodeProjectGeneration.gSemantics", 1141)) ;
    }
    {
    routine_enter_5F_file_5F_in_5F_group (var_XcodeProjectDescription, GALGAS_string ("updater-app-Prefix.pch"), var_fileListOf_5F_UPDATER_5F_APP_5F_group, inCompiler  COMMA_SOURCE_FILE ("XcodeProjectGeneration.gSemantics", 1142)) ;
    }
    {
    routine_enter_5F_xib_5F_file_5F_in_5F_group (var_XcodeProjectDescription, GALGAS_string ("English.lproj"), GALGAS_string ("UpdaterAppCredits.rtf"), var_fileListOf_5F_UPDATER_5F_APP_5F_group, inCompiler  COMMA_SOURCE_FILE ("XcodeProjectGeneration.gSemantics", 1143)) ;
    }
    {
    routine_enter_5F_xib_5F_file_5F_in_5F_group (var_XcodeProjectDescription, GALGAS_string ("English.lproj"), GALGAS_string ("UpdaterAppInfoPlist.strings"), var_fileListOf_5F_UPDATER_5F_APP_5F_group, inCompiler  COMMA_SOURCE_FILE ("XcodeProjectGeneration.gSemantics", 1149)) ;
    }
    {
    routine_enter_5F_xib_5F_file_5F_in_5F_group (var_XcodeProjectDescription, GALGAS_string ("English.lproj"), GALGAS_string ("UpdaterAppMainMenu.xib"), var_fileListOf_5F_UPDATER_5F_APP_5F_group, inCompiler  COMMA_SOURCE_FILE ("XcodeProjectGeneration.gSemantics", 1155)) ;
    }
    {
    routine_enter_5F_group (var_XcodeProjectDescription, GALGAS_string ("Updater Application"), GALGAS_string ("cocoa-application-update/updater-application"), var_fileListOf_5F_UPDATER_5F_APP_5F_group, inCompiler  COMMA_SOURCE_FILE ("XcodeProjectGeneration.gSemantics", 1161)) ;
    }
  }
  GALGAS_stringlist var_updaterApplicationDependencyList = GALGAS_stringlist::constructor_emptyList (SOURCE_FILE ("XcodeProjectGeneration.gSemantics", 1169)) ;
  const enumGalgasBool test_2 = var_handleUpdateFromInternet.boolEnum () ;
  if (kBoolTrue == test_2) {
    GALGAS_Xcode_5F_PBXBuildFile_5F_list var_listForSourceBuildPhaseOfUpdaterTool = GALGAS_Xcode_5F_PBXBuildFile_5F_list::constructor_emptyList (SOURCE_FILE ("XcodeProjectGeneration.gSemantics", 1173)) ;
    {
    routine_enter_5F_file_5F_for_5F_sources_5F_build_5F_phase (var_XcodeProjectDescription, GALGAS_string ("PMUpdaterServerObject.m"), var_listForSourceBuildPhaseOfUpdaterTool, inCompiler  COMMA_SOURCE_FILE ("XcodeProjectGeneration.gSemantics", 1174)) ;
    }
    {
    routine_enter_5F_file_5F_for_5F_sources_5F_build_5F_phase (var_XcodeProjectDescription, GALGAS_string ("updater-tool-main.m"), var_listForSourceBuildPhaseOfUpdaterTool, inCompiler  COMMA_SOURCE_FILE ("XcodeProjectGeneration.gSemantics", 1175)) ;
    }
    GALGAS_Xcode_5F_PBXBuildFile_5F_list var_frameworkList = GALGAS_Xcode_5F_PBXBuildFile_5F_list::constructor_emptyList (SOURCE_FILE ("XcodeProjectGeneration.gSemantics", 1177)) ;
    {
    routine_enter_5F_files_5F_for_5F_frameworks_5F_build_5F_phase (var_XcodeProjectDescription, GALGAS_stringlist::constructor_listWithValue (GALGAS_string ("Foundation.framework")  COMMA_SOURCE_FILE ("XcodeProjectGeneration.gSemantics", 1180)), var_frameworkList, inCompiler  COMMA_SOURCE_FILE ("XcodeProjectGeneration.gSemantics", 1178)) ;
    }
    GALGAS_stringlist var_updaterToolTargetSettings = GALGAS_stringlist::constructor_emptyList (SOURCE_FILE ("XcodeProjectGeneration.gSemantics", 1184)) ;
    var_updaterToolTargetSettings.addAssign_operation (GALGAS_string ("GCC_OPTIMIZATION_LEVEL = 2;")  COMMA_SOURCE_FILE ("XcodeProjectGeneration.gSemantics", 1185)) ;
    var_updaterToolTargetSettings.addAssign_operation (GALGAS_string ("GCC_ENABLE_OBJC_GC = Unsupported;")  COMMA_SOURCE_FILE ("XcodeProjectGeneration.gSemantics", 1186)) ;
    var_updaterToolTargetSettings.addAssign_operation (GALGAS_string ("GCC_WARN_UNUSED_PARAMETER = NO ;")  COMMA_SOURCE_FILE ("XcodeProjectGeneration.gSemantics", 1187)) ;
    var_updaterToolTargetSettings.addAssign_operation (GALGAS_string ("OTHER_LDFLAGS = \"-sectcreate __TEXT __info_plist cocoa-application-update/updater-tool/updater-tool-Info.plist -sectcreate __TEXT __launchd_plist cocoa"
      "-application-update/updater-tool/updater-tool-Launchd.plist\" ;")  COMMA_SOURCE_FILE ("XcodeProjectGeneration.gSemantics", 1188)) ;
    GALGAS_string var_updaterToolTargetKey ;
    {
    routine_add_5F_tool_5F_target (var_XcodeProjectDescription, var_bundleBaseName.operator_concat (GALGAS_string (".")  COMMA_SOURCE_FILE ("XcodeProjectGeneration.gSemantics", 1193)).operator_concat (constinArgument_inProjectName  COMMA_SOURCE_FILE ("XcodeProjectGeneration.gSemantics", 1193)).operator_concat (GALGAS_string (".updaterTool")  COMMA_SOURCE_FILE ("XcodeProjectGeneration.gSemantics", 1193)), var_bundleBaseName.operator_concat (GALGAS_string (".")  COMMA_SOURCE_FILE ("XcodeProjectGeneration.gSemantics", 1194)).operator_concat (constinArgument_inProjectName  COMMA_SOURCE_FILE ("XcodeProjectGeneration.gSemantics", 1194)).operator_concat (GALGAS_string (".updaterTool")  COMMA_SOURCE_FILE ("XcodeProjectGeneration.gSemantics", 1194)), var_updaterToolTargetSettings, GALGAS_string::makeEmptyString (), var_listForSourceBuildPhaseOfUpdaterTool, var_frameworkList, GALGAS_stringlist::constructor_emptyList (SOURCE_FILE ("XcodeProjectGeneration.gSemantics", 1199)), var_updaterToolTargetKey, inCompiler  COMMA_SOURCE_FILE ("XcodeProjectGeneration.gSemantics", 1191)) ;
    }
    var_updaterApplicationDependencyList.addAssign_operation (var_updaterToolTargetKey  COMMA_SOURCE_FILE ("XcodeProjectGeneration.gSemantics", 1202)) ;
  }
  GALGAS_stringlist var_CocoaApplicationDependencyList = GALGAS_stringlist::constructor_emptyList (SOURCE_FILE ("XcodeProjectGeneration.gSemantics", 1205)) ;
  const enumGalgasBool test_3 = var_handleUpdateFromInternet.boolEnum () ;
  if (kBoolTrue == test_3) {
    GALGAS_stringlist var_updaterAppTargetSettings = GALGAS_stringlist::constructor_emptyList (SOURCE_FILE ("XcodeProjectGeneration.gSemantics", 1208)) ;
    var_updaterAppTargetSettings.addAssign_operation (GALGAS_string ("GCC_OPTIMIZATION_LEVEL = 2;")  COMMA_SOURCE_FILE ("XcodeProjectGeneration.gSemantics", 1209)) ;
    GALGAS_Xcode_5F_PBXBuildFile_5F_list var_frameworkList = GALGAS_Xcode_5F_PBXBuildFile_5F_list::constructor_emptyList (SOURCE_FILE ("XcodeProjectGeneration.gSemantics", 1211)) ;
    GALGAS_stringlist var_theList = GALGAS_stringlist::constructor_emptyList (SOURCE_FILE ("XcodeProjectGeneration.gSemantics", 1212)) ;
    var_theList.addAssign_operation (GALGAS_string ("Cocoa.framework")  COMMA_SOURCE_FILE ("XcodeProjectGeneration.gSemantics", 1213)) ;
    var_theList.addAssign_operation (GALGAS_string ("Security.framework")  COMMA_SOURCE_FILE ("XcodeProjectGeneration.gSemantics", 1214)) ;
    var_theList.addAssign_operation (GALGAS_string ("ServiceManagement.framework")  COMMA_SOURCE_FILE ("XcodeProjectGeneration.gSemantics", 1215)) ;
    {
    routine_enter_5F_files_5F_for_5F_frameworks_5F_build_5F_phase (var_XcodeProjectDescription, var_theList, var_frameworkList, inCompiler  COMMA_SOURCE_FILE ("XcodeProjectGeneration.gSemantics", 1216)) ;
    }
    GALGAS_Xcode_5F_PBXBuildFile_5F_list var_listForSourceBuildPhaseOfUpdaterApp = GALGAS_Xcode_5F_PBXBuildFile_5F_list::constructor_emptyList (SOURCE_FILE ("XcodeProjectGeneration.gSemantics", 1222)) ;
    {
    routine_enter_5F_file_5F_for_5F_sources_5F_build_5F_phase (var_XcodeProjectDescription, GALGAS_string ("PMUpdaterAppDelegate.m"), var_listForSourceBuildPhaseOfUpdaterApp, inCompiler  COMMA_SOURCE_FILE ("XcodeProjectGeneration.gSemantics", 1223)) ;
    }
    {
    routine_enter_5F_file_5F_for_5F_sources_5F_build_5F_phase (var_XcodeProjectDescription, GALGAS_string ("updater-app-main.m"), var_listForSourceBuildPhaseOfUpdaterApp, inCompiler  COMMA_SOURCE_FILE ("XcodeProjectGeneration.gSemantics", 1224)) ;
    }
    GALGAS_Xcode_5F_PBXBuildFile_5F_list var_listForResourcesBuildPhaseOfUpdaterApp = GALGAS_Xcode_5F_PBXBuildFile_5F_list::constructor_emptyList (SOURCE_FILE ("XcodeProjectGeneration.gSemantics", 1226)) ;
    GALGAS_stringlist var_fileList = GALGAS_stringlist::constructor_emptyList (SOURCE_FILE ("XcodeProjectGeneration.gSemantics", 1227)) ;
    var_fileList.addAssign_operation (GALGAS_string ("UpdaterAppMainMenu.xib")  COMMA_SOURCE_FILE ("XcodeProjectGeneration.gSemantics", 1228)) ;
    var_fileList.addAssign_operation (GALGAS_string ("UpdaterAppInfoPlist.strings")  COMMA_SOURCE_FILE ("XcodeProjectGeneration.gSemantics", 1229)) ;
    var_fileList.addAssign_operation (GALGAS_string ("UpdaterAppCredits.rtf")  COMMA_SOURCE_FILE ("XcodeProjectGeneration.gSemantics", 1230)) ;
    {
    routine_enter_5F_files_5F_for_5F_frameworks_5F_build_5F_phase (var_XcodeProjectDescription, var_fileList, var_listForResourcesBuildPhaseOfUpdaterApp, inCompiler  COMMA_SOURCE_FILE ("XcodeProjectGeneration.gSemantics", 1231)) ;
    }
    GALGAS_string var_updaterAppTargetKey ;
    {
    routine_add_5F_app_5F_target (var_XcodeProjectDescription, var_bundleBaseName.operator_concat (GALGAS_string (".")  COMMA_SOURCE_FILE ("XcodeProjectGeneration.gSemantics", 1240)).operator_concat (constinArgument_inProjectName  COMMA_SOURCE_FILE ("XcodeProjectGeneration.gSemantics", 1240)).operator_concat (GALGAS_string (".updaterApp")  COMMA_SOURCE_FILE ("XcodeProjectGeneration.gSemantics", 1240)), var_bundleBaseName.operator_concat (GALGAS_string (".")  COMMA_SOURCE_FILE ("XcodeProjectGeneration.gSemantics", 1241)).operator_concat (constinArgument_inProjectName  COMMA_SOURCE_FILE ("XcodeProjectGeneration.gSemantics", 1241)).operator_concat (GALGAS_string (".updaterApp")  COMMA_SOURCE_FILE ("XcodeProjectGeneration.gSemantics", 1241)), var_updaterAppTargetSettings, GALGAS_string ("cocoa-application-update/updater-application/updater-app-Prefix.pch"), GALGAS_string ("cocoa-application-update/updater-application/updater-app-Info.plist"), var_listForSourceBuildPhaseOfUpdaterApp, var_frameworkList, var_listForResourcesBuildPhaseOfUpdaterApp, var_updaterApplicationDependencyList, var_bundleBaseName.operator_concat (GALGAS_string (".")  COMMA_SOURCE_FILE ("XcodeProjectGeneration.gSemantics", 1249)).operator_concat (constinArgument_inProjectName  COMMA_SOURCE_FILE ("XcodeProjectGeneration.gSemantics", 1249)).operator_concat (GALGAS_string (".updaterTool")  COMMA_SOURCE_FILE ("XcodeProjectGeneration.gSemantics", 1249)), var_updaterAppTargetKey, inCompiler  COMMA_SOURCE_FILE ("XcodeProjectGeneration.gSemantics", 1238)) ;
    }
    var_CocoaApplicationDependencyList.addAssign_operation (var_updaterAppTargetKey  COMMA_SOURCE_FILE ("XcodeProjectGeneration.gSemantics", 1252)) ;
  }
  GALGAS_Xcode_5F_PBXBuildFile_5F_list var_listForSourceBuildPhaseOfTool = GALGAS_Xcode_5F_PBXBuildFile_5F_list::constructor_emptyList (SOURCE_FILE ("XcodeProjectGeneration.gSemantics", 1255)) ;
  {
  routine_build_5F_HAND_5F_CODED_5F_source_5F_files_5F_for_5F_sources_5F_tool_5F_build_5F_phase (var_XcodeProjectDescription, constinArgument_inExternSourceNameSet_5F_tool, var_listForSourceBuildPhaseOfTool, inCompiler  COMMA_SOURCE_FILE ("XcodeProjectGeneration.gSemantics", 1257)) ;
  }
  {
  routine_build_5F_GENERATED_5F_BY_5F_GALGAS_5F_files_5F_for_5F_sources_5F_build_5F_phase (var_XcodeProjectDescription, constinArgument_inSourceFileSetForTool, var_listForSourceBuildPhaseOfTool, inCompiler  COMMA_SOURCE_FILE ("XcodeProjectGeneration.gSemantics", 1263)) ;
  }
  {
  routine_build_5F_LIBPM_5F_BDD_5F_source_5F_files_5F_for_5F_sources_5F_build_5F_phase (var_XcodeProjectDescription, var_listForSourceBuildPhaseOfTool, inCompiler  COMMA_SOURCE_FILE ("XcodeProjectGeneration.gSemantics", 1269)) ;
  }
  {
  routine_build_5F_LIBPM_5F_COMMAND_5F_LINE_5F_INTERFACE_5F_files_5F_for_5F_sources_5F_build_5F_phase (var_XcodeProjectDescription, var_listForSourceBuildPhaseOfTool, inCompiler  COMMA_SOURCE_FILE ("XcodeProjectGeneration.gSemantics", 1274)) ;
  }
  {
  routine_build_5F_LIBPM_5F_FILES_5F_files_5F_for_5F_sources_5F_build_5F_phase (var_XcodeProjectDescription, var_listForSourceBuildPhaseOfTool, inCompiler  COMMA_SOURCE_FILE ("XcodeProjectGeneration.gSemantics", 1279)) ;
  }
  {
  routine_build_5F_LIBPM_5F_GALGAS_5F__32__5F_files_5F_for_5F_sources_5F_build_5F_phase (var_XcodeProjectDescription, var_listForSourceBuildPhaseOfTool, inCompiler  COMMA_SOURCE_FILE ("XcodeProjectGeneration.gSemantics", 1284)) ;
  }
  {
  routine_build_5F_LIBPM_5F_STREAMS_5F_files_5F_for_5F_sources_5F_build_5F_phase (var_XcodeProjectDescription, var_listForSourceBuildPhaseOfTool, inCompiler  COMMA_SOURCE_FILE ("XcodeProjectGeneration.gSemantics", 1289)) ;
  }
  {
  routine_build_5F_LIBPM_5F_TIME_5F_files_5F_for_5F_sources_5F_build_5F_phase (var_XcodeProjectDescription, var_listForSourceBuildPhaseOfTool, inCompiler  COMMA_SOURCE_FILE ("XcodeProjectGeneration.gSemantics", 1294)) ;
  }
  {
  routine_build_5F_LIBPM_5F_UTILITIES_5F_files_5F_for_5F_sources_5F_build_5F_phase (var_XcodeProjectDescription, var_listForSourceBuildPhaseOfTool, inCompiler  COMMA_SOURCE_FILE ("XcodeProjectGeneration.gSemantics", 1299)) ;
  }
  {
  routine_build_5F_LIBPM_5F_STRINGS_5F_files_5F_for_5F_sources_5F_build_5F_phase (var_XcodeProjectDescription, var_listForSourceBuildPhaseOfTool, inCompiler  COMMA_SOURCE_FILE ("XcodeProjectGeneration.gSemantics", 1304)) ;
  }
  GALGAS_Xcode_5F_PBXBuildFile_5F_list var_listForFrameworksBuildPhaseOfTool = GALGAS_Xcode_5F_PBXBuildFile_5F_list::constructor_emptyList (SOURCE_FILE ("XcodeProjectGeneration.gSemantics", 1309)) ;
  {
  routine_build_5F_FRAMEWORKS_5F_for_5F_frameworks_5F_build_5F_phase (var_XcodeProjectDescription, constinArgument_inExternSourceNameSet_5F_tool, var_listForFrameworksBuildPhaseOfTool, inCompiler  COMMA_SOURCE_FILE ("XcodeProjectGeneration.gSemantics", 1310)) ;
  }
  GALGAS_stringlist var_toolTargetSettings = GALGAS_stringlist::constructor_emptyList (SOURCE_FILE ("XcodeProjectGeneration.gSemantics", 1316)) ;
  var_toolTargetSettings.addAssign_operation (GALGAS_string ("GCC_OPTIMIZATION_LEVEL = 2;")  COMMA_SOURCE_FILE ("XcodeProjectGeneration.gSemantics", 1317)) ;
  GALGAS_string temp_4 ;
  const enumGalgasBool test_5 = constinArgument_inMultiThreadingEnabled.boolEnum () ;
  if (kBoolTrue == test_5) {
    temp_4 = GALGAS_string ("1") ;
  }else if (kBoolFalse == test_5) {
    temp_4 = GALGAS_string ("0") ;
  }
  var_toolTargetSettings.addAssign_operation (GALGAS_string ("GCC_PREPROCESSOR_DEFINITIONS = \"LIBPM_MULTI_THREADING=").add_operation (temp_4, inCompiler COMMA_SOURCE_FILE ("XcodeProjectGeneration.gSemantics", 1319)).operator_concat (GALGAS_string ("\" \"DO_NOT_GENERATE_CHECKINGS\"").add_operation (GALGAS_string (";"), inCompiler COMMA_SOURCE_FILE ("XcodeProjectGeneration.gSemantics", 1320))  COMMA_SOURCE_FILE ("XcodeProjectGeneration.gSemantics", 1319))  COMMA_SOURCE_FILE ("XcodeProjectGeneration.gSemantics", 1318)) ;
  GALGAS_string var_toolTargetKey ;
  {
  routine_add_5F_tool_5F_target (var_XcodeProjectDescription, constinArgument_inProjectName, constinArgument_inProjectName.reader_stringByCapitalizingFirstCharacter (SOURCE_FILE ("XcodeProjectGeneration.gSemantics", 1327)).operator_concat (GALGAS_string (" Tool")  COMMA_SOURCE_FILE ("XcodeProjectGeneration.gSemantics", 1327)), var_toolTargetSettings, GALGAS_string::makeEmptyString (), var_listForSourceBuildPhaseOfTool, var_listForFrameworksBuildPhaseOfTool, GALGAS_stringlist::constructor_emptyList (SOURCE_FILE ("XcodeProjectGeneration.gSemantics", 1332)), var_toolTargetKey, inCompiler  COMMA_SOURCE_FILE ("XcodeProjectGeneration.gSemantics", 1324)) ;
  }
  GALGAS_Xcode_5F_PBXBuildFile_5F_list var_listForSourceBuildPhaseOfDebugTool = GALGAS_Xcode_5F_PBXBuildFile_5F_list::constructor_emptyList (SOURCE_FILE ("XcodeProjectGeneration.gSemantics", 1336)) ;
  {
  routine_build_5F_HAND_5F_CODED_5F_source_5F_files_5F_for_5F_sources_5F_tool_5F_build_5F_phase (var_XcodeProjectDescription, constinArgument_inExternSourceNameSet_5F_tool, var_listForSourceBuildPhaseOfDebugTool, inCompiler  COMMA_SOURCE_FILE ("XcodeProjectGeneration.gSemantics", 1338)) ;
  }
  {
  routine_build_5F_GENERATED_5F_BY_5F_GALGAS_5F_files_5F_for_5F_sources_5F_build_5F_phase (var_XcodeProjectDescription, constinArgument_inSourceFileSetForTool, var_listForSourceBuildPhaseOfDebugTool, inCompiler  COMMA_SOURCE_FILE ("XcodeProjectGeneration.gSemantics", 1344)) ;
  }
  {
  routine_build_5F_LIBPM_5F_BDD_5F_source_5F_files_5F_for_5F_sources_5F_build_5F_phase (var_XcodeProjectDescription, var_listForSourceBuildPhaseOfDebugTool, inCompiler  COMMA_SOURCE_FILE ("XcodeProjectGeneration.gSemantics", 1350)) ;
  }
  {
  routine_build_5F_LIBPM_5F_COMMAND_5F_LINE_5F_INTERFACE_5F_files_5F_for_5F_sources_5F_build_5F_phase (var_XcodeProjectDescription, var_listForSourceBuildPhaseOfDebugTool, inCompiler  COMMA_SOURCE_FILE ("XcodeProjectGeneration.gSemantics", 1355)) ;
  }
  {
  routine_build_5F_LIBPM_5F_FILES_5F_files_5F_for_5F_sources_5F_build_5F_phase (var_XcodeProjectDescription, var_listForSourceBuildPhaseOfDebugTool, inCompiler  COMMA_SOURCE_FILE ("XcodeProjectGeneration.gSemantics", 1360)) ;
  }
  {
  routine_build_5F_LIBPM_5F_GALGAS_5F__32__5F_files_5F_for_5F_sources_5F_build_5F_phase (var_XcodeProjectDescription, var_listForSourceBuildPhaseOfDebugTool, inCompiler  COMMA_SOURCE_FILE ("XcodeProjectGeneration.gSemantics", 1365)) ;
  }
  {
  routine_build_5F_LIBPM_5F_STREAMS_5F_files_5F_for_5F_sources_5F_build_5F_phase (var_XcodeProjectDescription, var_listForSourceBuildPhaseOfDebugTool, inCompiler  COMMA_SOURCE_FILE ("XcodeProjectGeneration.gSemantics", 1370)) ;
  }
  {
  routine_build_5F_LIBPM_5F_TIME_5F_files_5F_for_5F_sources_5F_build_5F_phase (var_XcodeProjectDescription, var_listForSourceBuildPhaseOfDebugTool, inCompiler  COMMA_SOURCE_FILE ("XcodeProjectGeneration.gSemantics", 1375)) ;
  }
  {
  routine_build_5F_LIBPM_5F_UTILITIES_5F_files_5F_for_5F_sources_5F_build_5F_phase (var_XcodeProjectDescription, var_listForSourceBuildPhaseOfDebugTool, inCompiler  COMMA_SOURCE_FILE ("XcodeProjectGeneration.gSemantics", 1380)) ;
  }
  {
  routine_build_5F_LIBPM_5F_STRINGS_5F_files_5F_for_5F_sources_5F_build_5F_phase (var_XcodeProjectDescription, var_listForSourceBuildPhaseOfDebugTool, inCompiler  COMMA_SOURCE_FILE ("XcodeProjectGeneration.gSemantics", 1385)) ;
  }
  GALGAS_Xcode_5F_PBXBuildFile_5F_list var_listForFrameworksBuildPhaseOfToolDebug = GALGAS_Xcode_5F_PBXBuildFile_5F_list::constructor_emptyList (SOURCE_FILE ("XcodeProjectGeneration.gSemantics", 1390)) ;
  {
  routine_build_5F_FRAMEWORKS_5F_for_5F_frameworks_5F_build_5F_phase (var_XcodeProjectDescription, constinArgument_inExternSourceNameSet_5F_tool, var_listForFrameworksBuildPhaseOfToolDebug, inCompiler  COMMA_SOURCE_FILE ("XcodeProjectGeneration.gSemantics", 1391)) ;
  }
  GALGAS_stringlist var_debugToolTargetSettings = GALGAS_stringlist::constructor_emptyList (SOURCE_FILE ("XcodeProjectGeneration.gSemantics", 1397)) ;
  var_debugToolTargetSettings.addAssign_operation (GALGAS_string ("GCC_GENERATE_DEBUGGING_SYMBOLS = YES;")  COMMA_SOURCE_FILE ("XcodeProjectGeneration.gSemantics", 1398)) ;
  var_debugToolTargetSettings.addAssign_operation (GALGAS_string ("GCC_OPTIMIZATION_LEVEL = 0;")  COMMA_SOURCE_FILE ("XcodeProjectGeneration.gSemantics", 1399)) ;
  var_debugToolTargetSettings.addAssign_operation (GALGAS_string ("GCC_WARN_UNINITIALIZED_AUTOS = NO;")  COMMA_SOURCE_FILE ("XcodeProjectGeneration.gSemantics", 1400)) ;
  GALGAS_string temp_6 ;
  const enumGalgasBool test_7 = constinArgument_inMultiThreadingEnabled.boolEnum () ;
  if (kBoolTrue == test_7) {
    temp_6 = GALGAS_string ("1") ;
  }else if (kBoolFalse == test_7) {
    temp_6 = GALGAS_string ("0") ;
  }
  var_debugToolTargetSettings.addAssign_operation (GALGAS_string ("GCC_PREPROCESSOR_DEFINITIONS = \"LIBPM_MULTI_THREADING=").operator_concat (temp_6  COMMA_SOURCE_FILE ("XcodeProjectGeneration.gSemantics", 1402)).operator_concat (GALGAS_string ("\";")  COMMA_SOURCE_FILE ("XcodeProjectGeneration.gSemantics", 1402))  COMMA_SOURCE_FILE ("XcodeProjectGeneration.gSemantics", 1401)) ;
  GALGAS_string var_toolDebugTargetKey ;
  {
  routine_add_5F_tool_5F_target (var_XcodeProjectDescription, constinArgument_inProjectName.operator_concat (GALGAS_string ("_debug")  COMMA_SOURCE_FILE ("XcodeProjectGeneration.gSemantics", 1407)), constinArgument_inProjectName.reader_stringByCapitalizingFirstCharacter (SOURCE_FILE ("XcodeProjectGeneration.gSemantics", 1408)).operator_concat (GALGAS_string (" Tool Debug")  COMMA_SOURCE_FILE ("XcodeProjectGeneration.gSemantics", 1408)), var_debugToolTargetSettings, GALGAS_string::makeEmptyString (), var_listForSourceBuildPhaseOfDebugTool, var_listForFrameworksBuildPhaseOfToolDebug, GALGAS_stringlist::constructor_emptyList (SOURCE_FILE ("XcodeProjectGeneration.gSemantics", 1413)), var_toolDebugTargetKey, inCompiler  COMMA_SOURCE_FILE ("XcodeProjectGeneration.gSemantics", 1405)) ;
  }
  GALGAS_Xcode_5F_PBXBuildFile_5F_list var_listForSourceBuildPhaseOfCocoaApp = GALGAS_Xcode_5F_PBXBuildFile_5F_list::constructor_emptyList (SOURCE_FILE ("XcodeProjectGeneration.gSemantics", 1418)) ;
  {
  routine_build_5F_COCOA_5F_APP_5F_files_5F_for_5F_sources_5F_build_5F_phase (var_XcodeProjectDescription, constinArgument_inGUISourceNameSet_5F_app.operator_or (constinArgument_inExternSourceNameSet_5F_app COMMA_SOURCE_FILE ("XcodeProjectGeneration.gSemantics", 1421)), var_handleUpdateFromInternet, var_listForSourceBuildPhaseOfCocoaApp, inCompiler  COMMA_SOURCE_FILE ("XcodeProjectGeneration.gSemantics", 1419)) ;
  }
  GALGAS_Xcode_5F_PBXBuildFile_5F_list var_listForFrameworksBuildPhaseOfCocoaApp = GALGAS_Xcode_5F_PBXBuildFile_5F_list::constructor_emptyList (SOURCE_FILE ("XcodeProjectGeneration.gSemantics", 1426)) ;
  var_fileSet = GALGAS_stringset::constructor_setWithStringList (constinArgument_inHandCodedLinkAppFileList  COMMA_SOURCE_FILE ("XcodeProjectGeneration.gSemantics", 1427)) ;
  var_fileSet.addAssign_operation (GALGAS_string ("AppKit.framework")  COMMA_SOURCE_FILE ("XcodeProjectGeneration.gSemantics", 1428)) ;
  var_fileSet.addAssign_operation (GALGAS_string ("Cocoa.framework")  COMMA_SOURCE_FILE ("XcodeProjectGeneration.gSemantics", 1429)) ;
  const enumGalgasBool test_8 = var_handleUpdateFromInternet.boolEnum () ;
  if (kBoolTrue == test_8) {
    var_fileSet.addAssign_operation (GALGAS_string ("WebKit.framework")  COMMA_SOURCE_FILE ("XcodeProjectGeneration.gSemantics", 1431)) ;
  }
  {
  routine_build_5F_FRAMEWORKS_5F_for_5F_frameworks_5F_build_5F_phase (var_XcodeProjectDescription, var_fileSet, var_listForFrameworksBuildPhaseOfCocoaApp, inCompiler  COMMA_SOURCE_FILE ("XcodeProjectGeneration.gSemantics", 1433)) ;
  }
  GALGAS_Xcode_5F_PBXBuildFile_5F_list var_listForResourcesBuildPhaseOfCocoaApp = GALGAS_Xcode_5F_PBXBuildFile_5F_list::constructor_emptyList (SOURCE_FILE ("XcodeProjectGeneration.gSemantics", 1439)) ;
  {
  routine_build_5F_RESOURCES_5F_for_5F_resources_5F_build_5F_phase (var_XcodeProjectDescription, var_bundleBaseName, constinArgument_inProjectName, constinArgument_inResourceFiles, var_handleUpdateFromInternet, var_listForResourcesBuildPhaseOfCocoaApp, inCompiler  COMMA_SOURCE_FILE ("XcodeProjectGeneration.gSemantics", 1440)) ;
  }
  {
  routine_build_5F_HAND_5F_CODED_5F_source_5F_files_5F_for_5F_sources_5F_cocoa_5F_build_5F_phase (var_XcodeProjectDescription, constinArgument_inExternSourceNameSet_5F_app, var_listForResourcesBuildPhaseOfCocoaApp, inCompiler  COMMA_SOURCE_FILE ("XcodeProjectGeneration.gSemantics", 1449)) ;
  }
  var_CocoaApplicationDependencyList.addAssign_operation (var_toolTargetKey  COMMA_SOURCE_FILE ("XcodeProjectGeneration.gSemantics", 1455)) ;
  var_CocoaApplicationDependencyList.addAssign_operation (var_toolDebugTargetKey  COMMA_SOURCE_FILE ("XcodeProjectGeneration.gSemantics", 1456)) ;
  GALGAS_stringlist var_cocoaAppTargetSettings = GALGAS_stringlist::constructor_emptyList (SOURCE_FILE ("XcodeProjectGeneration.gSemantics", 1458)) ;
  var_cocoaAppTargetSettings.addAssign_operation (GALGAS_string ("GCC_OPTIMIZATION_LEVEL = 2;")  COMMA_SOURCE_FILE ("XcodeProjectGeneration.gSemantics", 1459)) ;
  const enumGalgasBool test_9 = var_handleUpdateFromInternet.boolEnum () ;
  if (kBoolTrue == test_9) {
    var_cocoaAppTargetSettings.addAssign_operation (GALGAS_string ("GCC_PREPROCESSOR_DEFINITIONS = \"PM_HANDLE_UPDATE\";")  COMMA_SOURCE_FILE ("XcodeProjectGeneration.gSemantics", 1461)) ;
  }
  {
  GALGAS_string joker_49607_0 ; // Joker input parameter
  routine_add_5F_app_5F_target (var_XcodeProjectDescription, GALGAS_string ("Cocoa").operator_concat (constinArgument_inProjectName.reader_stringByCapitalizingFirstCharacter (SOURCE_FILE ("XcodeProjectGeneration.gSemantics", 1466))  COMMA_SOURCE_FILE ("XcodeProjectGeneration.gSemantics", 1466)), constinArgument_inProjectName.reader_stringByCapitalizingFirstCharacter (SOURCE_FILE ("XcodeProjectGeneration.gSemantics", 1467)).operator_concat (GALGAS_string (" Cocoa")  COMMA_SOURCE_FILE ("XcodeProjectGeneration.gSemantics", 1467)), var_cocoaAppTargetSettings, constinArgument_inLIBPMpath.operator_concat (GALGAS_string ("/cocoa_galgas/PP_CocoaGalgasPrefix.pch")  COMMA_SOURCE_FILE ("XcodeProjectGeneration.gSemantics", 1469)), GALGAS_string ("Info.plist"), var_listForSourceBuildPhaseOfCocoaApp, var_listForFrameworksBuildPhaseOfCocoaApp, var_listForResourcesBuildPhaseOfCocoaApp, var_CocoaApplicationDependencyList, GALGAS_string::makeEmptyString (), joker_49607_0, inCompiler  COMMA_SOURCE_FILE ("XcodeProjectGeneration.gSemantics", 1464)) ;
  }
  GALGAS_stringlist var_pathes = GALGAS_stringlist::constructor_emptyList (SOURCE_FILE ("XcodeProjectGeneration.gSemantics", 1479)) ;
  var_pathes.addAssign_operation (constinArgument_inGeneratedByGalgasSourcePath  COMMA_SOURCE_FILE ("XcodeProjectGeneration.gSemantics", 1480)) ;
  var_pathes.addAssign_operation (constinArgument_inLIBPMpath  COMMA_SOURCE_FILE ("XcodeProjectGeneration.gSemantics", 1481)) ;
  const enumGalgasBool test_10 = GALGAS_bool (kIsNotEqual, constinArgument_inAdditionalPathForTool.objectCompare (GALGAS_string::makeEmptyString ())).boolEnum () ;
  if (kBoolTrue == test_10) {
    var_pathes.addAssign_operation (constinArgument_inAdditionalPathForTool  COMMA_SOURCE_FILE ("XcodeProjectGeneration.gSemantics", 1483)) ;
  }
  const enumGalgasBool test_11 = GALGAS_bool (kIsStrictSup, var_fileSet.reader_count (SOURCE_FILE ("XcodeProjectGeneration.gSemantics", 1485)).objectCompare (GALGAS_uint ((uint32_t) 0U))).boolEnum () ;
  if (kBoolTrue == test_11) {
    var_pathes.addAssign_operation (GALGAS_string ("../hand_coded_sources/**")  COMMA_SOURCE_FILE ("XcodeProjectGeneration.gSemantics", 1486)) ;
  }
  GALGAS_stringlist var_projectDefaultSettings ;
  {
  routine_enterProjectDefaultSettings (var_pathes, constinArgument_inSDK, var_projectDefaultSettings, constinArgument_inUsesARC, inCompiler  COMMA_SOURCE_FILE ("XcodeProjectGeneration.gSemantics", 1490)) ;
  }
  var_projectDefaultSettings.addAssign_operation (GALGAS_string ("COPY_PHASE_STRIP = NO ;")  COMMA_SOURCE_FILE ("XcodeProjectGeneration.gSemantics", 1496)) ;
  const cMapElement_projectQualifiedFeatureMap * objectArray_50213 = (const cMapElement_projectQualifiedFeatureMap *) constinArgument_inProjectQualifiedFeatureMap.readAccessForWithInstruction (GALGAS_string ("codeSigning")) ;
  if (NULL != objectArray_50213) {
      macroValidSharedObject (objectArray_50213, cMapElement_projectQualifiedFeatureMap) ;
    var_projectDefaultSettings.addAssign_operation (GALGAS_string ("CODE_SIGN_IDENTITY = \"").operator_concat (objectArray_50213->mAttribute_mFeatureValue.reader_string (SOURCE_FILE ("XcodeProjectGeneration.gSemantics", 1499))  COMMA_SOURCE_FILE ("XcodeProjectGeneration.gSemantics", 1499)).operator_concat (GALGAS_string ("\";")  COMMA_SOURCE_FILE ("XcodeProjectGeneration.gSemantics", 1499))  COMMA_SOURCE_FILE ("XcodeProjectGeneration.gSemantics", 1499)) ;
  }
  {
  routine_generateXCodeFile (var_XcodeProjectDescription, constinArgument_in_5F_xcodeproj_5F_filePath, var_projectDefaultSettings, constinArgument_inReferenceFilePath, inCompiler  COMMA_SOURCE_FILE ("XcodeProjectGeneration.gSemantics", 1503)) ;
  }
}


//---------------------------------------------------------------------------------------------------------------------*

GALGAS_projectQualifiedFeatureMap_2D_element::GALGAS_projectQualifiedFeatureMap_2D_element (void) :
mAttribute_lkey (),
mAttribute_mFeatureValue () {
}

//---------------------------------------------------------------------------------------------------------------------*

GALGAS_projectQualifiedFeatureMap_2D_element::~ GALGAS_projectQualifiedFeatureMap_2D_element (void) {
}

//---------------------------------------------------------------------------------------------------------------------*

GALGAS_projectQualifiedFeatureMap_2D_element::GALGAS_projectQualifiedFeatureMap_2D_element (const GALGAS_lstring & inOperand0,
                                                                                            const GALGAS_lstring & inOperand1) :
mAttribute_lkey (inOperand0),
mAttribute_mFeatureValue (inOperand1) {
}

//---------------------------------------------------------------------------------------------------------------------*

GALGAS_projectQualifiedFeatureMap_2D_element GALGAS_projectQualifiedFeatureMap_2D_element::constructor_default (UNUSED_LOCATION_ARGS) {
  return GALGAS_projectQualifiedFeatureMap_2D_element (GALGAS_lstring::constructor_default (HERE),
                                                       GALGAS_lstring::constructor_default (HERE)) ;
}

//---------------------------------------------------------------------------------------------------------------------*

GALGAS_projectQualifiedFeatureMap_2D_element GALGAS_projectQualifiedFeatureMap_2D_element::constructor_new (const GALGAS_lstring & inOperand0,
                                                                                                            const GALGAS_lstring & inOperand1 
                                                                                                            COMMA_UNUSED_LOCATION_ARGS) {
  GALGAS_projectQualifiedFeatureMap_2D_element result ;
  if (inOperand0.isValid () && inOperand1.isValid ()) {
    result = GALGAS_projectQualifiedFeatureMap_2D_element (inOperand0, inOperand1) ;
  }
  return result ;
}

//---------------------------------------------------------------------------------------------------------------------*

typeComparisonResult GALGAS_projectQualifiedFeatureMap_2D_element::objectCompare (const GALGAS_projectQualifiedFeatureMap_2D_element & inOperand) const {
   typeComparisonResult result = kOperandEqual ;
  if (result == kOperandEqual) {
    result = mAttribute_lkey.objectCompare (inOperand.mAttribute_lkey) ;
  }
  if (result == kOperandEqual) {
    result = mAttribute_mFeatureValue.objectCompare (inOperand.mAttribute_mFeatureValue) ;
  }
  return result ;
}

//---------------------------------------------------------------------------------------------------------------------*

bool GALGAS_projectQualifiedFeatureMap_2D_element::isValid (void) const {
  return mAttribute_lkey.isValid () && mAttribute_mFeatureValue.isValid () ;
}

//---------------------------------------------------------------------------------------------------------------------*

void GALGAS_projectQualifiedFeatureMap_2D_element::drop (void) {
  mAttribute_lkey.drop () ;
  mAttribute_mFeatureValue.drop () ;
}

//---------------------------------------------------------------------------------------------------------------------*

void GALGAS_projectQualifiedFeatureMap_2D_element::description (C_String & ioString,
                                                                const int32_t inIndentation) const {
  ioString << "<struct @projectQualifiedFeatureMap-element:" ;
  if (! isValid ()) {
    ioString << " not built" ;
  }else{
    mAttribute_lkey.description (ioString, inIndentation+1) ;
    ioString << ", " ;
    mAttribute_mFeatureValue.description (ioString, inIndentation+1) ;
  }
  ioString << ">" ;
}

//---------------------------------------------------------------------------------------------------------------------*

GALGAS_lstring GALGAS_projectQualifiedFeatureMap_2D_element::reader_lkey (UNUSED_LOCATION_ARGS) const {
  return mAttribute_lkey ;
}

//---------------------------------------------------------------------------------------------------------------------*

GALGAS_lstring GALGAS_projectQualifiedFeatureMap_2D_element::reader_mFeatureValue (UNUSED_LOCATION_ARGS) const {
  return mAttribute_mFeatureValue ;
}



//---------------------------------------------------------------------------------------------------------------------*
//                                                                                                                     *
//                                      @projectQualifiedFeatureMap-element type                                       *
//                                                                                                                     *
//---------------------------------------------------------------------------------------------------------------------*

const C_galgas_type_descriptor
kTypeDescriptor_GALGAS_projectQualifiedFeatureMap_2D_element ("projectQualifiedFeatureMap-element",
                                                              NULL) ;

//---------------------------------------------------------------------------------------------------------------------*

const C_galgas_type_descriptor * GALGAS_projectQualifiedFeatureMap_2D_element::staticTypeDescriptor (void) const {
  return & kTypeDescriptor_GALGAS_projectQualifiedFeatureMap_2D_element ;
}

//---------------------------------------------------------------------------------------------------------------------*

AC_GALGAS_root * GALGAS_projectQualifiedFeatureMap_2D_element::clonedObject (void) const {
  AC_GALGAS_root * result = NULL ;
  if (isValid ()) {
    macroMyNew (result, GALGAS_projectQualifiedFeatureMap_2D_element (*this)) ;
  }
  return result ;
}

//---------------------------------------------------------------------------------------------------------------------*

GALGAS_projectQualifiedFeatureMap_2D_element GALGAS_projectQualifiedFeatureMap_2D_element::extractObject (const GALGAS_object & inObject,
                                                                                                          C_Compiler * inCompiler
                                                                                                          COMMA_LOCATION_ARGS) {
  GALGAS_projectQualifiedFeatureMap_2D_element result ;
  const GALGAS_projectQualifiedFeatureMap_2D_element * p = (const GALGAS_projectQualifiedFeatureMap_2D_element *) inObject.embeddedObject () ;
  if (NULL != p) {
    if (NULL != dynamic_cast <const GALGAS_projectQualifiedFeatureMap_2D_element *> (p)) {
      result = *p ;
    }else{
      inCompiler->castError ("projectQualifiedFeatureMap-element", p->dynamicTypeDescriptor () COMMA_THERE) ;
    }  
  }
  return result ;
}

//--- START OF USER ZONE 2


//--- END OF USER ZONE 2


