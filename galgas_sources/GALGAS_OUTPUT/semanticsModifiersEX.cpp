//---------------------------------------------------------------------------*
//                                                                           *
//                     File 'semanticsModifiersEX.cpp'                       *
//                 Generated by version GALGAS_BETA_VERSION                  *
//                      march 10th, 2010, at 17h5'58"                        *
//                                                                           *
//---------------------------------------------------------------------------*

//--- START OF USER ZONE 1


//--- END OF USER ZONE 1

//---------------------------------------------------------------------------*

#include "version_libpm.h"
#if LIBPM_VERSION != THE_LIBPM_VERSION
  #error "This file has been compiled with a version of GALGAS different than the version of libpm"
#endif

//---------------------------------------------------------------------------*

#include <typeinfo>
#include "utilities/MF_MemoryControl.h"
#include "files/C_TextFileWrite.h"
#include "galgas/C_galgas_CLI_Options.h"
#include "semanticsModifiersEX.h"

//---------------------------------------------------------------------------*

#ifndef DO_NOT_GENERATE_CHECKINGS
  #define SOURCE_FILE_AT_LINE(line) "semanticsModifiersEX.gSemantics", line
  #define COMMA_SOURCE_FILE_AT_LINE(line) , SOURCE_FILE_AT_LINE(line)
#else
  #define SOURCE_FILE_AT_LINE(line) 
  #define COMMA_SOURCE_FILE_AT_LINE(line) 
#endif


//--- START OF USER ZONE 2


//--- END OF USER ZONE 2

//---------------------------------------------------------------------------*
//                                                                           *
//              Element of list '@formalParameterSignatureEXX'               *
//                                                                           *
//---------------------------------------------------------------------------*

elementOf_GGS_formalParameterSignatureEXX::
elementOf_GGS_formalParameterSignatureEXX (const GGS_ACGalgasType & argument_0,
                                const GGS_formalArgumentPassingModeAST& argument_1
                                COMMA_LOCATION_ARGS) :
AC_galgas_list::cListElement (THERE),
mParameterType (argument_0),
mFormalParameterPassingMode (argument_1) {
}

//---------------------------------------------------------------------------*

bool elementOf_GGS_formalParameterSignatureEXX::
isEqualToObject (const cListElement * inOperand) const {
  bool equal = inOperand == this ;
  if (! equal) {
    const elementOf_GGS_formalParameterSignatureEXX * ptr = dynamic_cast <const elementOf_GGS_formalParameterSignatureEXX *> (inOperand) ;
    macroValidPointer (ptr) ;
    equal = mParameterType.operator_isEqual (ptr->mParameterType).boolValue ()
         && mFormalParameterPassingMode.operator_isEqual (ptr->mFormalParameterPassingMode).boolValue () ;
  }
  return equal ;
}

//---------------------------------------------------------------------------*

void elementOf_GGS_formalParameterSignatureEXX::
appendForDescription (C_String & ioString,
                      const PMSInt32 inIndentation) const {
  ioString << "\n" ;
  ioString.writeStringMultiple ("| ", inIndentation) ;
  ioString << "|-" ;
  ioString << mParameterType.reader_description (inIndentation) ;
  ioString << "\n" ;
  ioString.writeStringMultiple ("| ", inIndentation) ;
  ioString << "|-" ;
  ioString << mFormalParameterPassingMode.reader_description (inIndentation) ;
}

//---------------------------------------------------------------------------*
//                                                                           *
//                   List '@formalParameterSignatureEXX'                     *
//                                                                           *
//---------------------------------------------------------------------------*

const C_galgas_type_descriptorEX kTypeDescriptor_GGS_formalParameterSignatureEXX ("formalParameterSignatureEXX", false, NULL) ;

//---------------------------------------------------------------------------*

void GGS_formalParameterSignatureEXX::
internalAppendValues (const GGS_ACGalgasType & argument_0,
                    const GGS_formalArgumentPassingModeAST& argument_1
                    COMMA_LOCATION_ARGS) {
  cElement * newElement = (cElement *) NULL ;
  macroMyNew (newElement, cElement (argument_0,
                                argument_1
                                COMMA_THERE)) ;
  internalAppendItem (newElement) ;
}

//---------------------------------------------------------------------------*

void GGS_formalParameterSignatureEXX::
internalPrependValues (const GGS_ACGalgasType & argument_0,
                    const GGS_formalArgumentPassingModeAST& argument_1
                    COMMA_LOCATION_ARGS) {
  cElement * newElement = (cElement *) NULL ;
  macroMyNew (newElement, cElement (argument_0,
                                argument_1
                                COMMA_THERE)) ;
  internalPrependItem (newElement) ;
}

//---------------------------------------------------------------------------*

void GGS_formalParameterSignatureEXX::
addAssign_operation (const GGS_ACGalgasType & argument_0,
                                const GGS_formalArgumentPassingModeAST& argument_1) {
  if (isBuilt ()&& argument_0.isBuilt ()&& argument_1.isBuilt ()) {
    insulateList () ;
    internalAppendValues (argument_0,
                                argument_1
                                COMMA_HERE) ;
  }
}

//---------------------------------------------------------------------------*

GGS_formalParameterSignatureEXX GGS_formalParameterSignatureEXX::
operator_concat (const GGS_formalParameterSignatureEXX & inOperand) const {
  GGS_formalParameterSignatureEXX result = * this ;
  result.dotAssign_operation (inOperand) ;
  return result ;
}

//---------------------------------------------------------------------------*

void GGS_formalParameterSignatureEXX::
dotAssign_operation (const GGS_formalParameterSignatureEXX inOperand) {
  if (isBuilt () && inOperand.isBuilt ()) {
    if (count () == 0) {
      * this = inOperand ;
    }else{
      if (inOperand.count () > 0) {
        insulateList () ;
        elementOf_GGS_formalParameterSignatureEXX * p = inOperand.firstObject () ;
        while (p != NULL) {
          macroValidPointer (p) ;
          GGS_ACGalgasType  p_0 = p->mParameterType ;
          GGS_formalArgumentPassingModeAST p_1 = p->mFormalParameterPassingMode ;
          internalAppendValues (p_0, p_1 COMMA_HERE) ;
          p = p->nextObject () ;
        }
      }
    }
  }
}

//---------------------------------------------------------------------------*

void GGS_formalParameterSignatureEXX::
modifier_prependValue (C_Compiler & /* inLexique */,
                     const GGS_ACGalgasType & argument_0,
                     const GGS_formalArgumentPassingModeAST& argument_1
                     COMMA_UNUSED_LOCATION_ARGS) {
  if (isBuilt ()) {
    insulateList () ;
    internalPrependValues (argument_0,
                                argument_1
                                COMMA_HERE) ;
  }
}

//---------------------------------------------------------------------------*

void GGS_formalParameterSignatureEXX::
insulateList (void) {
  if (isShared ()) {
    cElement * ptr = firstObject () ;
    alloc () ;
    while (ptr != NULL) {
      macroValidPointer (ptr) ;
      internalAppendValues (ptr->mParameterType,
                                ptr->mFormalParameterPassingMode
                                COMMA_HERE) ;
      ptr = ptr->nextObject () ;
    }
  }
}

//---------------------------------------------------------------------------*

GGS_formalParameterSignatureEXX  GGS_formalParameterSignatureEXX::
constructor_emptyList (void) {
  GGS_formalParameterSignatureEXX result ;
  result.alloc () ;
  return result ;
}

//---------------------------------------------------------------------------*

GGS_formalParameterSignatureEXX  GGS_formalParameterSignatureEXX::
constructor_listWithValue (const GGS_ACGalgasType & argument_0,
                                const GGS_formalArgumentPassingModeAST& argument_1) {
  GGS_formalParameterSignatureEXX result ;
  result.alloc () ;
  result.addAssign_operation (argument_0, argument_1) ;
  return result ;
}

//---------------------------------------------------------------------------*

void GGS_formalParameterSignatureEXX::
internalSubListWithRange (GGS_formalParameterSignatureEXX & ioList,
                          const PMSInt32 inFirstIndex,
                          const PMSInt32 inCount) const {
  ioList.alloc () ;
  if (inCount > 0) {
    cElement * ptr = firstObject () ;
    for (PMSInt32 i=0 ; i<inFirstIndex ; i++) {
      macroValidPointer (ptr) ;
      ptr = ptr->nextObject () ;
    }
    for (PMSInt32 i=0 ; i<inCount ; i++) {
      macroValidPointer (ptr) ;
      ioList.addAssign_operation (ptr->mParameterType, ptr->mFormalParameterPassingMode) ;
      ptr = ptr->nextObject () ;
    }
  }
}

//---------------------------------------------------------------------------*

GGS_formalParameterSignatureEXX GGS_formalParameterSignatureEXX::
reader_subListWithRange (C_Compiler & inLexique,
                         const GGS_uint & inFirstIndex,
                         const GGS_uint & inCount
                         COMMA_LOCATION_ARGS) const {
  GGS_formalParameterSignatureEXX result ;
  if (isBuilt () && inFirstIndex.isBuilt () && inCount.isBuilt ()) {
    const PMSInt32 firstIndex = (PMSInt32) inFirstIndex.uintValue () ;
    const PMSInt32 rangeCount = (PMSInt32) inCount.uintValue () ;
    if ((firstIndex + rangeCount) > count ()) {
      inLexique.onTheFlyRunTimeError ("'subListWithRange' method invoked with upper bound greater than list object count" COMMA_THERE) ;
    }else{
      internalSubListWithRange (result, firstIndex, rangeCount) ;
    }
  }
  return result ;
}

//---------------------------------------------------------------------------*

GGS_formalParameterSignatureEXX GGS_formalParameterSignatureEXX::
reader_subListFromIndex (C_Compiler & inLexique,
                         const GGS_uint & inIndex
                         COMMA_LOCATION_ARGS) const {
  GGS_formalParameterSignatureEXX result ;
  if (isBuilt () && inIndex.isBuilt ()) {
    const PMSInt32 startIndex = (PMSInt32) inIndex.uintValue () ;
    if (startIndex > count ()) {
      inLexique.onTheFlyRunTimeError ("'subListFromIndex' method invoked with start index greater than list object count" COMMA_THERE) ;
    }else{
      internalSubListWithRange (result, startIndex, count () - startIndex) ;
    }
  }
  return result ;
}

//---------------------------------------------------------------------------*

GGS_string GGS_formalParameterSignatureEXX::
reader_description (const PMSInt32 inIndentation) const {
  return performDescription ("@formalParameterSignatureEXX", inIndentation) ;
}

//---------------------------------------------------------------------------*

void GGS_formalParameterSignatureEXX::
method_first (C_Compiler & inLexique,
              GGS_ACGalgasType & _out_0,
              GGS_formalArgumentPassingModeAST& _out_1
              COMMA_LOCATION_ARGS) const {
  cElement * ptr = NULL ;
  if (isBuilt ()) {
    ptr = firstObject () ;
    if (ptr == NULL) {
      inLexique.onTheFlyRunTimeError ("'first' method invoked on an empty list" COMMA_THERE) ;
    }
  }
  if (ptr != NULL) {
    _out_0 = ptr->mParameterType ;
    _out_1 = ptr->mFormalParameterPassingMode ;
  }else{
    _out_0.drop () ;
    _out_1.drop () ;
  }
}

//---------------------------------------------------------------------------*

void GGS_formalParameterSignatureEXX::
method_last (C_Compiler & inLexique,
             GGS_ACGalgasType & _out_0,
             GGS_formalArgumentPassingModeAST& _out_1
             COMMA_LOCATION_ARGS) const {
  cElement * ptr = NULL ;
  if (isBuilt ()) {
    ptr = lastObject () ;
    if (ptr == NULL) {
      inLexique.onTheFlyRunTimeError ("'last' method invoked on an empty list" COMMA_THERE) ;
    }
  }
  if (ptr != NULL) {
    _out_0 = ptr->mParameterType ;
    _out_1 = ptr->mFormalParameterPassingMode ;
  }else{
    _out_0.drop () ;
    _out_1.drop () ;
  }
}

//---------------------------------------------------------------------------*

void GGS_formalParameterSignatureEXX::
modifier_popFirst (C_Compiler & inLexique,
                 GGS_ACGalgasType & _out_0,
                 GGS_formalArgumentPassingModeAST& _out_1
                 COMMA_LOCATION_ARGS) {
  cElement * ptr = NULL ;
  if (isBuilt ()) {
    ptr = firstObject () ;
    if (ptr == NULL) {
      inLexique.onTheFlyRunTimeError ("'popFirst' modifier invoked on an empty list" COMMA_THERE) ;
    }
  }
  if (ptr != NULL) {
    _out_0 = ptr->mParameterType ;
    _out_1 = ptr->mFormalParameterPassingMode ;
    insulateList () ;
    internalRemoveFirst () ;
  }else{
    _out_0.drop () ;
    _out_1.drop () ;
  }
}

//---------------------------------------------------------------------------*

void GGS_formalParameterSignatureEXX::
modifier_popLast (C_Compiler & inLexique,
                GGS_ACGalgasType & _out_0,
                GGS_formalArgumentPassingModeAST& _out_1
                COMMA_LOCATION_ARGS) {
  cElement * ptr = NULL ;
  if (isBuilt ()) {
    ptr = lastObject () ;
    if (ptr == NULL) {
      inLexique.onTheFlyRunTimeError ("'popLast' modifier invoked on an empty list" COMMA_THERE) ;
    }
  }
  if (ptr != NULL) {
    _out_0 = ptr->mParameterType ;
    _out_1 = ptr->mFormalParameterPassingMode ;
    insulateList () ;
    internalRemoveLast () ;
  }else{
    _out_0.drop () ;
    _out_1.drop () ;
  }
}

//---------------------------------------------------------------------------*

GGS_ACGalgasType  GGS_formalParameterSignatureEXX::
reader_mParameterTypeAtIndex (C_Compiler & inLexique, const GGS_uint & inIndex COMMA_LOCATION_ARGS) const {
  GGS_ACGalgasType  result ;
  if (isBuilt () && inIndex.isBuilt ()) {
    cElement * object = (cElement *) objectAtIndex (inLexique, inIndex.uintValue () COMMA_THERE) ;
    if (object != NULL) {
      result = object->mParameterType ;
    }
  }
  return result ;
}

//---------------------------------------------------------------------------*

GGS_formalArgumentPassingModeAST GGS_formalParameterSignatureEXX::
reader_mFormalParameterPassingModeAtIndex (C_Compiler & inLexique, const GGS_uint & inIndex COMMA_LOCATION_ARGS) const {
  GGS_formalArgumentPassingModeAST result ;
  if (isBuilt () && inIndex.isBuilt ()) {
    cElement * object = (cElement *) objectAtIndex (inLexique, inIndex.uintValue () COMMA_THERE) ;
    if (object != NULL) {
      result = object->mFormalParameterPassingMode ;
    }
  }
  return result ;
}

//---------------------------------------------------------------------------*

void GGS_formalParameterSignatureEXX::
modifier_setMParameterTypeAtIndex (C_Compiler & inLexique,
                              const GGS_ACGalgasType  & inObject,
                              const GGS_uint & inIndex
                              COMMA_LOCATION_ARGS) const {
  if (isBuilt () && inIndex.isBuilt ()) {
    cElement * object = (cElement *) objectAtIndex (inLexique, inIndex.uintValue () COMMA_THERE) ;
    if (object != NULL) {
      object->mParameterType = inObject ;
    }
  }
}

//---------------------------------------------------------------------------*

void GGS_formalParameterSignatureEXX::
modifier_setMFormalParameterPassingModeAtIndex (C_Compiler & inLexique,
                              const GGS_formalArgumentPassingModeAST & inObject,
                              const GGS_uint & inIndex
                              COMMA_LOCATION_ARGS) const {
  if (isBuilt () && inIndex.isBuilt ()) {
    cElement * object = (cElement *) objectAtIndex (inLexique, inIndex.uintValue () COMMA_THERE) ;
    if (object != NULL) {
      object->mFormalParameterPassingMode = inObject ;
    }
  }
}

//---------------------------------------------------------------------------*

/* const */ GGS_ACGalgasType  & GGS_formalParameterSignatureEXX::cEnumerator::_mParameterType (LOCATION_ARGS) const {
  macroValidPointerThere (mCurrentEnumeratedObject) ;
  return ((/* const */ cElement *) mCurrentEnumeratedObject)->mParameterType ;
}

//---------------------------------------------------------------------------*

/* const */ GGS_formalArgumentPassingModeAST & GGS_formalParameterSignatureEXX::cEnumerator::_mFormalParameterPassingMode (LOCATION_ARGS) const {
  macroValidPointerThere (mCurrentEnumeratedObject) ;
  return ((/* const */ cElement *) mCurrentEnumeratedObject)->mFormalParameterPassingMode ;
}

//---------------------------------------------------------------------------*

GGS_object GGS_formalParameterSignatureEXX::reader_object (void) const {
  GGS_object result ;
  if (isBuilt ()) {
    GGS_formalParameterSignatureEXX * p = NULL ;
    macroMyNew (p, GGS_formalParameterSignatureEXX (*this)) ;
    result = GGS_object (p) ;
  }
  return result ;
}

//---------------------------------------------------------------------------*

GGS_formalParameterSignatureEXX GGS_formalParameterSignatureEXX::castFromObject (C_Compiler & inLexique,
                                   const GGS_object & inObject,
                                   const GGS_location & inErrorLocation
                                   COMMA_LOCATION_ARGS) {
  GGS_formalParameterSignatureEXX result ;
  const GGS__root * embeddedObject = inObject.embeddedObject () ;
  if (NULL != embeddedObject) {
    const GGS_formalParameterSignatureEXX * p = dynamic_cast <const GGS_formalParameterSignatureEXX *> (embeddedObject) ;
    if (NULL != p) {
      result = * p ;
    }else{
      castFromObjectErrorSignaling (inLexique, inErrorLocation, & kTypeDescriptor_GGS_formalParameterSignatureEXX, embeddedObject COMMA_THERE) ;
    }
  }
  return result ;
}

//---------------------------------------------------------------------------*

const C_galgas_type_descriptorEX * GGS_formalParameterSignatureEXX::typeDescriptor (void) const {
  return & kTypeDescriptor_GGS_formalParameterSignatureEXX ;
}

//---------------------------------------------------------------------------*
//                                                                           *
//                         class 'e_modifierMapEXX'                          *
//                                                                           *
//---------------------------------------------------------------------------*

e_modifierMapEXX::e_modifierMapEXX (void) :
mParameterList (),
mHasCompilerArgument () {
}

//---------------------------------------------------------------------------*
//                                                                           *
//                       class map '@modifierMapEXX'                         *
//                                                                           *
//---------------------------------------------------------------------------*

const C_galgas_type_descriptorEX kTypeDescriptor_GGS_modifierMapEXX ("modifierMapEXX", false, NULL) ;

//---------------------------------------------------------------------------*

elementOf_GGS_modifierMapEXX::
elementOf_GGS_modifierMapEXX (const GGS_lstring & inKey,
              const PMSInt32 inIndex,
              const e_modifierMapEXX & inInfo) :
AC_galgas_map_element (inKey, inIndex),
mInfo (inInfo) {
}

//---------------------------------------------------------------------------*

void elementOf_GGS_modifierMapEXX::
appendForMapDescription (const PMSInt32 inElementIndex,
                         C_String & ioString,
                         const PMSInt32 inIndentation) const {
  ioString << "\n" ;
  ioString.writeStringMultiple ("| ", inIndentation) ;
  ioString << "|-key " ;
  ioString.appendSigned (inElementIndex) ;
  ioString << ":" << mKey.reader_description (inIndentation + 1) ;
  ioString << "\n" ;
  ioString.writeStringMultiple ("| ", inIndentation) ;
  ioString << "|-value " ;
  ioString.appendSigned (inElementIndex) ;
  ioString << ":" << mInfo.mParameterList.reader_description (inIndentation + 1) ;
  ioString << "\n" ;
  ioString.writeStringMultiple ("| ", inIndentation) ;
  ioString << "|-value " ;
  ioString.appendSigned (inElementIndex) ;
  ioString << ":" << mInfo.mHasCompilerArgument.reader_description (inIndentation + 1) ;
}

//---------------------------------------------------------------------------*

bool elementOf_GGS_modifierMapEXX::
isEqualToMapElement (const AC_galgas_map_element * inOperand) const {
  const elementOf_GGS_modifierMapEXX * ptr = dynamic_cast <const elementOf_GGS_modifierMapEXX *> (inOperand) ;
  macroValidPointer (ptr) ;
  return (mInfo.mParameterList.operator_isEqual (ptr->mInfo.mParameterList)).boolValue ()
           && (mInfo.mHasCompilerArgument.operator_isEqual (ptr->mInfo.mHasCompilerArgument)).boolValue () ;
}

//---------------------------------------------------------------------------*

AC_galgas_map_element * GGS_modifierMapEXX::
new_element (const GGS_lstring & inKey, void * inInfo) {
  MF_Assert (reinterpret_cast <e_modifierMapEXX *> (inInfo) != NULL, "Dynamic cast error", 0, 0) ;
  AC_galgas_map_element * p = NULL ;
  e_modifierMapEXX * info = (e_modifierMapEXX *) inInfo ;
  macroMyNew (p, cElement (inKey, nextIndex (), * info)) ;
  return p ;
}

//---------------------------------------------------------------------------*

void GGS_modifierMapEXX::
assignInfo (AC_galgas_map_element * inPtr, void * inInfo) {
  MF_Assert (reinterpret_cast <cElement *> (inPtr) != NULL, "Dynamic cast error", 0, 0) ;
  MF_Assert (reinterpret_cast <e_modifierMapEXX *> (inInfo) != NULL, "Dynamic cast error", 0, 0) ;
  cElement * p = (cElement *) inPtr ;
  e_modifierMapEXX * info = (e_modifierMapEXX *) inInfo ;
  p->mInfo = * info ;
}

//---------------------------------------------------------------------------*

GGS_modifierMapEXX GGS_modifierMapEXX::
constructor_emptyMap (C_Compiler & /* inLexique */ COMMA_UNUSED_LOCATION_ARGS) {
  GGS_modifierMapEXX result ;
  macroMyNew (result.mSharedMapRoot, cMapRoot) ;
  return result ;
}

//---------------------------------------------------------------------------*

void GGS_modifierMapEXX::
enterIndex (const GGS_lstring & inKey,
            AC_galgas_index_core & outIndex) {
  e_modifierMapEXX info  ;
  internalEnterIndex (inKey,
                      (void *) & info,
                      outIndex) ;
}

//---------------------------------------------------------------------------*

GGS_bool GGS_modifierMapEXX::
operator_isEqual (const GGS_modifierMapEXX & inOperand) const {
  return GGS_bool (isBuilt () && inOperand.isBuilt (), isEqualToMap (inOperand)) ;
}

//---------------------------------------------------------------------------*

GGS_bool GGS_modifierMapEXX::
operator_isNotEqual (const GGS_modifierMapEXX & inOperand) const {
  return GGS_bool (isBuilt () && inOperand.isBuilt (), ! isEqualToMap (inOperand)) ;
}

//---------------------------------------------------------------------------*

void GGS_modifierMapEXX::
internalInsertForDuplication (AC_galgas_map_element * inPtr) {
  MF_Assert (reinterpret_cast <cElement *> (inPtr) != NULL, "Dynamic cast error", 0, 0) ;
  cElement * p = (cElement *) inPtr ;
  PMSInt32 attributeIndex = -1 ; // Unused here
  GGS_location existingKeyLocation ; // Unused here
  internalInsert (p->mKey, (void *) & p->mInfo, attributeIndex, existingKeyLocation) ;
}

//---------------------------------------------------------------------------*

void GGS_modifierMapEXX::
insertElement (C_Compiler & inLexique,
                const utf32 * inErrorMessage,
                const GGS_lstring & inKey,
                const GGS_formalParameterSignatureEXX & inParameter0,
                const GGS_bool& inParameter1,
                GGS_luint * outIndex
                COMMA_LOCATION_ARGS) {
  PMSInt32 elementID = - 1 ;
  if (isBuilt ()
   && inParameter0.isBuilt ()
   && inParameter1.isBuilt ()
   && inKey.isBuilt ()) {
    insulateMap () ;
    e_modifierMapEXX info  ;
    info.mParameterList = inParameter0 ;
    info.mHasCompilerArgument = inParameter1 ;
    GGS_location existingKeyLocation ;
    internalInsert (inKey, (void *) & info, elementID, existingKeyLocation) ;
    if (elementID < 0) {
      emitInsertMapSemanticErrorMessage (inLexique, inKey, inErrorMessage, existingKeyLocation COMMA_THERE) ;
    }
  }
  if (outIndex != NULL) {
    * outIndex = GGS_luint (GGS_uint (elementID >= 0, (PMUInt32) elementID), inKey) ;
  }
}

//---------------------------------------------------------------------------*

void GGS_modifierMapEXX::
searchElement (C_Compiler & inLexique,
               const utf32 * inErrorMessage,
               const GGS_lstring & inKey,
               GGS_formalParameterSignatureEXX   & outParameter0,
               GGS_bool  & outParameter1,
               GGS_luint * outIndex
               COMMA_LOCATION_ARGS) const {
  cElement * node = NULL  ;
  if (isBuilt () && inKey.isBuilt ()) {
    AC_galgas_map_element * p = internal_search (inKey.string ()) ;
    MF_Assert ((p == NULL) || (reinterpret_cast <cElement *> (p) != NULL), "Dynamic cast error", 0, 0) ;
    node = (cElement *) p ;
    if (node == NULL) {
      emitMapSemanticErrorMessage (inLexique, inKey, inErrorMessage COMMA_THERE) ;
    }
  }
  if (node == NULL) {
    outParameter0.drop () ;
    outParameter1.drop () ;
    if (outIndex != NULL) {
      outIndex->drop () ;
     }
  }else{
    outParameter0 = node->mInfo.mParameterList ;
    outParameter1 = node->mInfo.mHasCompilerArgument ;
    if (outIndex != NULL) {
      * outIndex = GGS_luint (GGS_uint (true, (PMUInt32) node->mID), inKey) ;
    }
  }
}

//---------------------------------------------------------------------------*

const utf32 GGS_modifierMapEXX::kSearchMessage_searchKey [] = {
  TO_UNICODE ('t'),
  TO_UNICODE ('h'),
  TO_UNICODE ('e'),
  TO_UNICODE (' '),
  TO_UNICODE ('\''),
  TO_UNICODE ('%'),
  TO_UNICODE ('K'),
  TO_UNICODE ('\''),
  TO_UNICODE (' '),
  TO_UNICODE ('m'),
  TO_UNICODE ('o'),
  TO_UNICODE ('d'),
  TO_UNICODE ('i'),
  TO_UNICODE ('f'),
  TO_UNICODE ('i'),
  TO_UNICODE ('e'),
  TO_UNICODE ('r'),
  TO_UNICODE (' '),
  TO_UNICODE ('i'),
  TO_UNICODE ('s'),
  TO_UNICODE (' '),
  TO_UNICODE ('n'),
  TO_UNICODE ('o'),
  TO_UNICODE ('t'),
  TO_UNICODE (' '),
  TO_UNICODE ('d'),
  TO_UNICODE ('e'),
  TO_UNICODE ('c'),
  TO_UNICODE ('l'),
  TO_UNICODE ('a'),
  TO_UNICODE ('r'),
  TO_UNICODE ('e'),
  TO_UNICODE ('d'),
  TO_UNICODE (0)
} ;

//---------------------------------------------------------------------------*

void GGS_modifierMapEXX::
method_searchKey (C_Compiler & inLexique,
                                const GGS_lstring & inKey,
                                GGS_formalParameterSignatureEXX   & outParameter0,
                                GGS_bool  & outParameter1 COMMA_LOCATION_ARGS) const {
  searchElement (inLexique,
                  kSearchMessage_searchKey,
                  inKey,
                  outParameter0,
                  outParameter1,
                  NULL
                  COMMA_THERE) ;
}

//---------------------------------------------------------------------------*

const utf32 GGS_modifierMapEXX::kInsertMessage_insertKey [] = {
  TO_UNICODE ('t'),
  TO_UNICODE ('h'),
  TO_UNICODE ('e'),
  TO_UNICODE (' '),
  TO_UNICODE ('\''),
  TO_UNICODE ('%'),
  TO_UNICODE ('K'),
  TO_UNICODE ('\''),
  TO_UNICODE (' '),
  TO_UNICODE ('m'),
  TO_UNICODE ('o'),
  TO_UNICODE ('d'),
  TO_UNICODE ('i'),
  TO_UNICODE ('f'),
  TO_UNICODE ('i'),
  TO_UNICODE ('e'),
  TO_UNICODE ('r'),
  TO_UNICODE (' '),
  TO_UNICODE ('h'),
  TO_UNICODE ('a'),
  TO_UNICODE ('s'),
  TO_UNICODE (' '),
  TO_UNICODE ('b'),
  TO_UNICODE ('e'),
  TO_UNICODE ('e'),
  TO_UNICODE ('n'),
  TO_UNICODE (' '),
  TO_UNICODE ('a'),
  TO_UNICODE ('l'),
  TO_UNICODE ('r'),
  TO_UNICODE ('e'),
  TO_UNICODE ('a'),
  TO_UNICODE ('d'),
  TO_UNICODE ('y'),
  TO_UNICODE (' '),
  TO_UNICODE ('d'),
  TO_UNICODE ('e'),
  TO_UNICODE ('f'),
  TO_UNICODE ('i'),
  TO_UNICODE ('n'),
  TO_UNICODE ('e'),
  TO_UNICODE ('d'),
  TO_UNICODE (0)
} ;

//---------------------------------------------------------------------------*

void GGS_modifierMapEXX::
modifier_insertKey (C_Compiler & inLexique,
                                const GGS_lstring & inKey,
                                const GGS_formalParameterSignatureEXX & inParameter0,
                                const GGS_bool& inParameter1 COMMA_LOCATION_ARGS) {
  insertElement (inLexique,
                 kInsertMessage_insertKey,
                 inKey,
                 inParameter0,
                 inParameter1,
                 NULL
                 COMMA_THERE) ;
}

//---------------------------------------------------------------------------*

GGS_modifierMapEXX GGS_modifierMapEXX::
constructor_mapWithMapToOverride (C_Compiler & /* inLexique */,
                                  const GGS_modifierMapEXX & inMapToOverride
                                  COMMA_UNUSED_LOCATION_ARGS) {
  GGS_modifierMapEXX result ; // Not Built
  if (inMapToOverride.mSharedMapRoot != NULL) {
    macroValidPointer (inMapToOverride.mSharedMapRoot) ;
    macroMyNew (result.mSharedMapRoot, cMapRoot) ;
    result.mSharedMapRoot->mNextMap = inMapToOverride.mSharedMapRoot ;
    inMapToOverride.mSharedMapRoot->mReferenceCount ++ ;
    result.mSharedMapRoot->mSequenceNumber = inMapToOverride.mSharedMapRoot->mSequenceNumber ;
  }
  return result ;
}

//---------------------------------------------------------------------------*

GGS_modifierMapEXX GGS_modifierMapEXX::
reader_overriddenMap (C_Compiler & /* inLexique */
                      COMMA_UNUSED_LOCATION_ARGS) const {
  GGS_modifierMapEXX result ; // Not Built
  if (mSharedMapRoot != NULL) {
    macroValidPointer (mSharedMapRoot) ;
    result.mSharedMapRoot = mSharedMapRoot->mNextMap ;
    if (result.mSharedMapRoot != NULL) {
      macroValidPointer (result.mSharedMapRoot) ;
      result.mSharedMapRoot->mReferenceCount ++ ;
    }else{
      macroMyNew (result.mSharedMapRoot, cMapRoot) ;
    }
  }
  return result ;
}

//---------------------------------------------------------------------------*

GGS_string GGS_modifierMapEXX::
reader_description (const PMSInt32 inIndentation) const {
  C_String s ;
  s << "<map @modifierMapEXX " ;
  if (isBuilt ()) {
    s.appendSigned (count ()) ;
    s << " object" << ((count () > 1) ? "s " : " ") ;
    cMapRoot * mapRoot = mSharedMapRoot ;
    PMSInt32 level = 0 ;
    while (mapRoot != NULL) {
      if (level > 0) {
        s << "\n" ;
        s.writeStringMultiple ("| ", inIndentation) ;
        s << "------- level " << cStringWithSigned (level) ;
      }
      macroValidPointer (mapRoot) ;
      cElement * p = (cElement *) mapRoot->mFirstItem ;
      PMSInt32 elementID = 0 ;
      while (p != NULL) {
        macroValidPointer (p) ;
        p->appendForMapDescription (elementID, s, inIndentation) ;
        p = p->nextObject () ;
        elementID ++ ;
      }
      mapRoot = mapRoot->mNextMap ;
      level ++ ;
    }
  }else{
    s << "not built" ;
  }
  s << "\n" ;
  s.writeStringMultiple ("| ", inIndentation) ;
  s << ">" ;
  return GGS_string (true, s) ;
}

//---------------------------------------------------------------------------*

/* const */ GGS_formalParameterSignatureEXX  & GGS_modifierMapEXX::cEnumerator::_mParameterList (LOCATION_ARGS) const {
  return ((cElement *) mObjectArray (mCurrentIndex COMMA_THERE))->mInfo.mParameterList ;
}

//---------------------------------------------------------------------------*

/* const */ GGS_bool & GGS_modifierMapEXX::cEnumerator::_mHasCompilerArgument (LOCATION_ARGS) const {
  return ((cElement *) mObjectArray (mCurrentIndex COMMA_THERE))->mInfo.mHasCompilerArgument ;
}

//---------------------------------------------------------------------------*

GGS_object GGS_modifierMapEXX::reader_object (void) const {
  GGS_object result ;
  if (isBuilt ()) {
    GGS_modifierMapEXX * p = NULL ;
    macroMyNew (p, GGS_modifierMapEXX (*this)) ;
    result = GGS_object (p) ;
  }
  return result ;
}

//---------------------------------------------------------------------------*

GGS_modifierMapEXX GGS_modifierMapEXX::castFromObject (C_Compiler & inLexique,
                                   const GGS_object & inObject,
                                   const GGS_location & inErrorLocation
                                   COMMA_LOCATION_ARGS) {
  GGS_modifierMapEXX result ;
  const GGS__root * embeddedObject = inObject.embeddedObject () ;
  if (NULL != embeddedObject) {
    const GGS_modifierMapEXX * p = dynamic_cast <const GGS_modifierMapEXX *> (embeddedObject) ;
    if (NULL != p) {
      result = * p ;
    }else{
      castFromObjectErrorSignaling (inLexique, inErrorLocation, & kTypeDescriptor_GGS_modifierMapEXX, embeddedObject COMMA_THERE) ;
    }
  }
  return result ;
}

//---------------------------------------------------------------------------*

const C_galgas_type_descriptorEX * GGS_modifierMapEXX::typeDescriptor (void) const {
  return & kTypeDescriptor_GGS_modifierMapEXX ;
}

//---------------------------------------------------------------------------*
//                                                                           *
//     Implementation of routine "enterModifierWithStringInputArgument"      *
//                                                                           *
//---------------------------------------------------------------------------*

void routine_enterModifierWithStringInputArgument (C_Compiler & inLexique,
                                GGS_modifierMapEXX  & var_cas_ioModifierMap,
                                const GGS_string  var_cas_inName,
                                const GGS_bool  var_cas_inHasCompilerArgument COMMA_UNUSED_LOCATION_ARGS) {
  #ifdef DEBUG_TRACE_ENABLED
    printf ("ENTER routine_enterModifierWithStringInputArgument at %s:%d\n", __FILE__, __LINE__) ;
  #endif
  GGS_formalParameterSignatureEXX  var_cas_argList = GGS_formalParameterSignatureEXX ::constructor_emptyList () ;
  var_cas_argList.addAssign_operation (GGS_stringGalgasType ::constructor_new (inLexique COMMA_HERE), GGS_formalArgumentPassingModeAST::constructor_argumentConstantIn (inLexique COMMA_HERE)) ;
  var_cas_ioModifierMap.modifier_insertKey (inLexique, GGS_lstring ::constructor_new (inLexique, var_cas_inName, GGS_location (inLexique) COMMA_HERE), var_cas_argList, var_cas_inHasCompilerArgument COMMA_SOURCE_FILE_AT_LINE (49)) ;
  #ifdef DEBUG_TRACE_ENABLED
    printf ("LEAVE routine_enterModifierWithStringInputArgument\n") ;
  #endif
}

//---------------------------------------------------------------------------*
//                                                                           *
//         Implementation of routine "enterModifierWithoutArgument"          *
//                                                                           *
//---------------------------------------------------------------------------*

void routine_enterModifierWithoutArgument (C_Compiler & inLexique,
                                GGS_modifierMapEXX  & var_cas_ioModifierMap,
                                const GGS_string  var_cas_inName,
                                const GGS_bool  var_cas_inHasCompilerArgument COMMA_UNUSED_LOCATION_ARGS) {
  #ifdef DEBUG_TRACE_ENABLED
    printf ("ENTER routine_enterModifierWithoutArgument at %s:%d\n", __FILE__, __LINE__) ;
  #endif
  var_cas_ioModifierMap.modifier_insertKey (inLexique, GGS_lstring ::constructor_new (inLexique, var_cas_inName, GGS_location (inLexique) COMMA_HERE), GGS_formalParameterSignatureEXX ::constructor_emptyList (), var_cas_inHasCompilerArgument COMMA_SOURCE_FILE_AT_LINE (63)) ;
  #ifdef DEBUG_TRACE_ENABLED
    printf ("LEAVE routine_enterModifierWithoutArgument\n") ;
  #endif
}

//---------------------------------------------------------------------------*
//                                                                           *
//    Implementation of routine "enterModifierWithLocationInputArgument"     *
//                                                                           *
//---------------------------------------------------------------------------*

void routine_enterModifierWithLocationInputArgument (C_Compiler & inLexique,
                                GGS_modifierMapEXX  & var_cas_ioModifierMap,
                                const GGS_string  var_cas_inName,
                                const GGS_bool  var_cas_inHasCompilerArgument COMMA_UNUSED_LOCATION_ARGS) {
  #ifdef DEBUG_TRACE_ENABLED
    printf ("ENTER routine_enterModifierWithLocationInputArgument at %s:%d\n", __FILE__, __LINE__) ;
  #endif
  GGS_formalParameterSignatureEXX  var_cas_argList = GGS_formalParameterSignatureEXX ::constructor_emptyList () ;
  var_cas_argList.addAssign_operation (GGS_locationGalgasType ::constructor_new (inLexique COMMA_HERE), GGS_formalArgumentPassingModeAST::constructor_argumentConstantIn (inLexique COMMA_HERE)) ;
  var_cas_ioModifierMap.modifier_insertKey (inLexique, GGS_lstring ::constructor_new (inLexique, var_cas_inName, GGS_location (inLexique) COMMA_HERE), var_cas_argList, var_cas_inHasCompilerArgument COMMA_SOURCE_FILE_AT_LINE (79)) ;
  #ifdef DEBUG_TRACE_ENABLED
    printf ("LEAVE routine_enterModifierWithLocationInputArgument\n") ;
  #endif
}

//---------------------------------------------------------------------------*
//                                                                           *
//      Implementation of routine "enterModifierWithCharInputArgument"       *
//                                                                           *
//---------------------------------------------------------------------------*

void routine_enterModifierWithCharInputArgument (C_Compiler & inLexique,
                                GGS_modifierMapEXX  & var_cas_ioModifierMap,
                                const GGS_string  var_cas_inName,
                                const GGS_bool  var_cas_inHasCompilerArgument COMMA_UNUSED_LOCATION_ARGS) {
  #ifdef DEBUG_TRACE_ENABLED
    printf ("ENTER routine_enterModifierWithCharInputArgument at %s:%d\n", __FILE__, __LINE__) ;
  #endif
  GGS_formalParameterSignatureEXX  var_cas_argList = GGS_formalParameterSignatureEXX ::constructor_emptyList () ;
  var_cas_argList.addAssign_operation (GGS_charGalgasType ::constructor_new (inLexique COMMA_HERE), GGS_formalArgumentPassingModeAST::constructor_argumentConstantIn (inLexique COMMA_HERE)) ;
  var_cas_ioModifierMap.modifier_insertKey (inLexique, GGS_lstring ::constructor_new (inLexique, var_cas_inName, GGS_location (inLexique) COMMA_HERE), var_cas_argList, var_cas_inHasCompilerArgument COMMA_SOURCE_FILE_AT_LINE (95)) ;
  #ifdef DEBUG_TRACE_ENABLED
    printf ("LEAVE routine_enterModifierWithCharInputArgument\n") ;
  #endif
}

//---------------------------------------------------------------------------*
//                                                                           *
//      Implementation of routine "enterModifierWithBoolInputArgument"       *
//                                                                           *
//---------------------------------------------------------------------------*

void routine_enterModifierWithBoolInputArgument (C_Compiler & inLexique,
                                GGS_modifierMapEXX  & var_cas_ioModifierMap,
                                const GGS_string  var_cas_inName,
                                const GGS_bool  var_cas_inHasCompilerArgument COMMA_UNUSED_LOCATION_ARGS) {
  #ifdef DEBUG_TRACE_ENABLED
    printf ("ENTER routine_enterModifierWithBoolInputArgument at %s:%d\n", __FILE__, __LINE__) ;
  #endif
  GGS_formalParameterSignatureEXX  var_cas_argList = GGS_formalParameterSignatureEXX ::constructor_emptyList () ;
  var_cas_argList.addAssign_operation (GGS_boolGalgasType ::constructor_new (inLexique COMMA_HERE), GGS_formalArgumentPassingModeAST::constructor_argumentConstantIn (inLexique COMMA_HERE)) ;
  var_cas_ioModifierMap.modifier_insertKey (inLexique, GGS_lstring ::constructor_new (inLexique, var_cas_inName, GGS_location (inLexique) COMMA_HERE), var_cas_argList, var_cas_inHasCompilerArgument COMMA_SOURCE_FILE_AT_LINE (111)) ;
  #ifdef DEBUG_TRACE_ENABLED
    printf ("LEAVE routine_enterModifierWithBoolInputArgument\n") ;
  #endif
}

//---------------------------------------------------------------------------*
//                                                                           *
//      Implementation of routine "enterModifierWithDataInputArgument"       *
//                                                                           *
//---------------------------------------------------------------------------*

void routine_enterModifierWithDataInputArgument (C_Compiler & inLexique,
                                GGS_modifierMapEXX  & var_cas_ioModifierMap,
                                const GGS_string  var_cas_inName,
                                const GGS_bool  var_cas_inHasCompilerArgument COMMA_UNUSED_LOCATION_ARGS) {
  #ifdef DEBUG_TRACE_ENABLED
    printf ("ENTER routine_enterModifierWithDataInputArgument at %s:%d\n", __FILE__, __LINE__) ;
  #endif
  GGS_formalParameterSignatureEXX  var_cas_argList = GGS_formalParameterSignatureEXX ::constructor_emptyList () ;
  var_cas_argList.addAssign_operation (GGS_dataGalgasType ::constructor_new (inLexique COMMA_HERE), GGS_formalArgumentPassingModeAST::constructor_argumentConstantIn (inLexique COMMA_HERE)) ;
  var_cas_ioModifierMap.modifier_insertKey (inLexique, GGS_lstring ::constructor_new (inLexique, var_cas_inName, GGS_location (inLexique) COMMA_HERE), var_cas_argList, var_cas_inHasCompilerArgument COMMA_SOURCE_FILE_AT_LINE (127)) ;
  #ifdef DEBUG_TRACE_ENABLED
    printf ("LEAVE routine_enterModifierWithDataInputArgument\n") ;
  #endif
}

//---------------------------------------------------------------------------*
//                                                                           *
//      Implementation of routine "enterModifierWithUintInputArgument"       *
//                                                                           *
//---------------------------------------------------------------------------*

void routine_enterModifierWithUintInputArgument (C_Compiler & inLexique,
                                GGS_modifierMapEXX  & var_cas_ioModifierMap,
                                const GGS_string  var_cas_inName,
                                const GGS_bool  var_cas_inHasCompilerArgument COMMA_UNUSED_LOCATION_ARGS) {
  #ifdef DEBUG_TRACE_ENABLED
    printf ("ENTER routine_enterModifierWithUintInputArgument at %s:%d\n", __FILE__, __LINE__) ;
  #endif
  GGS_formalParameterSignatureEXX  var_cas_argList = GGS_formalParameterSignatureEXX ::constructor_emptyList () ;
  var_cas_argList.addAssign_operation (GGS_uintGalgasType ::constructor_new (inLexique COMMA_HERE), GGS_formalArgumentPassingModeAST::constructor_argumentConstantIn (inLexique COMMA_HERE)) ;
  var_cas_ioModifierMap.modifier_insertKey (inLexique, GGS_lstring ::constructor_new (inLexique, var_cas_inName, GGS_location (inLexique) COMMA_HERE), var_cas_argList, var_cas_inHasCompilerArgument COMMA_SOURCE_FILE_AT_LINE (143)) ;
  #ifdef DEBUG_TRACE_ENABLED
    printf ("LEAVE routine_enterModifierWithUintInputArgument\n") ;
  #endif
}

//---------------------------------------------------------------------------*
//                                                                           *
//     Implementation of routine "enterModifierWithUint64InputArgument"      *
//                                                                           *
//---------------------------------------------------------------------------*

void routine_enterModifierWithUint64InputArgument (C_Compiler & inLexique,
                                GGS_modifierMapEXX  & var_cas_ioModifierMap,
                                const GGS_string  var_cas_inName,
                                const GGS_bool  var_cas_inHasCompilerArgument COMMA_UNUSED_LOCATION_ARGS) {
  #ifdef DEBUG_TRACE_ENABLED
    printf ("ENTER routine_enterModifierWithUint64InputArgument at %s:%d\n", __FILE__, __LINE__) ;
  #endif
  GGS_formalParameterSignatureEXX  var_cas_argList = GGS_formalParameterSignatureEXX ::constructor_emptyList () ;
  var_cas_argList.addAssign_operation (GGS_uint64GalgasType ::constructor_new (inLexique COMMA_HERE), GGS_formalArgumentPassingModeAST::constructor_argumentConstantIn (inLexique COMMA_HERE)) ;
  var_cas_ioModifierMap.modifier_insertKey (inLexique, GGS_lstring ::constructor_new (inLexique, var_cas_inName, GGS_location (inLexique) COMMA_HERE), var_cas_argList, var_cas_inHasCompilerArgument COMMA_SOURCE_FILE_AT_LINE (159)) ;
  #ifdef DEBUG_TRACE_ENABLED
    printf ("LEAVE routine_enterModifierWithUint64InputArgument\n") ;
  #endif
}

//---------------------------------------------------------------------------*
//                                                                           *
//      Implementation of routine "enterModifierWithSintInputArgument"       *
//                                                                           *
//---------------------------------------------------------------------------*

void routine_enterModifierWithSintInputArgument (C_Compiler & inLexique,
                                GGS_modifierMapEXX  & var_cas_ioModifierMap,
                                const GGS_string  var_cas_inName,
                                const GGS_bool  var_cas_inHasCompilerArgument COMMA_UNUSED_LOCATION_ARGS) {
  #ifdef DEBUG_TRACE_ENABLED
    printf ("ENTER routine_enterModifierWithSintInputArgument at %s:%d\n", __FILE__, __LINE__) ;
  #endif
  GGS_formalParameterSignatureEXX  var_cas_argList = GGS_formalParameterSignatureEXX ::constructor_emptyList () ;
  var_cas_argList.addAssign_operation (GGS_sintGalgasType ::constructor_new (inLexique COMMA_HERE), GGS_formalArgumentPassingModeAST::constructor_argumentConstantIn (inLexique COMMA_HERE)) ;
  var_cas_ioModifierMap.modifier_insertKey (inLexique, GGS_lstring ::constructor_new (inLexique, var_cas_inName, GGS_location (inLexique) COMMA_HERE), var_cas_argList, var_cas_inHasCompilerArgument COMMA_SOURCE_FILE_AT_LINE (175)) ;
  #ifdef DEBUG_TRACE_ENABLED
    printf ("LEAVE routine_enterModifierWithSintInputArgument\n") ;
  #endif
}

//---------------------------------------------------------------------------*
//                                                                           *
//     Implementation of routine "enterModifierWithSint64InputArgument"      *
//                                                                           *
//---------------------------------------------------------------------------*

void routine_enterModifierWithSint64InputArgument (C_Compiler & inLexique,
                                GGS_modifierMapEXX  & var_cas_ioModifierMap,
                                const GGS_string  var_cas_inName,
                                const GGS_bool  var_cas_inHasCompilerArgument COMMA_UNUSED_LOCATION_ARGS) {
  #ifdef DEBUG_TRACE_ENABLED
    printf ("ENTER routine_enterModifierWithSint64InputArgument at %s:%d\n", __FILE__, __LINE__) ;
  #endif
  GGS_formalParameterSignatureEXX  var_cas_argList = GGS_formalParameterSignatureEXX ::constructor_emptyList () ;
  var_cas_argList.addAssign_operation (GGS_sint64GalgasType ::constructor_new (inLexique COMMA_HERE), GGS_formalArgumentPassingModeAST::constructor_argumentConstantIn (inLexique COMMA_HERE)) ;
  var_cas_ioModifierMap.modifier_insertKey (inLexique, GGS_lstring ::constructor_new (inLexique, var_cas_inName, GGS_location (inLexique) COMMA_HERE), var_cas_argList, var_cas_inHasCompilerArgument COMMA_SOURCE_FILE_AT_LINE (191)) ;
  #ifdef DEBUG_TRACE_ENABLED
    printf ("LEAVE routine_enterModifierWithSint64InputArgument\n") ;
  #endif
}

//---------------------------------------------------------------------------*
//                                                                           *
//     Implementation of routine "enterModifierWithDoubleInputArgument"      *
//                                                                           *
//---------------------------------------------------------------------------*

void routine_enterModifierWithDoubleInputArgument (C_Compiler & inLexique,
                                GGS_modifierMapEXX  & var_cas_ioModifierMap,
                                const GGS_string  var_cas_inName,
                                const GGS_bool  var_cas_inHasCompilerArgument COMMA_UNUSED_LOCATION_ARGS) {
  #ifdef DEBUG_TRACE_ENABLED
    printf ("ENTER routine_enterModifierWithDoubleInputArgument at %s:%d\n", __FILE__, __LINE__) ;
  #endif
  GGS_formalParameterSignatureEXX  var_cas_argList = GGS_formalParameterSignatureEXX ::constructor_emptyList () ;
  var_cas_argList.addAssign_operation (GGS_doubleGalgasType ::constructor_new (inLexique COMMA_HERE), GGS_formalArgumentPassingModeAST::constructor_argumentConstantIn (inLexique COMMA_HERE)) ;
  var_cas_ioModifierMap.modifier_insertKey (inLexique, GGS_lstring ::constructor_new (inLexique, var_cas_inName, GGS_location (inLexique) COMMA_HERE), var_cas_argList, var_cas_inHasCompilerArgument COMMA_SOURCE_FILE_AT_LINE (207)) ;
  #ifdef DEBUG_TRACE_ENABLED
    printf ("LEAVE routine_enterModifierWithDoubleInputArgument\n") ;
  #endif
}

//---------------------------------------------------------------------------*
//                                                                           *
//    Implementation of routine "enterModifierWithCharUintInputArgument"     *
//                                                                           *
//---------------------------------------------------------------------------*

void routine_enterModifierWithCharUintInputArgument (C_Compiler & inLexique,
                                GGS_modifierMapEXX  & var_cas_ioModifierMap,
                                const GGS_string  var_cas_inName,
                                const GGS_bool  var_cas_inHasCompilerArgument COMMA_UNUSED_LOCATION_ARGS) {
  #ifdef DEBUG_TRACE_ENABLED
    printf ("ENTER routine_enterModifierWithCharUintInputArgument at %s:%d\n", __FILE__, __LINE__) ;
  #endif
  GGS_formalParameterSignatureEXX  var_cas_argList = GGS_formalParameterSignatureEXX ::constructor_emptyList () ;
  var_cas_argList.addAssign_operation (GGS_charGalgasType ::constructor_new (inLexique COMMA_HERE), GGS_formalArgumentPassingModeAST::constructor_argumentConstantIn (inLexique COMMA_HERE)) ;
  var_cas_argList.addAssign_operation (GGS_uintGalgasType ::constructor_new (inLexique COMMA_HERE), GGS_formalArgumentPassingModeAST::constructor_argumentConstantIn (inLexique COMMA_HERE)) ;
  var_cas_ioModifierMap.modifier_insertKey (inLexique, GGS_lstring ::constructor_new (inLexique, var_cas_inName, GGS_location (inLexique) COMMA_HERE), var_cas_argList, var_cas_inHasCompilerArgument COMMA_SOURCE_FILE_AT_LINE (224)) ;
  #ifdef DEBUG_TRACE_ENABLED
    printf ("LEAVE routine_enterModifierWithCharUintInputArgument\n") ;
  #endif
}

//---------------------------------------------------------------------------*
//                                                                           *
//      Virtual Table for category reader '@ACGalgasType.modifierMap'        *
//                                                                           *
//---------------------------------------------------------------------------*

static TC_UniqueArray <typeCategoryReader__ACGalgasType__modifierMap> gDispatchTableForReader__ACGalgasType__modifierMap ;

//---------------------------------------------------------------------------*

void
enterCategoryReader__ACGalgasType__modifierMap (typeCategoryReader__ACGalgasType__modifierMap inRoutine,
                     const PMSInt32 inClassID) {
  gDispatchTableForReader__ACGalgasType__modifierMap.forceObjectAtIndex (inClassID, inRoutine, NULL COMMA_HERE) ;
}

//---------------------------------------------------------------------------*

static GGS_modifierMapEXX 
category_reader__ACGalgasType_defaultReader_modifierMap (C_Compiler &,
                                const cPtr_ACGalgasType *
                                COMMA_UNUSED_LOCATION_ARGS) {
  return GGS_modifierMapEXX  () ;
}

//---------------------------------------------------------------------------*

typeCategoryReader__ACGalgasType__modifierMap
findCategoryReader__ACGalgasType__modifierMap (AC_galgasClassRunTimeInformationEX * inClassPtr) {
  typeCategoryReader__ACGalgasType__modifierMap result = NULL ;
  if (inClassPtr->slotID () < gDispatchTableForReader__ACGalgasType__modifierMap.count ()) {
    result = gDispatchTableForReader__ACGalgasType__modifierMap (inClassPtr->slotID () COMMA_HERE) ;
  }
  if (result == NULL) {
    AC_galgasClassRunTimeInformationEX * superClassPtr = inClassPtr->superClassPtr () ;
    if (superClassPtr != NULL) {
      result = findCategoryReader__ACGalgasType__modifierMap (superClassPtr) ;
      gDispatchTableForReader__ACGalgasType__modifierMap.forceObjectAtIndex (inClassPtr->slotID (), result, NULL COMMA_HERE) ;
    }
  }
  if (NULL == result) {
    result = category_reader__ACGalgasType_defaultReader_modifierMap ;
  }
  return result ;
}

//---------------------------------------------------------------------------*
//                                                                           *
//        Implementation of once function "modifierMapFor_location"          *
//                                                                           *
//---------------------------------------------------------------------------*

static GGS_modifierMapEXX  gCachedResultForOnceFunction_modifierMapFor_location ;
static bool gCacheFlagForOnceFunction_modifierMapFor_location = false ;

//---------------------------------------------------------------------------*

GGS_modifierMapEXX  function_modifierMapFor_location (C_Compiler & inLexique COMMA_UNUSED_LOCATION_ARGS) {
  if (! gCacheFlagForOnceFunction_modifierMapFor_location) {
    #ifdef DEBUG_TRACE_ENABLED
      printf ("ENTER function_modifierMapFor_location at %s:%d\n", __FILE__, __LINE__) ;
    #endif
  GGS_modifierMapEXX  var_cas_outModifierMap ;
    var_cas_outModifierMap = GGS_modifierMapEXX ::constructor_emptyMap (inLexique COMMA_HERE) ;
    #ifdef DEBUG_TRACE_ENABLED
      printf ("LEAVE function_modifierMapFor_location\n") ;
    #endif
    gCacheFlagForOnceFunction_modifierMapFor_location = true ;
    gCachedResultForOnceFunction_modifierMapFor_location = var_cas_outModifierMap ;
  }
  return gCachedResultForOnceFunction_modifierMapFor_location ;
}

//---------------------------------------------------------------------------*

static GGS_object functionForGenericCall_modifierMapFor_location (C_Compiler & inLexique,
                           const GGS_objectlist & /* inEffectiveParameterArray */,
                           const GGS_location & /* inErrorLocation */
                           COMMA_LOCATION_ARGS) {
  const GGS_modifierMapEXX  result = function_modifierMapFor_location (inLexique
                            COMMA_THERE) ;
  return result.reader_object () ;
}

//---------------------------------------------------------------------------*

const C_galgas_function_descriptorEX kFunction_descriptor_modifierMapFor_location ("modifierMapFor_location",
                              functionForGenericCall_modifierMapFor_location,
                              & kTypeDescriptor_GGS_modifierMapEXX ,
                              0,
                              NULL) ;

//---------------------------------------------------------------------------*
//                                                                           *
//            Category reader '@locationGalgasType.modifierMap'              *
//                                                                           *
//---------------------------------------------------------------------------*

static GGS_modifierMapEXX 
category_reader__locationGalgasType__modifierMap (C_Compiler & inLexique,
                                const cPtr_locationGalgasType * operand_8294
                                COMMA_UNUSED_LOCATION_ARGS) {
  GGS_modifierMapEXX  var_cas_outModifierMap ;
  if (operand_8294 != NULL) {
    var_cas_outModifierMap = function_modifierMapFor_location (inLexique COMMA_SOURCE_FILE_AT_LINE (244)) ;
  }
  return var_cas_outModifierMap ;
}

//---------------------------------------------------------------------------*
//                                                                           *
//         Implementation of once function "modifierMapFor_string"           *
//                                                                           *
//---------------------------------------------------------------------------*

static GGS_modifierMapEXX  gCachedResultForOnceFunction_modifierMapFor_string ;
static bool gCacheFlagForOnceFunction_modifierMapFor_string = false ;

//---------------------------------------------------------------------------*

GGS_modifierMapEXX  function_modifierMapFor_string (C_Compiler & inLexique COMMA_UNUSED_LOCATION_ARGS) {
  if (! gCacheFlagForOnceFunction_modifierMapFor_string) {
    #ifdef DEBUG_TRACE_ENABLED
      printf ("ENTER function_modifierMapFor_string at %s:%d\n", __FILE__, __LINE__) ;
    #endif
  GGS_modifierMapEXX  var_cas_outModifierMap ;
    var_cas_outModifierMap = GGS_modifierMapEXX ::constructor_emptyMap (inLexique COMMA_HERE) ;
    ::routine_enterModifierWithUintInputArgument (inLexique,  var_cas_outModifierMap,  GGS_string ("setCapacity"),  GGS_bool (true) COMMA_SOURCE_FILE_AT_LINE (251)) ;
    ::routine_enterModifierWithUintInputArgument (inLexique,  var_cas_outModifierMap,  GGS_string ("incIndentation"),  GGS_bool (true) COMMA_SOURCE_FILE_AT_LINE (252)) ;
    ::routine_enterModifierWithUintInputArgument (inLexique,  var_cas_outModifierMap,  GGS_string ("decIndentation"),  GGS_bool (true) COMMA_SOURCE_FILE_AT_LINE (253)) ;
    ::routine_enterModifierWithCharUintInputArgument (inLexique,  var_cas_outModifierMap,  GGS_string ("setCharacterAtIndex"),  GGS_bool (true) COMMA_SOURCE_FILE_AT_LINE (254)) ;
    #ifdef DEBUG_TRACE_ENABLED
      printf ("LEAVE function_modifierMapFor_string\n") ;
    #endif
    gCacheFlagForOnceFunction_modifierMapFor_string = true ;
    gCachedResultForOnceFunction_modifierMapFor_string = var_cas_outModifierMap ;
  }
  return gCachedResultForOnceFunction_modifierMapFor_string ;
}

//---------------------------------------------------------------------------*

static GGS_object functionForGenericCall_modifierMapFor_string (C_Compiler & inLexique,
                           const GGS_objectlist & /* inEffectiveParameterArray */,
                           const GGS_location & /* inErrorLocation */
                           COMMA_LOCATION_ARGS) {
  const GGS_modifierMapEXX  result = function_modifierMapFor_string (inLexique
                            COMMA_THERE) ;
  return result.reader_object () ;
}

//---------------------------------------------------------------------------*

const C_galgas_function_descriptorEX kFunction_descriptor_modifierMapFor_string ("modifierMapFor_string",
                              functionForGenericCall_modifierMapFor_string,
                              & kTypeDescriptor_GGS_modifierMapEXX ,
                              0,
                              NULL) ;

//---------------------------------------------------------------------------*
//                                                                           *
//             Category reader '@stringGalgasType.modifierMap'               *
//                                                                           *
//---------------------------------------------------------------------------*

static GGS_modifierMapEXX 
category_reader__stringGalgasType__modifierMap (C_Compiler & inLexique,
                                const cPtr_stringGalgasType * operand_9045
                                COMMA_UNUSED_LOCATION_ARGS) {
  GGS_modifierMapEXX  var_cas_outModifierMap ;
  if (operand_9045 != NULL) {
    var_cas_outModifierMap = function_modifierMapFor_string (inLexique COMMA_SOURCE_FILE_AT_LINE (260)) ;
  }
  return var_cas_outModifierMap ;
}

//---------------------------------------------------------------------------*
//                                                                           *
//          Implementation of once function "modifierMapFor_char"            *
//                                                                           *
//---------------------------------------------------------------------------*

static GGS_modifierMapEXX  gCachedResultForOnceFunction_modifierMapFor_char ;
static bool gCacheFlagForOnceFunction_modifierMapFor_char = false ;

//---------------------------------------------------------------------------*

GGS_modifierMapEXX  function_modifierMapFor_char (C_Compiler & inLexique COMMA_UNUSED_LOCATION_ARGS) {
  if (! gCacheFlagForOnceFunction_modifierMapFor_char) {
    #ifdef DEBUG_TRACE_ENABLED
      printf ("ENTER function_modifierMapFor_char at %s:%d\n", __FILE__, __LINE__) ;
    #endif
  GGS_modifierMapEXX  var_cas_outModifierMap ;
    var_cas_outModifierMap = GGS_modifierMapEXX ::constructor_emptyMap (inLexique COMMA_HERE) ;
    #ifdef DEBUG_TRACE_ENABLED
      printf ("LEAVE function_modifierMapFor_char\n") ;
    #endif
    gCacheFlagForOnceFunction_modifierMapFor_char = true ;
    gCachedResultForOnceFunction_modifierMapFor_char = var_cas_outModifierMap ;
  }
  return gCachedResultForOnceFunction_modifierMapFor_char ;
}

//---------------------------------------------------------------------------*

static GGS_object functionForGenericCall_modifierMapFor_char (C_Compiler & inLexique,
                           const GGS_objectlist & /* inEffectiveParameterArray */,
                           const GGS_location & /* inErrorLocation */
                           COMMA_LOCATION_ARGS) {
  const GGS_modifierMapEXX  result = function_modifierMapFor_char (inLexique
                            COMMA_THERE) ;
  return result.reader_object () ;
}

//---------------------------------------------------------------------------*

const C_galgas_function_descriptorEX kFunction_descriptor_modifierMapFor_char ("modifierMapFor_char",
                              functionForGenericCall_modifierMapFor_char,
                              & kTypeDescriptor_GGS_modifierMapEXX ,
                              0,
                              NULL) ;

//---------------------------------------------------------------------------*
//                                                                           *
//              Category reader '@charGalgasType.modifierMap'                *
//                                                                           *
//---------------------------------------------------------------------------*

static GGS_modifierMapEXX 
category_reader__charGalgasType__modifierMap (C_Compiler & inLexique,
                                const cPtr_charGalgasType * operand_9464
                                COMMA_UNUSED_LOCATION_ARGS) {
  GGS_modifierMapEXX  var_cas_outModifierMap ;
  if (operand_9464 != NULL) {
    var_cas_outModifierMap = function_modifierMapFor_char (inLexique COMMA_SOURCE_FILE_AT_LINE (272)) ;
  }
  return var_cas_outModifierMap ;
}

//---------------------------------------------------------------------------*
//                                                                           *
//          Implementation of once function "modifierMapFor_bool"            *
//                                                                           *
//---------------------------------------------------------------------------*

static GGS_modifierMapEXX  gCachedResultForOnceFunction_modifierMapFor_bool ;
static bool gCacheFlagForOnceFunction_modifierMapFor_bool = false ;

//---------------------------------------------------------------------------*

GGS_modifierMapEXX  function_modifierMapFor_bool (C_Compiler & inLexique COMMA_UNUSED_LOCATION_ARGS) {
  if (! gCacheFlagForOnceFunction_modifierMapFor_bool) {
    #ifdef DEBUG_TRACE_ENABLED
      printf ("ENTER function_modifierMapFor_bool at %s:%d\n", __FILE__, __LINE__) ;
    #endif
  GGS_modifierMapEXX  var_cas_outModifierMap ;
    var_cas_outModifierMap = GGS_modifierMapEXX ::constructor_emptyMap (inLexique COMMA_HERE) ;
    #ifdef DEBUG_TRACE_ENABLED
      printf ("LEAVE function_modifierMapFor_bool\n") ;
    #endif
    gCacheFlagForOnceFunction_modifierMapFor_bool = true ;
    gCachedResultForOnceFunction_modifierMapFor_bool = var_cas_outModifierMap ;
  }
  return gCachedResultForOnceFunction_modifierMapFor_bool ;
}

//---------------------------------------------------------------------------*

static GGS_object functionForGenericCall_modifierMapFor_bool (C_Compiler & inLexique,
                           const GGS_objectlist & /* inEffectiveParameterArray */,
                           const GGS_location & /* inErrorLocation */
                           COMMA_LOCATION_ARGS) {
  const GGS_modifierMapEXX  result = function_modifierMapFor_bool (inLexique
                            COMMA_THERE) ;
  return result.reader_object () ;
}

//---------------------------------------------------------------------------*

const C_galgas_function_descriptorEX kFunction_descriptor_modifierMapFor_bool ("modifierMapFor_bool",
                              functionForGenericCall_modifierMapFor_bool,
                              & kTypeDescriptor_GGS_modifierMapEXX ,
                              0,
                              NULL) ;

//---------------------------------------------------------------------------*
//                                                                           *
//              Category reader '@boolGalgasType.modifierMap'                *
//                                                                           *
//---------------------------------------------------------------------------*

static GGS_modifierMapEXX 
category_reader__boolGalgasType__modifierMap (C_Compiler & inLexique,
                                const cPtr_boolGalgasType * operand_9881
                                COMMA_UNUSED_LOCATION_ARGS) {
  GGS_modifierMapEXX  var_cas_outModifierMap ;
  if (operand_9881 != NULL) {
    var_cas_outModifierMap = function_modifierMapFor_bool (inLexique COMMA_SOURCE_FILE_AT_LINE (284)) ;
  }
  return var_cas_outModifierMap ;
}

//---------------------------------------------------------------------------*
//                                                                           *
//          Implementation of once function "modifierMapFor_uint"            *
//                                                                           *
//---------------------------------------------------------------------------*

static GGS_modifierMapEXX  gCachedResultForOnceFunction_modifierMapFor_uint ;
static bool gCacheFlagForOnceFunction_modifierMapFor_uint = false ;

//---------------------------------------------------------------------------*

GGS_modifierMapEXX  function_modifierMapFor_uint (C_Compiler & inLexique COMMA_UNUSED_LOCATION_ARGS) {
  if (! gCacheFlagForOnceFunction_modifierMapFor_uint) {
    #ifdef DEBUG_TRACE_ENABLED
      printf ("ENTER function_modifierMapFor_uint at %s:%d\n", __FILE__, __LINE__) ;
    #endif
  GGS_modifierMapEXX  var_cas_outModifierMap ;
    var_cas_outModifierMap = GGS_modifierMapEXX ::constructor_emptyMap (inLexique COMMA_HERE) ;
    #ifdef DEBUG_TRACE_ENABLED
      printf ("LEAVE function_modifierMapFor_uint\n") ;
    #endif
    gCacheFlagForOnceFunction_modifierMapFor_uint = true ;
    gCachedResultForOnceFunction_modifierMapFor_uint = var_cas_outModifierMap ;
  }
  return gCachedResultForOnceFunction_modifierMapFor_uint ;
}

//---------------------------------------------------------------------------*

static GGS_object functionForGenericCall_modifierMapFor_uint (C_Compiler & inLexique,
                           const GGS_objectlist & /* inEffectiveParameterArray */,
                           const GGS_location & /* inErrorLocation */
                           COMMA_LOCATION_ARGS) {
  const GGS_modifierMapEXX  result = function_modifierMapFor_uint (inLexique
                            COMMA_THERE) ;
  return result.reader_object () ;
}

//---------------------------------------------------------------------------*

const C_galgas_function_descriptorEX kFunction_descriptor_modifierMapFor_uint ("modifierMapFor_uint",
                              functionForGenericCall_modifierMapFor_uint,
                              & kTypeDescriptor_GGS_modifierMapEXX ,
                              0,
                              NULL) ;

//---------------------------------------------------------------------------*
//                                                                           *
//              Category reader '@uintGalgasType.modifierMap'                *
//                                                                           *
//---------------------------------------------------------------------------*

static GGS_modifierMapEXX 
category_reader__uintGalgasType__modifierMap (C_Compiler & inLexique,
                                const cPtr_uintGalgasType * operand_10300
                                COMMA_UNUSED_LOCATION_ARGS) {
  GGS_modifierMapEXX  var_cas_outModifierMap ;
  if (operand_10300 != NULL) {
    var_cas_outModifierMap = function_modifierMapFor_uint (inLexique COMMA_SOURCE_FILE_AT_LINE (296)) ;
  }
  return var_cas_outModifierMap ;
}

//---------------------------------------------------------------------------*
//                                                                           *
//          Implementation of once function "modifierMapFor_sint"            *
//                                                                           *
//---------------------------------------------------------------------------*

static GGS_modifierMapEXX  gCachedResultForOnceFunction_modifierMapFor_sint ;
static bool gCacheFlagForOnceFunction_modifierMapFor_sint = false ;

//---------------------------------------------------------------------------*

GGS_modifierMapEXX  function_modifierMapFor_sint (C_Compiler & inLexique COMMA_UNUSED_LOCATION_ARGS) {
  if (! gCacheFlagForOnceFunction_modifierMapFor_sint) {
    #ifdef DEBUG_TRACE_ENABLED
      printf ("ENTER function_modifierMapFor_sint at %s:%d\n", __FILE__, __LINE__) ;
    #endif
  GGS_modifierMapEXX  var_cas_outModifierMap ;
    var_cas_outModifierMap = GGS_modifierMapEXX ::constructor_emptyMap (inLexique COMMA_HERE) ;
    #ifdef DEBUG_TRACE_ENABLED
      printf ("LEAVE function_modifierMapFor_sint\n") ;
    #endif
    gCacheFlagForOnceFunction_modifierMapFor_sint = true ;
    gCachedResultForOnceFunction_modifierMapFor_sint = var_cas_outModifierMap ;
  }
  return gCachedResultForOnceFunction_modifierMapFor_sint ;
}

//---------------------------------------------------------------------------*

static GGS_object functionForGenericCall_modifierMapFor_sint (C_Compiler & inLexique,
                           const GGS_objectlist & /* inEffectiveParameterArray */,
                           const GGS_location & /* inErrorLocation */
                           COMMA_LOCATION_ARGS) {
  const GGS_modifierMapEXX  result = function_modifierMapFor_sint (inLexique
                            COMMA_THERE) ;
  return result.reader_object () ;
}

//---------------------------------------------------------------------------*

const C_galgas_function_descriptorEX kFunction_descriptor_modifierMapFor_sint ("modifierMapFor_sint",
                              functionForGenericCall_modifierMapFor_sint,
                              & kTypeDescriptor_GGS_modifierMapEXX ,
                              0,
                              NULL) ;

//---------------------------------------------------------------------------*
//                                                                           *
//              Category reader '@sintGalgasType.modifierMap'                *
//                                                                           *
//---------------------------------------------------------------------------*

static GGS_modifierMapEXX 
category_reader__sintGalgasType__modifierMap (C_Compiler & inLexique,
                                const cPtr_sintGalgasType * operand_10717
                                COMMA_UNUSED_LOCATION_ARGS) {
  GGS_modifierMapEXX  var_cas_outModifierMap ;
  if (operand_10717 != NULL) {
    var_cas_outModifierMap = function_modifierMapFor_sint (inLexique COMMA_SOURCE_FILE_AT_LINE (308)) ;
  }
  return var_cas_outModifierMap ;
}

//---------------------------------------------------------------------------*
//                                                                           *
//         Implementation of once function "modifierMapFor_uint64"           *
//                                                                           *
//---------------------------------------------------------------------------*

static GGS_modifierMapEXX  gCachedResultForOnceFunction_modifierMapFor_uint64 ;
static bool gCacheFlagForOnceFunction_modifierMapFor_uint64 = false ;

//---------------------------------------------------------------------------*

GGS_modifierMapEXX  function_modifierMapFor_uint64 (C_Compiler & inLexique COMMA_UNUSED_LOCATION_ARGS) {
  if (! gCacheFlagForOnceFunction_modifierMapFor_uint64) {
    #ifdef DEBUG_TRACE_ENABLED
      printf ("ENTER function_modifierMapFor_uint64 at %s:%d\n", __FILE__, __LINE__) ;
    #endif
  GGS_modifierMapEXX  var_cas_outModifierMap ;
    var_cas_outModifierMap = GGS_modifierMapEXX ::constructor_emptyMap (inLexique COMMA_HERE) ;
    #ifdef DEBUG_TRACE_ENABLED
      printf ("LEAVE function_modifierMapFor_uint64\n") ;
    #endif
    gCacheFlagForOnceFunction_modifierMapFor_uint64 = true ;
    gCachedResultForOnceFunction_modifierMapFor_uint64 = var_cas_outModifierMap ;
  }
  return gCachedResultForOnceFunction_modifierMapFor_uint64 ;
}

//---------------------------------------------------------------------------*

static GGS_object functionForGenericCall_modifierMapFor_uint64 (C_Compiler & inLexique,
                           const GGS_objectlist & /* inEffectiveParameterArray */,
                           const GGS_location & /* inErrorLocation */
                           COMMA_LOCATION_ARGS) {
  const GGS_modifierMapEXX  result = function_modifierMapFor_uint64 (inLexique
                            COMMA_THERE) ;
  return result.reader_object () ;
}

//---------------------------------------------------------------------------*

const C_galgas_function_descriptorEX kFunction_descriptor_modifierMapFor_uint64 ("modifierMapFor_uint64",
                              functionForGenericCall_modifierMapFor_uint64,
                              & kTypeDescriptor_GGS_modifierMapEXX ,
                              0,
                              NULL) ;

//---------------------------------------------------------------------------*
//                                                                           *
//             Category reader '@uint64GalgasType.modifierMap'               *
//                                                                           *
//---------------------------------------------------------------------------*

static GGS_modifierMapEXX 
category_reader__uint64GalgasType__modifierMap (C_Compiler & inLexique,
                                const cPtr_uint64GalgasType * operand_11138
                                COMMA_UNUSED_LOCATION_ARGS) {
  GGS_modifierMapEXX  var_cas_outModifierMap ;
  if (operand_11138 != NULL) {
    var_cas_outModifierMap = function_modifierMapFor_uint64 (inLexique COMMA_SOURCE_FILE_AT_LINE (320)) ;
  }
  return var_cas_outModifierMap ;
}

//---------------------------------------------------------------------------*
//                                                                           *
//         Implementation of once function "modifierMapFor_sint64"           *
//                                                                           *
//---------------------------------------------------------------------------*

static GGS_modifierMapEXX  gCachedResultForOnceFunction_modifierMapFor_sint64 ;
static bool gCacheFlagForOnceFunction_modifierMapFor_sint64 = false ;

//---------------------------------------------------------------------------*

GGS_modifierMapEXX  function_modifierMapFor_sint64 (C_Compiler & inLexique COMMA_UNUSED_LOCATION_ARGS) {
  if (! gCacheFlagForOnceFunction_modifierMapFor_sint64) {
    #ifdef DEBUG_TRACE_ENABLED
      printf ("ENTER function_modifierMapFor_sint64 at %s:%d\n", __FILE__, __LINE__) ;
    #endif
  GGS_modifierMapEXX  var_cas_outModifierMap ;
    var_cas_outModifierMap = GGS_modifierMapEXX ::constructor_emptyMap (inLexique COMMA_HERE) ;
    #ifdef DEBUG_TRACE_ENABLED
      printf ("LEAVE function_modifierMapFor_sint64\n") ;
    #endif
    gCacheFlagForOnceFunction_modifierMapFor_sint64 = true ;
    gCachedResultForOnceFunction_modifierMapFor_sint64 = var_cas_outModifierMap ;
  }
  return gCachedResultForOnceFunction_modifierMapFor_sint64 ;
}

//---------------------------------------------------------------------------*

static GGS_object functionForGenericCall_modifierMapFor_sint64 (C_Compiler & inLexique,
                           const GGS_objectlist & /* inEffectiveParameterArray */,
                           const GGS_location & /* inErrorLocation */
                           COMMA_LOCATION_ARGS) {
  const GGS_modifierMapEXX  result = function_modifierMapFor_sint64 (inLexique
                            COMMA_THERE) ;
  return result.reader_object () ;
}

//---------------------------------------------------------------------------*

const C_galgas_function_descriptorEX kFunction_descriptor_modifierMapFor_sint64 ("modifierMapFor_sint64",
                              functionForGenericCall_modifierMapFor_sint64,
                              & kTypeDescriptor_GGS_modifierMapEXX ,
                              0,
                              NULL) ;

//---------------------------------------------------------------------------*
//                                                                           *
//             Category reader '@sint64GalgasType.modifierMap'               *
//                                                                           *
//---------------------------------------------------------------------------*

static GGS_modifierMapEXX 
category_reader__sint64GalgasType__modifierMap (C_Compiler & inLexique,
                                const cPtr_sint64GalgasType * operand_11561
                                COMMA_UNUSED_LOCATION_ARGS) {
  GGS_modifierMapEXX  var_cas_outModifierMap ;
  if (operand_11561 != NULL) {
    var_cas_outModifierMap = function_modifierMapFor_sint64 (inLexique COMMA_SOURCE_FILE_AT_LINE (332)) ;
  }
  return var_cas_outModifierMap ;
}

//---------------------------------------------------------------------------*
//                                                                           *
//         Implementation of once function "modifierMapFor_double"           *
//                                                                           *
//---------------------------------------------------------------------------*

static GGS_modifierMapEXX  gCachedResultForOnceFunction_modifierMapFor_double ;
static bool gCacheFlagForOnceFunction_modifierMapFor_double = false ;

//---------------------------------------------------------------------------*

GGS_modifierMapEXX  function_modifierMapFor_double (C_Compiler & inLexique COMMA_UNUSED_LOCATION_ARGS) {
  if (! gCacheFlagForOnceFunction_modifierMapFor_double) {
    #ifdef DEBUG_TRACE_ENABLED
      printf ("ENTER function_modifierMapFor_double at %s:%d\n", __FILE__, __LINE__) ;
    #endif
  GGS_modifierMapEXX  var_cas_outModifierMap ;
    var_cas_outModifierMap = GGS_modifierMapEXX ::constructor_emptyMap (inLexique COMMA_HERE) ;
    #ifdef DEBUG_TRACE_ENABLED
      printf ("LEAVE function_modifierMapFor_double\n") ;
    #endif
    gCacheFlagForOnceFunction_modifierMapFor_double = true ;
    gCachedResultForOnceFunction_modifierMapFor_double = var_cas_outModifierMap ;
  }
  return gCachedResultForOnceFunction_modifierMapFor_double ;
}

//---------------------------------------------------------------------------*

static GGS_object functionForGenericCall_modifierMapFor_double (C_Compiler & inLexique,
                           const GGS_objectlist & /* inEffectiveParameterArray */,
                           const GGS_location & /* inErrorLocation */
                           COMMA_LOCATION_ARGS) {
  const GGS_modifierMapEXX  result = function_modifierMapFor_double (inLexique
                            COMMA_THERE) ;
  return result.reader_object () ;
}

//---------------------------------------------------------------------------*

const C_galgas_function_descriptorEX kFunction_descriptor_modifierMapFor_double ("modifierMapFor_double",
                              functionForGenericCall_modifierMapFor_double,
                              & kTypeDescriptor_GGS_modifierMapEXX ,
                              0,
                              NULL) ;

//---------------------------------------------------------------------------*
//                                                                           *
//             Category reader '@doubleGalgasType.modifierMap'               *
//                                                                           *
//---------------------------------------------------------------------------*

static GGS_modifierMapEXX 
category_reader__doubleGalgasType__modifierMap (C_Compiler & inLexique,
                                const cPtr_doubleGalgasType * operand_11984
                                COMMA_UNUSED_LOCATION_ARGS) {
  GGS_modifierMapEXX  var_cas_outModifierMap ;
  if (operand_11984 != NULL) {
    var_cas_outModifierMap = function_modifierMapFor_double (inLexique COMMA_SOURCE_FILE_AT_LINE (344)) ;
  }
  return var_cas_outModifierMap ;
}

//---------------------------------------------------------------------------*
//                                                                           *
//         Implementation of once function "modifierMapFor_lstring"          *
//                                                                           *
//---------------------------------------------------------------------------*

static GGS_modifierMapEXX  gCachedResultForOnceFunction_modifierMapFor_lstring ;
static bool gCacheFlagForOnceFunction_modifierMapFor_lstring = false ;

//---------------------------------------------------------------------------*

GGS_modifierMapEXX  function_modifierMapFor_lstring (C_Compiler & inLexique COMMA_UNUSED_LOCATION_ARGS) {
  if (! gCacheFlagForOnceFunction_modifierMapFor_lstring) {
    #ifdef DEBUG_TRACE_ENABLED
      printf ("ENTER function_modifierMapFor_lstring at %s:%d\n", __FILE__, __LINE__) ;
    #endif
  GGS_modifierMapEXX  var_cas_outModifierMap ;
    var_cas_outModifierMap = GGS_modifierMapEXX ::constructor_emptyMap (inLexique COMMA_HERE) ;
    ::routine_enterModifierWithStringInputArgument (inLexique,  var_cas_outModifierMap,  GGS_string ("setString"),  GGS_bool (false) COMMA_SOURCE_FILE_AT_LINE (351)) ;
    ::routine_enterModifierWithLocationInputArgument (inLexique,  var_cas_outModifierMap,  GGS_string ("setLocation"),  GGS_bool (false) COMMA_SOURCE_FILE_AT_LINE (352)) ;
    #ifdef DEBUG_TRACE_ENABLED
      printf ("LEAVE function_modifierMapFor_lstring\n") ;
    #endif
    gCacheFlagForOnceFunction_modifierMapFor_lstring = true ;
    gCachedResultForOnceFunction_modifierMapFor_lstring = var_cas_outModifierMap ;
  }
  return gCachedResultForOnceFunction_modifierMapFor_lstring ;
}

//---------------------------------------------------------------------------*

static GGS_object functionForGenericCall_modifierMapFor_lstring (C_Compiler & inLexique,
                           const GGS_objectlist & /* inEffectiveParameterArray */,
                           const GGS_location & /* inErrorLocation */
                           COMMA_LOCATION_ARGS) {
  const GGS_modifierMapEXX  result = function_modifierMapFor_lstring (inLexique
                            COMMA_THERE) ;
  return result.reader_object () ;
}

//---------------------------------------------------------------------------*

const C_galgas_function_descriptorEX kFunction_descriptor_modifierMapFor_lstring ("modifierMapFor_lstring",
                              functionForGenericCall_modifierMapFor_lstring,
                              & kTypeDescriptor_GGS_modifierMapEXX ,
                              0,
                              NULL) ;

//---------------------------------------------------------------------------*
//                                                                           *
//             Category reader '@lstringGalgasType.modifierMap'              *
//                                                                           *
//---------------------------------------------------------------------------*

static GGS_modifierMapEXX 
category_reader__lstringGalgasType__modifierMap (C_Compiler & inLexique,
                                const cPtr_lstringGalgasType * operand_12569
                                COMMA_UNUSED_LOCATION_ARGS) {
  GGS_modifierMapEXX  var_cas_outModifierMap ;
  if (operand_12569 != NULL) {
    var_cas_outModifierMap = function_modifierMapFor_lstring (inLexique COMMA_SOURCE_FILE_AT_LINE (358)) ;
  }
  return var_cas_outModifierMap ;
}

//---------------------------------------------------------------------------*
//                                                                           *
//          Implementation of once function "modifierMapFor_lchar"           *
//                                                                           *
//---------------------------------------------------------------------------*

static GGS_modifierMapEXX  gCachedResultForOnceFunction_modifierMapFor_lchar ;
static bool gCacheFlagForOnceFunction_modifierMapFor_lchar = false ;

//---------------------------------------------------------------------------*

GGS_modifierMapEXX  function_modifierMapFor_lchar (C_Compiler & inLexique COMMA_UNUSED_LOCATION_ARGS) {
  if (! gCacheFlagForOnceFunction_modifierMapFor_lchar) {
    #ifdef DEBUG_TRACE_ENABLED
      printf ("ENTER function_modifierMapFor_lchar at %s:%d\n", __FILE__, __LINE__) ;
    #endif
  GGS_modifierMapEXX  var_cas_outModifierMap ;
    var_cas_outModifierMap = GGS_modifierMapEXX ::constructor_emptyMap (inLexique COMMA_HERE) ;
    ::routine_enterModifierWithCharInputArgument (inLexique,  var_cas_outModifierMap,  GGS_string ("setChar"),  GGS_bool (false) COMMA_SOURCE_FILE_AT_LINE (365)) ;
    ::routine_enterModifierWithLocationInputArgument (inLexique,  var_cas_outModifierMap,  GGS_string ("setLocation"),  GGS_bool (false) COMMA_SOURCE_FILE_AT_LINE (366)) ;
    #ifdef DEBUG_TRACE_ENABLED
      printf ("LEAVE function_modifierMapFor_lchar\n") ;
    #endif
    gCacheFlagForOnceFunction_modifierMapFor_lchar = true ;
    gCachedResultForOnceFunction_modifierMapFor_lchar = var_cas_outModifierMap ;
  }
  return gCachedResultForOnceFunction_modifierMapFor_lchar ;
}

//---------------------------------------------------------------------------*

static GGS_object functionForGenericCall_modifierMapFor_lchar (C_Compiler & inLexique,
                           const GGS_objectlist & /* inEffectiveParameterArray */,
                           const GGS_location & /* inErrorLocation */
                           COMMA_LOCATION_ARGS) {
  const GGS_modifierMapEXX  result = function_modifierMapFor_lchar (inLexique
                            COMMA_THERE) ;
  return result.reader_object () ;
}

//---------------------------------------------------------------------------*

const C_galgas_function_descriptorEX kFunction_descriptor_modifierMapFor_lchar ("modifierMapFor_lchar",
                              functionForGenericCall_modifierMapFor_lchar,
                              & kTypeDescriptor_GGS_modifierMapEXX ,
                              0,
                              NULL) ;

//---------------------------------------------------------------------------*
//                                                                           *
//              Category reader '@lcharGalgasType.modifierMap'               *
//                                                                           *
//---------------------------------------------------------------------------*

static GGS_modifierMapEXX 
category_reader__lcharGalgasType__modifierMap (C_Compiler & inLexique,
                                const cPtr_lcharGalgasType * operand_13147
                                COMMA_UNUSED_LOCATION_ARGS) {
  GGS_modifierMapEXX  var_cas_outModifierMap ;
  if (operand_13147 != NULL) {
    var_cas_outModifierMap = function_modifierMapFor_lchar (inLexique COMMA_SOURCE_FILE_AT_LINE (372)) ;
  }
  return var_cas_outModifierMap ;
}

//---------------------------------------------------------------------------*
//                                                                           *
//          Implementation of once function "modifierMapFor_lbool"           *
//                                                                           *
//---------------------------------------------------------------------------*

static GGS_modifierMapEXX  gCachedResultForOnceFunction_modifierMapFor_lbool ;
static bool gCacheFlagForOnceFunction_modifierMapFor_lbool = false ;

//---------------------------------------------------------------------------*

GGS_modifierMapEXX  function_modifierMapFor_lbool (C_Compiler & inLexique COMMA_UNUSED_LOCATION_ARGS) {
  if (! gCacheFlagForOnceFunction_modifierMapFor_lbool) {
    #ifdef DEBUG_TRACE_ENABLED
      printf ("ENTER function_modifierMapFor_lbool at %s:%d\n", __FILE__, __LINE__) ;
    #endif
  GGS_modifierMapEXX  var_cas_outModifierMap ;
    var_cas_outModifierMap = GGS_modifierMapEXX ::constructor_emptyMap (inLexique COMMA_HERE) ;
    ::routine_enterModifierWithBoolInputArgument (inLexique,  var_cas_outModifierMap,  GGS_string ("setBool"),  GGS_bool (false) COMMA_SOURCE_FILE_AT_LINE (379)) ;
    ::routine_enterModifierWithLocationInputArgument (inLexique,  var_cas_outModifierMap,  GGS_string ("setLocation"),  GGS_bool (false) COMMA_SOURCE_FILE_AT_LINE (380)) ;
    #ifdef DEBUG_TRACE_ENABLED
      printf ("LEAVE function_modifierMapFor_lbool\n") ;
    #endif
    gCacheFlagForOnceFunction_modifierMapFor_lbool = true ;
    gCachedResultForOnceFunction_modifierMapFor_lbool = var_cas_outModifierMap ;
  }
  return gCachedResultForOnceFunction_modifierMapFor_lbool ;
}

//---------------------------------------------------------------------------*

static GGS_object functionForGenericCall_modifierMapFor_lbool (C_Compiler & inLexique,
                           const GGS_objectlist & /* inEffectiveParameterArray */,
                           const GGS_location & /* inErrorLocation */
                           COMMA_LOCATION_ARGS) {
  const GGS_modifierMapEXX  result = function_modifierMapFor_lbool (inLexique
                            COMMA_THERE) ;
  return result.reader_object () ;
}

//---------------------------------------------------------------------------*

const C_galgas_function_descriptorEX kFunction_descriptor_modifierMapFor_lbool ("modifierMapFor_lbool",
                              functionForGenericCall_modifierMapFor_lbool,
                              & kTypeDescriptor_GGS_modifierMapEXX ,
                              0,
                              NULL) ;

//---------------------------------------------------------------------------*
//                                                                           *
//              Category reader '@lboolGalgasType.modifierMap'               *
//                                                                           *
//---------------------------------------------------------------------------*

static GGS_modifierMapEXX 
category_reader__lboolGalgasType__modifierMap (C_Compiler & inLexique,
                                const cPtr_lboolGalgasType * operand_13723
                                COMMA_UNUSED_LOCATION_ARGS) {
  GGS_modifierMapEXX  var_cas_outModifierMap ;
  if (operand_13723 != NULL) {
    var_cas_outModifierMap = function_modifierMapFor_lbool (inLexique COMMA_SOURCE_FILE_AT_LINE (386)) ;
  }
  return var_cas_outModifierMap ;
}

//---------------------------------------------------------------------------*
//                                                                           *
//          Implementation of once function "modifierMapFor_luint"           *
//                                                                           *
//---------------------------------------------------------------------------*

static GGS_modifierMapEXX  gCachedResultForOnceFunction_modifierMapFor_luint ;
static bool gCacheFlagForOnceFunction_modifierMapFor_luint = false ;

//---------------------------------------------------------------------------*

GGS_modifierMapEXX  function_modifierMapFor_luint (C_Compiler & inLexique COMMA_UNUSED_LOCATION_ARGS) {
  if (! gCacheFlagForOnceFunction_modifierMapFor_luint) {
    #ifdef DEBUG_TRACE_ENABLED
      printf ("ENTER function_modifierMapFor_luint at %s:%d\n", __FILE__, __LINE__) ;
    #endif
  GGS_modifierMapEXX  var_cas_outModifierMap ;
    var_cas_outModifierMap = GGS_modifierMapEXX ::constructor_emptyMap (inLexique COMMA_HERE) ;
    ::routine_enterModifierWithUintInputArgument (inLexique,  var_cas_outModifierMap,  GGS_string ("setUint"),  GGS_bool (false) COMMA_SOURCE_FILE_AT_LINE (393)) ;
    ::routine_enterModifierWithLocationInputArgument (inLexique,  var_cas_outModifierMap,  GGS_string ("setLocation"),  GGS_bool (false) COMMA_SOURCE_FILE_AT_LINE (394)) ;
    #ifdef DEBUG_TRACE_ENABLED
      printf ("LEAVE function_modifierMapFor_luint\n") ;
    #endif
    gCacheFlagForOnceFunction_modifierMapFor_luint = true ;
    gCachedResultForOnceFunction_modifierMapFor_luint = var_cas_outModifierMap ;
  }
  return gCachedResultForOnceFunction_modifierMapFor_luint ;
}

//---------------------------------------------------------------------------*

static GGS_object functionForGenericCall_modifierMapFor_luint (C_Compiler & inLexique,
                           const GGS_objectlist & /* inEffectiveParameterArray */,
                           const GGS_location & /* inErrorLocation */
                           COMMA_LOCATION_ARGS) {
  const GGS_modifierMapEXX  result = function_modifierMapFor_luint (inLexique
                            COMMA_THERE) ;
  return result.reader_object () ;
}

//---------------------------------------------------------------------------*

const C_galgas_function_descriptorEX kFunction_descriptor_modifierMapFor_luint ("modifierMapFor_luint",
                              functionForGenericCall_modifierMapFor_luint,
                              & kTypeDescriptor_GGS_modifierMapEXX ,
                              0,
                              NULL) ;

//---------------------------------------------------------------------------*
//                                                                           *
//              Category reader '@luintGalgasType.modifierMap'               *
//                                                                           *
//---------------------------------------------------------------------------*

static GGS_modifierMapEXX 
category_reader__luintGalgasType__modifierMap (C_Compiler & inLexique,
                                const cPtr_luintGalgasType * operand_14299
                                COMMA_UNUSED_LOCATION_ARGS) {
  GGS_modifierMapEXX  var_cas_outModifierMap ;
  if (operand_14299 != NULL) {
    var_cas_outModifierMap = function_modifierMapFor_luint (inLexique COMMA_SOURCE_FILE_AT_LINE (400)) ;
  }
  return var_cas_outModifierMap ;
}

//---------------------------------------------------------------------------*
//                                                                           *
//          Implementation of once function "modifierMapFor_lsint"           *
//                                                                           *
//---------------------------------------------------------------------------*

static GGS_modifierMapEXX  gCachedResultForOnceFunction_modifierMapFor_lsint ;
static bool gCacheFlagForOnceFunction_modifierMapFor_lsint = false ;

//---------------------------------------------------------------------------*

GGS_modifierMapEXX  function_modifierMapFor_lsint (C_Compiler & inLexique COMMA_UNUSED_LOCATION_ARGS) {
  if (! gCacheFlagForOnceFunction_modifierMapFor_lsint) {
    #ifdef DEBUG_TRACE_ENABLED
      printf ("ENTER function_modifierMapFor_lsint at %s:%d\n", __FILE__, __LINE__) ;
    #endif
  GGS_modifierMapEXX  var_cas_outModifierMap ;
    var_cas_outModifierMap = GGS_modifierMapEXX ::constructor_emptyMap (inLexique COMMA_HERE) ;
    ::routine_enterModifierWithSintInputArgument (inLexique,  var_cas_outModifierMap,  GGS_string ("setSint"),  GGS_bool (false) COMMA_SOURCE_FILE_AT_LINE (407)) ;
    ::routine_enterModifierWithLocationInputArgument (inLexique,  var_cas_outModifierMap,  GGS_string ("setLocation"),  GGS_bool (false) COMMA_SOURCE_FILE_AT_LINE (408)) ;
    #ifdef DEBUG_TRACE_ENABLED
      printf ("LEAVE function_modifierMapFor_lsint\n") ;
    #endif
    gCacheFlagForOnceFunction_modifierMapFor_lsint = true ;
    gCachedResultForOnceFunction_modifierMapFor_lsint = var_cas_outModifierMap ;
  }
  return gCachedResultForOnceFunction_modifierMapFor_lsint ;
}

//---------------------------------------------------------------------------*

static GGS_object functionForGenericCall_modifierMapFor_lsint (C_Compiler & inLexique,
                           const GGS_objectlist & /* inEffectiveParameterArray */,
                           const GGS_location & /* inErrorLocation */
                           COMMA_LOCATION_ARGS) {
  const GGS_modifierMapEXX  result = function_modifierMapFor_lsint (inLexique
                            COMMA_THERE) ;
  return result.reader_object () ;
}

//---------------------------------------------------------------------------*

const C_galgas_function_descriptorEX kFunction_descriptor_modifierMapFor_lsint ("modifierMapFor_lsint",
                              functionForGenericCall_modifierMapFor_lsint,
                              & kTypeDescriptor_GGS_modifierMapEXX ,
                              0,
                              NULL) ;

//---------------------------------------------------------------------------*
//                                                                           *
//              Category reader '@lsintGalgasType.modifierMap'               *
//                                                                           *
//---------------------------------------------------------------------------*

static GGS_modifierMapEXX 
category_reader__lsintGalgasType__modifierMap (C_Compiler & inLexique,
                                const cPtr_lsintGalgasType * operand_14875
                                COMMA_UNUSED_LOCATION_ARGS) {
  GGS_modifierMapEXX  var_cas_outModifierMap ;
  if (operand_14875 != NULL) {
    var_cas_outModifierMap = function_modifierMapFor_lsint (inLexique COMMA_SOURCE_FILE_AT_LINE (414)) ;
  }
  return var_cas_outModifierMap ;
}

//---------------------------------------------------------------------------*
//                                                                           *
//         Implementation of once function "modifierMapFor_luint64"          *
//                                                                           *
//---------------------------------------------------------------------------*

static GGS_modifierMapEXX  gCachedResultForOnceFunction_modifierMapFor_luint64 ;
static bool gCacheFlagForOnceFunction_modifierMapFor_luint64 = false ;

//---------------------------------------------------------------------------*

GGS_modifierMapEXX  function_modifierMapFor_luint64 (C_Compiler & inLexique COMMA_UNUSED_LOCATION_ARGS) {
  if (! gCacheFlagForOnceFunction_modifierMapFor_luint64) {
    #ifdef DEBUG_TRACE_ENABLED
      printf ("ENTER function_modifierMapFor_luint64 at %s:%d\n", __FILE__, __LINE__) ;
    #endif
  GGS_modifierMapEXX  var_cas_outModifierMap ;
    var_cas_outModifierMap = GGS_modifierMapEXX ::constructor_emptyMap (inLexique COMMA_HERE) ;
    ::routine_enterModifierWithUint64InputArgument (inLexique,  var_cas_outModifierMap,  GGS_string ("setUint64"),  GGS_bool (false) COMMA_SOURCE_FILE_AT_LINE (421)) ;
    ::routine_enterModifierWithLocationInputArgument (inLexique,  var_cas_outModifierMap,  GGS_string ("setLocation"),  GGS_bool (false) COMMA_SOURCE_FILE_AT_LINE (422)) ;
    #ifdef DEBUG_TRACE_ENABLED
      printf ("LEAVE function_modifierMapFor_luint64\n") ;
    #endif
    gCacheFlagForOnceFunction_modifierMapFor_luint64 = true ;
    gCachedResultForOnceFunction_modifierMapFor_luint64 = var_cas_outModifierMap ;
  }
  return gCachedResultForOnceFunction_modifierMapFor_luint64 ;
}

//---------------------------------------------------------------------------*

static GGS_object functionForGenericCall_modifierMapFor_luint64 (C_Compiler & inLexique,
                           const GGS_objectlist & /* inEffectiveParameterArray */,
                           const GGS_location & /* inErrorLocation */
                           COMMA_LOCATION_ARGS) {
  const GGS_modifierMapEXX  result = function_modifierMapFor_luint64 (inLexique
                            COMMA_THERE) ;
  return result.reader_object () ;
}

//---------------------------------------------------------------------------*

const C_galgas_function_descriptorEX kFunction_descriptor_modifierMapFor_luint64 ("modifierMapFor_luint64",
                              functionForGenericCall_modifierMapFor_luint64,
                              & kTypeDescriptor_GGS_modifierMapEXX ,
                              0,
                              NULL) ;

//---------------------------------------------------------------------------*
//                                                                           *
//             Category reader '@luint64GalgasType.modifierMap'              *
//                                                                           *
//---------------------------------------------------------------------------*

static GGS_modifierMapEXX 
category_reader__luint64GalgasType__modifierMap (C_Compiler & inLexique,
                                const cPtr_luint64GalgasType * operand_15459
                                COMMA_UNUSED_LOCATION_ARGS) {
  GGS_modifierMapEXX  var_cas_outModifierMap ;
  if (operand_15459 != NULL) {
    var_cas_outModifierMap = function_modifierMapFor_luint64 (inLexique COMMA_SOURCE_FILE_AT_LINE (428)) ;
  }
  return var_cas_outModifierMap ;
}

//---------------------------------------------------------------------------*
//                                                                           *
//         Implementation of once function "modifierMapFor_lsint64"          *
//                                                                           *
//---------------------------------------------------------------------------*

static GGS_modifierMapEXX  gCachedResultForOnceFunction_modifierMapFor_lsint64 ;
static bool gCacheFlagForOnceFunction_modifierMapFor_lsint64 = false ;

//---------------------------------------------------------------------------*

GGS_modifierMapEXX  function_modifierMapFor_lsint64 (C_Compiler & inLexique COMMA_UNUSED_LOCATION_ARGS) {
  if (! gCacheFlagForOnceFunction_modifierMapFor_lsint64) {
    #ifdef DEBUG_TRACE_ENABLED
      printf ("ENTER function_modifierMapFor_lsint64 at %s:%d\n", __FILE__, __LINE__) ;
    #endif
  GGS_modifierMapEXX  var_cas_outModifierMap ;
    var_cas_outModifierMap = GGS_modifierMapEXX ::constructor_emptyMap (inLexique COMMA_HERE) ;
    ::routine_enterModifierWithSint64InputArgument (inLexique,  var_cas_outModifierMap,  GGS_string ("setSint64"),  GGS_bool (false) COMMA_SOURCE_FILE_AT_LINE (435)) ;
    ::routine_enterModifierWithLocationInputArgument (inLexique,  var_cas_outModifierMap,  GGS_string ("setLocation"),  GGS_bool (false) COMMA_SOURCE_FILE_AT_LINE (436)) ;
    #ifdef DEBUG_TRACE_ENABLED
      printf ("LEAVE function_modifierMapFor_lsint64\n") ;
    #endif
    gCacheFlagForOnceFunction_modifierMapFor_lsint64 = true ;
    gCachedResultForOnceFunction_modifierMapFor_lsint64 = var_cas_outModifierMap ;
  }
  return gCachedResultForOnceFunction_modifierMapFor_lsint64 ;
}

//---------------------------------------------------------------------------*

static GGS_object functionForGenericCall_modifierMapFor_lsint64 (C_Compiler & inLexique,
                           const GGS_objectlist & /* inEffectiveParameterArray */,
                           const GGS_location & /* inErrorLocation */
                           COMMA_LOCATION_ARGS) {
  const GGS_modifierMapEXX  result = function_modifierMapFor_lsint64 (inLexique
                            COMMA_THERE) ;
  return result.reader_object () ;
}

//---------------------------------------------------------------------------*

const C_galgas_function_descriptorEX kFunction_descriptor_modifierMapFor_lsint64 ("modifierMapFor_lsint64",
                              functionForGenericCall_modifierMapFor_lsint64,
                              & kTypeDescriptor_GGS_modifierMapEXX ,
                              0,
                              NULL) ;

//---------------------------------------------------------------------------*
//                                                                           *
//             Category reader '@lsint64GalgasType.modifierMap'              *
//                                                                           *
//---------------------------------------------------------------------------*

static GGS_modifierMapEXX 
category_reader__lsint64GalgasType__modifierMap (C_Compiler & inLexique,
                                const cPtr_lsint64GalgasType * operand_16045
                                COMMA_UNUSED_LOCATION_ARGS) {
  GGS_modifierMapEXX  var_cas_outModifierMap ;
  if (operand_16045 != NULL) {
    var_cas_outModifierMap = function_modifierMapFor_lsint64 (inLexique COMMA_SOURCE_FILE_AT_LINE (442)) ;
  }
  return var_cas_outModifierMap ;
}

//---------------------------------------------------------------------------*
//                                                                           *
//         Implementation of once function "modifierMapFor_ldouble"          *
//                                                                           *
//---------------------------------------------------------------------------*

static GGS_modifierMapEXX  gCachedResultForOnceFunction_modifierMapFor_ldouble ;
static bool gCacheFlagForOnceFunction_modifierMapFor_ldouble = false ;

//---------------------------------------------------------------------------*

GGS_modifierMapEXX  function_modifierMapFor_ldouble (C_Compiler & inLexique COMMA_UNUSED_LOCATION_ARGS) {
  if (! gCacheFlagForOnceFunction_modifierMapFor_ldouble) {
    #ifdef DEBUG_TRACE_ENABLED
      printf ("ENTER function_modifierMapFor_ldouble at %s:%d\n", __FILE__, __LINE__) ;
    #endif
  GGS_modifierMapEXX  var_cas_outModifierMap ;
    var_cas_outModifierMap = GGS_modifierMapEXX ::constructor_emptyMap (inLexique COMMA_HERE) ;
    ::routine_enterModifierWithDoubleInputArgument (inLexique,  var_cas_outModifierMap,  GGS_string ("setDouble"),  GGS_bool (false) COMMA_SOURCE_FILE_AT_LINE (449)) ;
    ::routine_enterModifierWithLocationInputArgument (inLexique,  var_cas_outModifierMap,  GGS_string ("setLocation"),  GGS_bool (false) COMMA_SOURCE_FILE_AT_LINE (450)) ;
    #ifdef DEBUG_TRACE_ENABLED
      printf ("LEAVE function_modifierMapFor_ldouble\n") ;
    #endif
    gCacheFlagForOnceFunction_modifierMapFor_ldouble = true ;
    gCachedResultForOnceFunction_modifierMapFor_ldouble = var_cas_outModifierMap ;
  }
  return gCachedResultForOnceFunction_modifierMapFor_ldouble ;
}

//---------------------------------------------------------------------------*

static GGS_object functionForGenericCall_modifierMapFor_ldouble (C_Compiler & inLexique,
                           const GGS_objectlist & /* inEffectiveParameterArray */,
                           const GGS_location & /* inErrorLocation */
                           COMMA_LOCATION_ARGS) {
  const GGS_modifierMapEXX  result = function_modifierMapFor_ldouble (inLexique
                            COMMA_THERE) ;
  return result.reader_object () ;
}

//---------------------------------------------------------------------------*

const C_galgas_function_descriptorEX kFunction_descriptor_modifierMapFor_ldouble ("modifierMapFor_ldouble",
                              functionForGenericCall_modifierMapFor_ldouble,
                              & kTypeDescriptor_GGS_modifierMapEXX ,
                              0,
                              NULL) ;

//---------------------------------------------------------------------------*
//                                                                           *
//             Category reader '@ldoubleGalgasType.modifierMap'              *
//                                                                           *
//---------------------------------------------------------------------------*

static GGS_modifierMapEXX 
category_reader__ldoubleGalgasType__modifierMap (C_Compiler & inLexique,
                                const cPtr_ldoubleGalgasType * operand_16631
                                COMMA_UNUSED_LOCATION_ARGS) {
  GGS_modifierMapEXX  var_cas_outModifierMap ;
  if (operand_16631 != NULL) {
    var_cas_outModifierMap = function_modifierMapFor_ldouble (inLexique COMMA_SOURCE_FILE_AT_LINE (456)) ;
  }
  return var_cas_outModifierMap ;
}

//---------------------------------------------------------------------------*
//                                                                           *
//        Implementation of once function "modifierMapFor_stringset"         *
//                                                                           *
//---------------------------------------------------------------------------*

static GGS_modifierMapEXX  gCachedResultForOnceFunction_modifierMapFor_stringset ;
static bool gCacheFlagForOnceFunction_modifierMapFor_stringset = false ;

//---------------------------------------------------------------------------*

GGS_modifierMapEXX  function_modifierMapFor_stringset (C_Compiler & inLexique COMMA_UNUSED_LOCATION_ARGS) {
  if (! gCacheFlagForOnceFunction_modifierMapFor_stringset) {
    #ifdef DEBUG_TRACE_ENABLED
      printf ("ENTER function_modifierMapFor_stringset at %s:%d\n", __FILE__, __LINE__) ;
    #endif
  GGS_modifierMapEXX  var_cas_outModifierMap ;
    var_cas_outModifierMap = GGS_modifierMapEXX ::constructor_emptyMap (inLexique COMMA_HERE) ;
    #ifdef DEBUG_TRACE_ENABLED
      printf ("LEAVE function_modifierMapFor_stringset\n") ;
    #endif
    gCacheFlagForOnceFunction_modifierMapFor_stringset = true ;
    gCachedResultForOnceFunction_modifierMapFor_stringset = var_cas_outModifierMap ;
  }
  return gCachedResultForOnceFunction_modifierMapFor_stringset ;
}

//---------------------------------------------------------------------------*

static GGS_object functionForGenericCall_modifierMapFor_stringset (C_Compiler & inLexique,
                           const GGS_objectlist & /* inEffectiveParameterArray */,
                           const GGS_location & /* inErrorLocation */
                           COMMA_LOCATION_ARGS) {
  const GGS_modifierMapEXX  result = function_modifierMapFor_stringset (inLexique
                            COMMA_THERE) ;
  return result.reader_object () ;
}

//---------------------------------------------------------------------------*

const C_galgas_function_descriptorEX kFunction_descriptor_modifierMapFor_stringset ("modifierMapFor_stringset",
                              functionForGenericCall_modifierMapFor_stringset,
                              & kTypeDescriptor_GGS_modifierMapEXX ,
                              0,
                              NULL) ;

//---------------------------------------------------------------------------*
//                                                                           *
//            Category reader '@stringsetGalgasType.modifierMap'             *
//                                                                           *
//---------------------------------------------------------------------------*

static GGS_modifierMapEXX 
category_reader__stringsetGalgasType__modifierMap (C_Compiler & inLexique,
                                const cPtr_stringsetGalgasType * operand_17061
                                COMMA_UNUSED_LOCATION_ARGS) {
  GGS_modifierMapEXX  var_cas_outModifierMap ;
  if (operand_17061 != NULL) {
    var_cas_outModifierMap = function_modifierMapFor_stringset (inLexique COMMA_SOURCE_FILE_AT_LINE (468)) ;
  }
  return var_cas_outModifierMap ;
}

//---------------------------------------------------------------------------*
//                                                                           *
//        Implementation of once function "modifierMapFor_binaryset"         *
//                                                                           *
//---------------------------------------------------------------------------*

static GGS_modifierMapEXX  gCachedResultForOnceFunction_modifierMapFor_binaryset ;
static bool gCacheFlagForOnceFunction_modifierMapFor_binaryset = false ;

//---------------------------------------------------------------------------*

GGS_modifierMapEXX  function_modifierMapFor_binaryset (C_Compiler & inLexique COMMA_UNUSED_LOCATION_ARGS) {
  if (! gCacheFlagForOnceFunction_modifierMapFor_binaryset) {
    #ifdef DEBUG_TRACE_ENABLED
      printf ("ENTER function_modifierMapFor_binaryset at %s:%d\n", __FILE__, __LINE__) ;
    #endif
  GGS_modifierMapEXX  var_cas_outModifierMap ;
    var_cas_outModifierMap = GGS_modifierMapEXX ::constructor_emptyMap (inLexique COMMA_HERE) ;
    #ifdef DEBUG_TRACE_ENABLED
      printf ("LEAVE function_modifierMapFor_binaryset\n") ;
    #endif
    gCacheFlagForOnceFunction_modifierMapFor_binaryset = true ;
    gCachedResultForOnceFunction_modifierMapFor_binaryset = var_cas_outModifierMap ;
  }
  return gCachedResultForOnceFunction_modifierMapFor_binaryset ;
}

//---------------------------------------------------------------------------*

static GGS_object functionForGenericCall_modifierMapFor_binaryset (C_Compiler & inLexique,
                           const GGS_objectlist & /* inEffectiveParameterArray */,
                           const GGS_location & /* inErrorLocation */
                           COMMA_LOCATION_ARGS) {
  const GGS_modifierMapEXX  result = function_modifierMapFor_binaryset (inLexique
                            COMMA_THERE) ;
  return result.reader_object () ;
}

//---------------------------------------------------------------------------*

const C_galgas_function_descriptorEX kFunction_descriptor_modifierMapFor_binaryset ("modifierMapFor_binaryset",
                              functionForGenericCall_modifierMapFor_binaryset,
                              & kTypeDescriptor_GGS_modifierMapEXX ,
                              0,
                              NULL) ;

//---------------------------------------------------------------------------*
//                                                                           *
//            Category reader '@binarysetGalgasType.modifierMap'             *
//                                                                           *
//---------------------------------------------------------------------------*

static GGS_modifierMapEXX 
category_reader__binarysetGalgasType__modifierMap (C_Compiler & inLexique,
                                const cPtr_binarysetGalgasType * operand_17493
                                COMMA_UNUSED_LOCATION_ARGS) {
  GGS_modifierMapEXX  var_cas_outModifierMap ;
  if (operand_17493 != NULL) {
    var_cas_outModifierMap = function_modifierMapFor_binaryset (inLexique COMMA_SOURCE_FILE_AT_LINE (480)) ;
  }
  return var_cas_outModifierMap ;
}

//---------------------------------------------------------------------------*
//                                                                           *
//          Implementation of once function "modifierMapFor_type"            *
//                                                                           *
//---------------------------------------------------------------------------*

static GGS_modifierMapEXX  gCachedResultForOnceFunction_modifierMapFor_type ;
static bool gCacheFlagForOnceFunction_modifierMapFor_type = false ;

//---------------------------------------------------------------------------*

GGS_modifierMapEXX  function_modifierMapFor_type (C_Compiler & inLexique COMMA_UNUSED_LOCATION_ARGS) {
  if (! gCacheFlagForOnceFunction_modifierMapFor_type) {
    #ifdef DEBUG_TRACE_ENABLED
      printf ("ENTER function_modifierMapFor_type at %s:%d\n", __FILE__, __LINE__) ;
    #endif
  GGS_modifierMapEXX  var_cas_outModifierMap ;
    var_cas_outModifierMap = GGS_modifierMapEXX ::constructor_emptyMap (inLexique COMMA_HERE) ;
    #ifdef DEBUG_TRACE_ENABLED
      printf ("LEAVE function_modifierMapFor_type\n") ;
    #endif
    gCacheFlagForOnceFunction_modifierMapFor_type = true ;
    gCachedResultForOnceFunction_modifierMapFor_type = var_cas_outModifierMap ;
  }
  return gCachedResultForOnceFunction_modifierMapFor_type ;
}

//---------------------------------------------------------------------------*

static GGS_object functionForGenericCall_modifierMapFor_type (C_Compiler & inLexique,
                           const GGS_objectlist & /* inEffectiveParameterArray */,
                           const GGS_location & /* inErrorLocation */
                           COMMA_LOCATION_ARGS) {
  const GGS_modifierMapEXX  result = function_modifierMapFor_type (inLexique
                            COMMA_THERE) ;
  return result.reader_object () ;
}

//---------------------------------------------------------------------------*

const C_galgas_function_descriptorEX kFunction_descriptor_modifierMapFor_type ("modifierMapFor_type",
                              functionForGenericCall_modifierMapFor_type,
                              & kTypeDescriptor_GGS_modifierMapEXX ,
                              0,
                              NULL) ;

//---------------------------------------------------------------------------*
//                                                                           *
//              Category reader '@typeGalgasType.modifierMap'                *
//                                                                           *
//---------------------------------------------------------------------------*

static GGS_modifierMapEXX 
category_reader__typeGalgasType__modifierMap (C_Compiler & inLexique,
                                const cPtr_typeGalgasType * operand_17915
                                COMMA_UNUSED_LOCATION_ARGS) {
  GGS_modifierMapEXX  var_cas_outModifierMap ;
  if (operand_17915 != NULL) {
    var_cas_outModifierMap = function_modifierMapFor_type (inLexique COMMA_SOURCE_FILE_AT_LINE (492)) ;
  }
  return var_cas_outModifierMap ;
}

//---------------------------------------------------------------------------*
//                                                                           *
//         Implementation of once function "modifierMapFor_object"           *
//                                                                           *
//---------------------------------------------------------------------------*

static GGS_modifierMapEXX  gCachedResultForOnceFunction_modifierMapFor_object ;
static bool gCacheFlagForOnceFunction_modifierMapFor_object = false ;

//---------------------------------------------------------------------------*

GGS_modifierMapEXX  function_modifierMapFor_object (C_Compiler & inLexique COMMA_UNUSED_LOCATION_ARGS) {
  if (! gCacheFlagForOnceFunction_modifierMapFor_object) {
    #ifdef DEBUG_TRACE_ENABLED
      printf ("ENTER function_modifierMapFor_object at %s:%d\n", __FILE__, __LINE__) ;
    #endif
  GGS_modifierMapEXX  var_cas_outModifierMap ;
    var_cas_outModifierMap = GGS_modifierMapEXX ::constructor_emptyMap (inLexique COMMA_HERE) ;
    #ifdef DEBUG_TRACE_ENABLED
      printf ("LEAVE function_modifierMapFor_object\n") ;
    #endif
    gCacheFlagForOnceFunction_modifierMapFor_object = true ;
    gCachedResultForOnceFunction_modifierMapFor_object = var_cas_outModifierMap ;
  }
  return gCachedResultForOnceFunction_modifierMapFor_object ;
}

//---------------------------------------------------------------------------*

static GGS_object functionForGenericCall_modifierMapFor_object (C_Compiler & inLexique,
                           const GGS_objectlist & /* inEffectiveParameterArray */,
                           const GGS_location & /* inErrorLocation */
                           COMMA_LOCATION_ARGS) {
  const GGS_modifierMapEXX  result = function_modifierMapFor_object (inLexique
                            COMMA_THERE) ;
  return result.reader_object () ;
}

//---------------------------------------------------------------------------*

const C_galgas_function_descriptorEX kFunction_descriptor_modifierMapFor_object ("modifierMapFor_object",
                              functionForGenericCall_modifierMapFor_object,
                              & kTypeDescriptor_GGS_modifierMapEXX ,
                              0,
                              NULL) ;

//---------------------------------------------------------------------------*
//                                                                           *
//             Category reader '@objectGalgasType.modifierMap'               *
//                                                                           *
//---------------------------------------------------------------------------*

static GGS_modifierMapEXX 
category_reader__objectGalgasType__modifierMap (C_Compiler & inLexique,
                                const cPtr_objectGalgasType * operand_18336
                                COMMA_UNUSED_LOCATION_ARGS) {
  GGS_modifierMapEXX  var_cas_outModifierMap ;
  if (operand_18336 != NULL) {
    var_cas_outModifierMap = function_modifierMapFor_object (inLexique COMMA_SOURCE_FILE_AT_LINE (504)) ;
  }
  return var_cas_outModifierMap ;
}

//---------------------------------------------------------------------------*
//                                                                           *
//          Implementation of once function "modifierMapFor_data"            *
//                                                                           *
//---------------------------------------------------------------------------*

static GGS_modifierMapEXX  gCachedResultForOnceFunction_modifierMapFor_data ;
static bool gCacheFlagForOnceFunction_modifierMapFor_data = false ;

//---------------------------------------------------------------------------*

GGS_modifierMapEXX  function_modifierMapFor_data (C_Compiler & inLexique COMMA_UNUSED_LOCATION_ARGS) {
  if (! gCacheFlagForOnceFunction_modifierMapFor_data) {
    #ifdef DEBUG_TRACE_ENABLED
      printf ("ENTER function_modifierMapFor_data at %s:%d\n", __FILE__, __LINE__) ;
    #endif
  GGS_modifierMapEXX  var_cas_outModifierMap ;
    var_cas_outModifierMap = GGS_modifierMapEXX ::constructor_emptyMap (inLexique COMMA_HERE) ;
    ::routine_enterModifierWithUintInputArgument (inLexique,  var_cas_outModifierMap,  GGS_string ("appendByte"),  GGS_bool (true) COMMA_SOURCE_FILE_AT_LINE (511)) ;
    ::routine_enterModifierWithUintInputArgument (inLexique,  var_cas_outModifierMap,  GGS_string ("appendShortBE"),  GGS_bool (true) COMMA_SOURCE_FILE_AT_LINE (512)) ;
    ::routine_enterModifierWithUintInputArgument (inLexique,  var_cas_outModifierMap,  GGS_string ("appendShortLE"),  GGS_bool (true) COMMA_SOURCE_FILE_AT_LINE (513)) ;
    ::routine_enterModifierWithUintInputArgument (inLexique,  var_cas_outModifierMap,  GGS_string ("appendUIntBE"),  GGS_bool (false) COMMA_SOURCE_FILE_AT_LINE (514)) ;
    ::routine_enterModifierWithUintInputArgument (inLexique,  var_cas_outModifierMap,  GGS_string ("appendUIntLE"),  GGS_bool (false) COMMA_SOURCE_FILE_AT_LINE (515)) ;
    ::routine_enterModifierWithStringInputArgument (inLexique,  var_cas_outModifierMap,  GGS_string ("appendUTF8String"),  GGS_bool (false) COMMA_SOURCE_FILE_AT_LINE (516)) ;
    ::routine_enterModifierWithDataInputArgument (inLexique,  var_cas_outModifierMap,  GGS_string ("appendData"),  GGS_bool (false) COMMA_SOURCE_FILE_AT_LINE (517)) ;
    #ifdef DEBUG_TRACE_ENABLED
      printf ("LEAVE function_modifierMapFor_data\n") ;
    #endif
    gCacheFlagForOnceFunction_modifierMapFor_data = true ;
    gCachedResultForOnceFunction_modifierMapFor_data = var_cas_outModifierMap ;
  }
  return gCachedResultForOnceFunction_modifierMapFor_data ;
}

//---------------------------------------------------------------------------*

static GGS_object functionForGenericCall_modifierMapFor_data (C_Compiler & inLexique,
                           const GGS_objectlist & /* inEffectiveParameterArray */,
                           const GGS_location & /* inErrorLocation */
                           COMMA_LOCATION_ARGS) {
  const GGS_modifierMapEXX  result = function_modifierMapFor_data (inLexique
                            COMMA_THERE) ;
  return result.reader_object () ;
}

//---------------------------------------------------------------------------*

const C_galgas_function_descriptorEX kFunction_descriptor_modifierMapFor_data ("modifierMapFor_data",
                              functionForGenericCall_modifierMapFor_data,
                              & kTypeDescriptor_GGS_modifierMapEXX ,
                              0,
                              NULL) ;

//---------------------------------------------------------------------------*
//                                                                           *
//              Category reader '@dataGalgasType.modifierMap'                *
//                                                                           *
//---------------------------------------------------------------------------*

static GGS_modifierMapEXX 
category_reader__dataGalgasType__modifierMap (C_Compiler & inLexique,
                                const cPtr_dataGalgasType * operand_19309
                                COMMA_UNUSED_LOCATION_ARGS) {
  GGS_modifierMapEXX  var_cas_outModifierMap ;
  if (operand_19309 != NULL) {
    var_cas_outModifierMap = function_modifierMapFor_data (inLexique COMMA_SOURCE_FILE_AT_LINE (523)) ;
  }
  return var_cas_outModifierMap ;
}

//---------------------------------------------------------------------------*
//                                                                           *
//        Implementation of once function "modifierMapFor_function"          *
//                                                                           *
//---------------------------------------------------------------------------*

static GGS_modifierMapEXX  gCachedResultForOnceFunction_modifierMapFor_function ;
static bool gCacheFlagForOnceFunction_modifierMapFor_function = false ;

//---------------------------------------------------------------------------*

GGS_modifierMapEXX  function_modifierMapFor_function (C_Compiler & inLexique COMMA_UNUSED_LOCATION_ARGS) {
  if (! gCacheFlagForOnceFunction_modifierMapFor_function) {
    #ifdef DEBUG_TRACE_ENABLED
      printf ("ENTER function_modifierMapFor_function at %s:%d\n", __FILE__, __LINE__) ;
    #endif
  GGS_modifierMapEXX  var_cas_outModifierMap ;
    var_cas_outModifierMap = GGS_modifierMapEXX ::constructor_emptyMap (inLexique COMMA_HERE) ;
    #ifdef DEBUG_TRACE_ENABLED
      printf ("LEAVE function_modifierMapFor_function\n") ;
    #endif
    gCacheFlagForOnceFunction_modifierMapFor_function = true ;
    gCachedResultForOnceFunction_modifierMapFor_function = var_cas_outModifierMap ;
  }
  return gCachedResultForOnceFunction_modifierMapFor_function ;
}

//---------------------------------------------------------------------------*

static GGS_object functionForGenericCall_modifierMapFor_function (C_Compiler & inLexique,
                           const GGS_objectlist & /* inEffectiveParameterArray */,
                           const GGS_location & /* inErrorLocation */
                           COMMA_LOCATION_ARGS) {
  const GGS_modifierMapEXX  result = function_modifierMapFor_function (inLexique
                            COMMA_THERE) ;
  return result.reader_object () ;
}

//---------------------------------------------------------------------------*

const C_galgas_function_descriptorEX kFunction_descriptor_modifierMapFor_function ("modifierMapFor_function",
                              functionForGenericCall_modifierMapFor_function,
                              & kTypeDescriptor_GGS_modifierMapEXX ,
                              0,
                              NULL) ;

//---------------------------------------------------------------------------*
//                                                                           *
//            Category reader '@functionGalgasType.modifierMap'              *
//                                                                           *
//---------------------------------------------------------------------------*

static GGS_modifierMapEXX 
category_reader__functionGalgasType__modifierMap (C_Compiler & inLexique,
                                const cPtr_functionGalgasType * operand_19734
                                COMMA_UNUSED_LOCATION_ARGS) {
  GGS_modifierMapEXX  var_cas_outModifierMap ;
  if (operand_19734 != NULL) {
    var_cas_outModifierMap = function_modifierMapFor_function (inLexique COMMA_SOURCE_FILE_AT_LINE (535)) ;
  }
  return var_cas_outModifierMap ;
}

//---------------------------------------------------------------------------*
//                                                                           *
//              Category reader '@classGalgasType.modifierMap'               *
//                                                                           *
//---------------------------------------------------------------------------*

static GGS_modifierMapEXX 
category_reader__classGalgasType__modifierMap (C_Compiler & inLexique,
                                const cPtr_classGalgasType * operand_19956
                                COMMA_UNUSED_LOCATION_ARGS) {
  GGS_modifierMapEXX  var_cas_outModifierMap ;
  if (operand_19956 != NULL) {
    const GGS_bool cond_20085 = operand_19956->mSuperClassIndex.reader_isNull (inLexique COMMA_SOURCE_FILE_AT_LINE (541)) ;
    if (cond_20085.isBuiltAndTrue ()) {
      var_cas_outModifierMap = GGS_modifierMapEXX ::constructor_emptyMap (inLexique COMMA_HERE) ;
    }else if (cond_20085.isBuiltAndFalse ()) {
      GGS_ACGalgasType  var_cas_superClassType = operand_19956->mSuperClassIndex.reader_mType (inLexique COMMA_SOURCE_FILE_AT_LINE (544)) ;
      var_cas_outModifierMap = (findCategoryReader__ACGalgasType__modifierMap (var_cas_superClassType (HERE)->galgasRTTI ()) (inLexique, var_cas_superClassType.getPtr () COMMA_SOURCE_FILE_AT_LINE (545))) ;
    }
    {
      GGS_attributeList::cEnumerator enumerator_20237 (operand_19956->mAttributeList, true) ;
      const GGS_attributeList::cElement * operand_20237 = NULL ;
      while (((operand_20237 = enumerator_20237.nextObject ()))) {
        macroValidPointer (operand_20237) ;
        GGS_ACGalgasType  var_cas_t = operand_20237->mAttributeTypeIndex.reader_mType (inLexique COMMA_SOURCE_FILE_AT_LINE (548)) ;
        GGS_formalParameterSignatureEXX  var_cas_accessorSignature = GGS_formalParameterSignatureEXX ::constructor_emptyList () ;
        var_cas_accessorSignature.addAssign_operation (GGS_lstringGalgasType ::constructor_new (inLexique COMMA_HERE), GGS_formalArgumentPassingModeAST::constructor_argumentConstantIn (inLexique COMMA_HERE)) ;
        var_cas_accessorSignature.addAssign_operation (var_cas_t, GGS_formalArgumentPassingModeAST::constructor_argumentConstantIn (inLexique COMMA_HERE)) ;
        var_cas_outModifierMap.modifier_insertKey (inLexique, GGS_lstring ::constructor_new (inLexique, (GGS_string ("set")).operator_concat (operand_20237->mAttributeName.ggs_string ().reader_stringByCapitalizingFirstCharacter ()), operand_20237->mAttributeName.reader_location (inLexique COMMA_SOURCE_FILE_AT_LINE (554)) COMMA_HERE), var_cas_accessorSignature, GGS_bool (true) COMMA_SOURCE_FILE_AT_LINE (553)) ;
      }
    }
  }
  return var_cas_outModifierMap ;
}

//---------------------------------------------------------------------------*
//                                                                           *
//              Category reader '@listGalgasType.modifierMap'                *
//                                                                           *
//---------------------------------------------------------------------------*

static GGS_modifierMapEXX 
category_reader__listGalgasType__modifierMap (C_Compiler & inLexique,
                                const cPtr_listGalgasType * operand_20918
                                COMMA_UNUSED_LOCATION_ARGS) {
  GGS_modifierMapEXX  var_cas_outModifierMap ;
  if (operand_20918 != NULL) {
    var_cas_outModifierMap = GGS_modifierMapEXX ::constructor_emptyMap (inLexique COMMA_HERE) ;
    GGS_formalParameterSignatureEXX  var_cas_extractSignature = GGS_formalParameterSignatureEXX ::constructor_emptyList () ;
    GGS_formalParameterSignatureEXX  var_cas_inputSignature = GGS_formalParameterSignatureEXX ::constructor_emptyList () ;
    {
      GGS_attributeList::cEnumerator enumerator_21149 (operand_20918->mAttributeList, true) ;
      const GGS_attributeList::cElement * operand_21149 = NULL ;
      while (((operand_21149 = enumerator_21149.nextObject ()))) {
        macroValidPointer (operand_21149) ;
        GGS_ACGalgasType  var_cas_t = operand_21149->mAttributeTypeIndex.reader_mType (inLexique COMMA_SOURCE_FILE_AT_LINE (568)) ;
        var_cas_extractSignature.addAssign_operation (var_cas_t, GGS_formalArgumentPassingModeAST::constructor_argumentOut (inLexique COMMA_HERE)) ;
        var_cas_inputSignature.addAssign_operation (var_cas_t, GGS_formalArgumentPassingModeAST::constructor_argumentConstantIn (inLexique COMMA_HERE)) ;
      }
    }
    var_cas_outModifierMap.modifier_insertKey (inLexique, GGS_lstring ::constructor_new (inLexique, GGS_string ("popFirst"), GGS_location (inLexique) COMMA_HERE), var_cas_extractSignature, GGS_bool (true) COMMA_SOURCE_FILE_AT_LINE (572)) ;
    var_cas_outModifierMap.modifier_insertKey (inLexique, GGS_lstring ::constructor_new (inLexique, GGS_string ("popLast"), GGS_location (inLexique) COMMA_HERE), var_cas_extractSignature, GGS_bool (true) COMMA_SOURCE_FILE_AT_LINE (577)) ;
    var_cas_outModifierMap.modifier_insertKey (inLexique, GGS_lstring ::constructor_new (inLexique, GGS_string ("prependValue"), GGS_location (inLexique) COMMA_HERE), var_cas_inputSignature, GGS_bool (true) COMMA_SOURCE_FILE_AT_LINE (582)) ;
    {
      GGS_attributeList::cEnumerator enumerator_21719 (operand_20918->mAttributeList, true) ;
      const GGS_attributeList::cElement * operand_21719 = NULL ;
      while (((operand_21719 = enumerator_21719.nextObject ()))) {
        macroValidPointer (operand_21719) ;
        GGS_ACGalgasType  var_cas_t = operand_21719->mAttributeTypeIndex.reader_mType (inLexique COMMA_SOURCE_FILE_AT_LINE (588)) ;
        GGS_formalParameterSignatureEXX  var_cas_signature = GGS_formalParameterSignatureEXX ::constructor_emptyList () ;
        var_cas_signature.addAssign_operation (GGS_uintGalgasType ::constructor_new (inLexique COMMA_HERE), GGS_formalArgumentPassingModeAST::constructor_argumentConstantIn (inLexique COMMA_HERE)) ;
        var_cas_signature.addAssign_operation (var_cas_t, GGS_formalArgumentPassingModeAST::constructor_argumentOut (inLexique COMMA_HERE)) ;
        var_cas_outModifierMap.modifier_insertKey (inLexique, GGS_lstring ::constructor_new (inLexique, ((GGS_string ("set")).operator_concat (operand_21719->mAttributeName.reader_string (inLexique COMMA_SOURCE_FILE_AT_LINE (593)).reader_stringByCapitalizingFirstCharacter ())).operator_concat (GGS_string ("AtIndex")), operand_21719->mAttributeName.reader_location (inLexique COMMA_SOURCE_FILE_AT_LINE (593)) COMMA_HERE), var_cas_signature, GGS_bool (true) COMMA_SOURCE_FILE_AT_LINE (592)) ;
      }
    }
  }
  return var_cas_outModifierMap ;
}

//---------------------------------------------------------------------------*
//                                                                           *
//         Implementation of once function "modifierMapFor_listmap"          *
//                                                                           *
//---------------------------------------------------------------------------*

static GGS_modifierMapEXX  gCachedResultForOnceFunction_modifierMapFor_listmap ;
static bool gCacheFlagForOnceFunction_modifierMapFor_listmap = false ;

//---------------------------------------------------------------------------*

GGS_modifierMapEXX  function_modifierMapFor_listmap (C_Compiler & inLexique COMMA_UNUSED_LOCATION_ARGS) {
  if (! gCacheFlagForOnceFunction_modifierMapFor_listmap) {
    #ifdef DEBUG_TRACE_ENABLED
      printf ("ENTER function_modifierMapFor_listmap at %s:%d\n", __FILE__, __LINE__) ;
    #endif
  GGS_modifierMapEXX  var_cas_outModifierMap ;
    var_cas_outModifierMap = GGS_modifierMapEXX ::constructor_emptyMap (inLexique COMMA_HERE) ;
    #ifdef DEBUG_TRACE_ENABLED
      printf ("LEAVE function_modifierMapFor_listmap\n") ;
    #endif
    gCacheFlagForOnceFunction_modifierMapFor_listmap = true ;
    gCachedResultForOnceFunction_modifierMapFor_listmap = var_cas_outModifierMap ;
  }
  return gCachedResultForOnceFunction_modifierMapFor_listmap ;
}

//---------------------------------------------------------------------------*

static GGS_object functionForGenericCall_modifierMapFor_listmap (C_Compiler & inLexique,
                           const GGS_objectlist & /* inEffectiveParameterArray */,
                           const GGS_location & /* inErrorLocation */
                           COMMA_LOCATION_ARGS) {
  const GGS_modifierMapEXX  result = function_modifierMapFor_listmap (inLexique
                            COMMA_THERE) ;
  return result.reader_object () ;
}

//---------------------------------------------------------------------------*

const C_galgas_function_descriptorEX kFunction_descriptor_modifierMapFor_listmap ("modifierMapFor_listmap",
                              functionForGenericCall_modifierMapFor_listmap,
                              & kTypeDescriptor_GGS_modifierMapEXX ,
                              0,
                              NULL) ;

//---------------------------------------------------------------------------*
//                                                                           *
//             Category reader '@listmapGalgasType.modifierMap'              *
//                                                                           *
//---------------------------------------------------------------------------*

static GGS_modifierMapEXX 
category_reader__listmapGalgasType__modifierMap (C_Compiler & inLexique,
                                const cPtr_listmapGalgasType * operand_22552
                                COMMA_UNUSED_LOCATION_ARGS) {
  GGS_modifierMapEXX  var_cas_outModifierMap ;
  if (operand_22552 != NULL) {
    var_cas_outModifierMap = function_modifierMapFor_listmap (inLexique COMMA_SOURCE_FILE_AT_LINE (609)) ;
  }
  return var_cas_outModifierMap ;
}

//---------------------------------------------------------------------------*
//                                                                           *
//             Category reader '@structGalgasType.modifierMap'               *
//                                                                           *
//---------------------------------------------------------------------------*

static GGS_modifierMapEXX 
category_reader__structGalgasType__modifierMap (C_Compiler & inLexique,
                                const cPtr_structGalgasType * operand_22774
                                COMMA_UNUSED_LOCATION_ARGS) {
  GGS_modifierMapEXX  var_cas_outModifierMap ;
  if (operand_22774 != NULL) {
    var_cas_outModifierMap = GGS_modifierMapEXX ::constructor_emptyMap (inLexique COMMA_HERE) ;
  }
  return var_cas_outModifierMap ;
}

//---------------------------------------------------------------------------*
//                                                                           *
//           Category reader '@sortedlistGalgasType.modifierMap'             *
//                                                                           *
//---------------------------------------------------------------------------*

static GGS_modifierMapEXX 
category_reader__sortedlistGalgasType__modifierMap (C_Compiler & inLexique,
                                const cPtr_sortedlistGalgasType * operand_23001
                                COMMA_UNUSED_LOCATION_ARGS) {
  GGS_modifierMapEXX  var_cas_outModifierMap ;
  if (operand_23001 != NULL) {
    var_cas_outModifierMap = GGS_modifierMapEXX ::constructor_emptyMap (inLexique COMMA_HERE) ;
    GGS_formalParameterSignatureEXX  var_cas_extractSignature = GGS_formalParameterSignatureEXX ::constructor_emptyList () ;
    {
      GGS_attributeList::cEnumerator enumerator_23172 (operand_23001->mAttributeList, true) ;
      const GGS_attributeList::cElement * operand_23172 = NULL ;
      while (((operand_23172 = enumerator_23172.nextObject ()))) {
        macroValidPointer (operand_23172) ;
        GGS_ACGalgasType  var_cas_t = operand_23172->mAttributeTypeIndex.reader_mType (inLexique COMMA_SOURCE_FILE_AT_LINE (624)) ;
        var_cas_extractSignature.addAssign_operation (var_cas_t, GGS_formalArgumentPassingModeAST::constructor_argumentOut (inLexique COMMA_HERE)) ;
      }
    }
    var_cas_outModifierMap.modifier_insertKey (inLexique, GGS_lstring ::constructor_new (inLexique, GGS_string ("popSmallest"), GGS_location (inLexique) COMMA_HERE), var_cas_extractSignature, GGS_bool (true) COMMA_SOURCE_FILE_AT_LINE (627)) ;
    var_cas_outModifierMap.modifier_insertKey (inLexique, GGS_lstring ::constructor_new (inLexique, GGS_string ("popGreatest"), GGS_location (inLexique) COMMA_HERE), var_cas_extractSignature, GGS_bool (true) COMMA_SOURCE_FILE_AT_LINE (632)) ;
  }
  return var_cas_outModifierMap ;
}

//---------------------------------------------------------------------------*
//                                                                           *
//                  Category reader '@mapType.modifierMap'                   *
//                                                                           *
//---------------------------------------------------------------------------*

static GGS_modifierMapEXX 
category_reader__mapType__modifierMap (C_Compiler & inLexique,
                                const cPtr_mapType * operand_23666
                                COMMA_UNUSED_LOCATION_ARGS) {
  GGS_modifierMapEXX  var_cas_outModifierMap ;
  if (operand_23666 != NULL) {
    var_cas_outModifierMap = GGS_modifierMapEXX ::constructor_emptyMap (inLexique COMMA_HERE) ;
    GGS_formalParameterSignatureEXX  var_cas_insertSignature = GGS_formalParameterSignatureEXX ::constructor_emptyList () ;
    GGS_formalParameterSignatureEXX  var_cas_removeSignature = GGS_formalParameterSignatureEXX ::constructor_emptyList () ;
    var_cas_insertSignature.addAssign_operation (GGS_lstringGalgasType ::constructor_new (inLexique COMMA_HERE), GGS_formalArgumentPassingModeAST::constructor_argumentConstantIn (inLexique COMMA_HERE)) ;
    var_cas_removeSignature.addAssign_operation (GGS_lstringGalgasType ::constructor_new (inLexique COMMA_HERE), GGS_formalArgumentPassingModeAST::constructor_argumentConstantIn (inLexique COMMA_HERE)) ;
    {
      GGS_attributeList::cEnumerator enumerator_24099 (operand_23666->mAttributeList, true) ;
      const GGS_attributeList::cElement * operand_24099 = NULL ;
      while (((operand_24099 = enumerator_24099.nextObject ()))) {
        macroValidPointer (operand_24099) ;
        GGS_ACGalgasType  var_cas_t = operand_24099->mAttributeTypeIndex.reader_mType (inLexique COMMA_SOURCE_FILE_AT_LINE (648)) ;
        var_cas_insertSignature.addAssign_operation (var_cas_t, GGS_formalArgumentPassingModeAST::constructor_argumentConstantIn (inLexique COMMA_HERE)) ;
        var_cas_removeSignature.addAssign_operation (var_cas_t, GGS_formalArgumentPassingModeAST::constructor_argumentOut (inLexique COMMA_HERE)) ;
        GGS_formalParameterSignatureEXX  var_cas_accessorSignature = GGS_formalParameterSignatureEXX ::constructor_emptyList () ;
        var_cas_accessorSignature.addAssign_operation (GGS_lstringGalgasType ::constructor_new (inLexique COMMA_HERE), GGS_formalArgumentPassingModeAST::constructor_argumentConstantIn (inLexique COMMA_HERE)) ;
        var_cas_accessorSignature.addAssign_operation (var_cas_t, GGS_formalArgumentPassingModeAST::constructor_argumentConstantIn (inLexique COMMA_HERE)) ;
        var_cas_outModifierMap.modifier_insertKey (inLexique, GGS_lstring ::constructor_new (inLexique, ((GGS_string ("set")).operator_concat (operand_24099->mAttributeName.ggs_string ().reader_stringByCapitalizingFirstCharacter ())).operator_concat (GGS_string ("ForKey")), operand_24099->mAttributeName.reader_location (inLexique COMMA_SOURCE_FILE_AT_LINE (656)) COMMA_HERE), var_cas_accessorSignature, GGS_bool (true) COMMA_SOURCE_FILE_AT_LINE (655)) ;
      }
    }
    {
      GGS_mapMethodMap::cEnumerator enumerator_24861 (operand_23666->mInsertMethodMap, true) ;
      const GGS_mapMethodMap::cElement * operand_24861 = NULL ;
      while (((operand_24861 = enumerator_24861.nextObject ()))) {
        macroValidPointer (operand_24861) ;
        var_cas_outModifierMap.modifier_insertKey (inLexique, operand_24861->mKey, var_cas_insertSignature, GGS_bool (true) COMMA_SOURCE_FILE_AT_LINE (663)) ;
      }
    }
    {
      GGS_mapMethodMap::cEnumerator enumerator_25013 (operand_23666->mRemoveMethodMap, true) ;
      const GGS_mapMethodMap::cElement * operand_25013 = NULL ;
      while (((operand_25013 = enumerator_25013.nextObject ()))) {
        macroValidPointer (operand_25013) ;
        var_cas_outModifierMap.modifier_insertKey (inLexique, operand_25013->mKey, var_cas_removeSignature, GGS_bool (true) COMMA_SOURCE_FILE_AT_LINE (671)) ;
      }
    }
  }
  return var_cas_outModifierMap ;
}

//---------------------------------------------------------------------------*
//                                                                           *
//               Category reader '@mapindexType.modifierMap'                 *
//                                                                           *
//---------------------------------------------------------------------------*

static GGS_modifierMapEXX 
category_reader__mapindexType__modifierMap (C_Compiler & inLexique,
                                const cPtr_mapindexType * operand_25253
                                COMMA_UNUSED_LOCATION_ARGS) {
  GGS_modifierMapEXX  var_cas_outModifierMap ;
  if (operand_25253 != NULL) {
    var_cas_outModifierMap = GGS_modifierMapEXX ::constructor_emptyMap (inLexique COMMA_HERE) ;
  }
  return var_cas_outModifierMap ;
}

//---------------------------------------------------------------------------*
//                                                                           *
//                 Category reader '@enumType.modifierMap'                   *
//                                                                           *
//---------------------------------------------------------------------------*

static GGS_modifierMapEXX 
category_reader__enumType__modifierMap (C_Compiler & inLexique,
                                const cPtr_enumType * operand_25468
                                COMMA_UNUSED_LOCATION_ARGS) {
  GGS_modifierMapEXX  var_cas_outModifierMap ;
  if (operand_25468 != NULL) {
    var_cas_outModifierMap = GGS_modifierMapEXX ::constructor_emptyMap (inLexique COMMA_HERE) ;
  }
  return var_cas_outModifierMap ;
}

//---------------------------------------------------------------------------*
//                                                                           *
//                      Prologue and epilogue actions                        *
//                                                                           *
//---------------------------------------------------------------------------*

static void prologueRoutineFor_semanticsModifiersEX (void) {
  enterCategoryReader__ACGalgasType__modifierMap ((typeCategoryReader__ACGalgasType__modifierMap) category_reader__locationGalgasType__modifierMap, gClassInfoFor__locationGalgasType.slotID ()) ;
  enterCategoryReader__ACGalgasType__modifierMap ((typeCategoryReader__ACGalgasType__modifierMap) category_reader__stringGalgasType__modifierMap, gClassInfoFor__stringGalgasType.slotID ()) ;
  enterCategoryReader__ACGalgasType__modifierMap ((typeCategoryReader__ACGalgasType__modifierMap) category_reader__charGalgasType__modifierMap, gClassInfoFor__charGalgasType.slotID ()) ;
  enterCategoryReader__ACGalgasType__modifierMap ((typeCategoryReader__ACGalgasType__modifierMap) category_reader__boolGalgasType__modifierMap, gClassInfoFor__boolGalgasType.slotID ()) ;
  enterCategoryReader__ACGalgasType__modifierMap ((typeCategoryReader__ACGalgasType__modifierMap) category_reader__uintGalgasType__modifierMap, gClassInfoFor__uintGalgasType.slotID ()) ;
  enterCategoryReader__ACGalgasType__modifierMap ((typeCategoryReader__ACGalgasType__modifierMap) category_reader__sintGalgasType__modifierMap, gClassInfoFor__sintGalgasType.slotID ()) ;
  enterCategoryReader__ACGalgasType__modifierMap ((typeCategoryReader__ACGalgasType__modifierMap) category_reader__uint64GalgasType__modifierMap, gClassInfoFor__uint64GalgasType.slotID ()) ;
  enterCategoryReader__ACGalgasType__modifierMap ((typeCategoryReader__ACGalgasType__modifierMap) category_reader__sint64GalgasType__modifierMap, gClassInfoFor__sint64GalgasType.slotID ()) ;
  enterCategoryReader__ACGalgasType__modifierMap ((typeCategoryReader__ACGalgasType__modifierMap) category_reader__doubleGalgasType__modifierMap, gClassInfoFor__doubleGalgasType.slotID ()) ;
  enterCategoryReader__ACGalgasType__modifierMap ((typeCategoryReader__ACGalgasType__modifierMap) category_reader__lstringGalgasType__modifierMap, gClassInfoFor__lstringGalgasType.slotID ()) ;
  enterCategoryReader__ACGalgasType__modifierMap ((typeCategoryReader__ACGalgasType__modifierMap) category_reader__lcharGalgasType__modifierMap, gClassInfoFor__lcharGalgasType.slotID ()) ;
  enterCategoryReader__ACGalgasType__modifierMap ((typeCategoryReader__ACGalgasType__modifierMap) category_reader__lboolGalgasType__modifierMap, gClassInfoFor__lboolGalgasType.slotID ()) ;
  enterCategoryReader__ACGalgasType__modifierMap ((typeCategoryReader__ACGalgasType__modifierMap) category_reader__luintGalgasType__modifierMap, gClassInfoFor__luintGalgasType.slotID ()) ;
  enterCategoryReader__ACGalgasType__modifierMap ((typeCategoryReader__ACGalgasType__modifierMap) category_reader__lsintGalgasType__modifierMap, gClassInfoFor__lsintGalgasType.slotID ()) ;
  enterCategoryReader__ACGalgasType__modifierMap ((typeCategoryReader__ACGalgasType__modifierMap) category_reader__luint64GalgasType__modifierMap, gClassInfoFor__luint64GalgasType.slotID ()) ;
  enterCategoryReader__ACGalgasType__modifierMap ((typeCategoryReader__ACGalgasType__modifierMap) category_reader__lsint64GalgasType__modifierMap, gClassInfoFor__lsint64GalgasType.slotID ()) ;
  enterCategoryReader__ACGalgasType__modifierMap ((typeCategoryReader__ACGalgasType__modifierMap) category_reader__ldoubleGalgasType__modifierMap, gClassInfoFor__ldoubleGalgasType.slotID ()) ;
  enterCategoryReader__ACGalgasType__modifierMap ((typeCategoryReader__ACGalgasType__modifierMap) category_reader__stringsetGalgasType__modifierMap, gClassInfoFor__stringsetGalgasType.slotID ()) ;
  enterCategoryReader__ACGalgasType__modifierMap ((typeCategoryReader__ACGalgasType__modifierMap) category_reader__binarysetGalgasType__modifierMap, gClassInfoFor__binarysetGalgasType.slotID ()) ;
  enterCategoryReader__ACGalgasType__modifierMap ((typeCategoryReader__ACGalgasType__modifierMap) category_reader__typeGalgasType__modifierMap, gClassInfoFor__typeGalgasType.slotID ()) ;
  enterCategoryReader__ACGalgasType__modifierMap ((typeCategoryReader__ACGalgasType__modifierMap) category_reader__objectGalgasType__modifierMap, gClassInfoFor__objectGalgasType.slotID ()) ;
  enterCategoryReader__ACGalgasType__modifierMap ((typeCategoryReader__ACGalgasType__modifierMap) category_reader__dataGalgasType__modifierMap, gClassInfoFor__dataGalgasType.slotID ()) ;
  enterCategoryReader__ACGalgasType__modifierMap ((typeCategoryReader__ACGalgasType__modifierMap) category_reader__functionGalgasType__modifierMap, gClassInfoFor__functionGalgasType.slotID ()) ;
  enterCategoryReader__ACGalgasType__modifierMap ((typeCategoryReader__ACGalgasType__modifierMap) category_reader__classGalgasType__modifierMap, gClassInfoFor__classGalgasType.slotID ()) ;
  enterCategoryReader__ACGalgasType__modifierMap ((typeCategoryReader__ACGalgasType__modifierMap) category_reader__listGalgasType__modifierMap, gClassInfoFor__listGalgasType.slotID ()) ;
  enterCategoryReader__ACGalgasType__modifierMap ((typeCategoryReader__ACGalgasType__modifierMap) category_reader__listmapGalgasType__modifierMap, gClassInfoFor__listmapGalgasType.slotID ()) ;
  enterCategoryReader__ACGalgasType__modifierMap ((typeCategoryReader__ACGalgasType__modifierMap) category_reader__structGalgasType__modifierMap, gClassInfoFor__structGalgasType.slotID ()) ;
  enterCategoryReader__ACGalgasType__modifierMap ((typeCategoryReader__ACGalgasType__modifierMap) category_reader__sortedlistGalgasType__modifierMap, gClassInfoFor__sortedlistGalgasType.slotID ()) ;
  enterCategoryReader__ACGalgasType__modifierMap ((typeCategoryReader__ACGalgasType__modifierMap) category_reader__mapType__modifierMap, gClassInfoFor__mapType.slotID ()) ;
  enterCategoryReader__ACGalgasType__modifierMap ((typeCategoryReader__ACGalgasType__modifierMap) category_reader__mapindexType__modifierMap, gClassInfoFor__mapindexType.slotID ()) ;
  enterCategoryReader__ACGalgasType__modifierMap ((typeCategoryReader__ACGalgasType__modifierMap) category_reader__enumType__modifierMap, gClassInfoFor__enumType.slotID ()) ;
}

//---------------------------------------------------------------------------*

static void epilogueRoutineFor_semanticsModifiersEX (void) {
  gDispatchTableForReader__ACGalgasType__modifierMap.free () ;
  gCachedResultForOnceFunction_modifierMapFor_location.drop () ;
  gCachedResultForOnceFunction_modifierMapFor_string.drop () ;
  gCachedResultForOnceFunction_modifierMapFor_char.drop () ;
  gCachedResultForOnceFunction_modifierMapFor_bool.drop () ;
  gCachedResultForOnceFunction_modifierMapFor_uint.drop () ;
  gCachedResultForOnceFunction_modifierMapFor_sint.drop () ;
  gCachedResultForOnceFunction_modifierMapFor_uint64.drop () ;
  gCachedResultForOnceFunction_modifierMapFor_sint64.drop () ;
  gCachedResultForOnceFunction_modifierMapFor_double.drop () ;
  gCachedResultForOnceFunction_modifierMapFor_lstring.drop () ;
  gCachedResultForOnceFunction_modifierMapFor_lchar.drop () ;
  gCachedResultForOnceFunction_modifierMapFor_lbool.drop () ;
  gCachedResultForOnceFunction_modifierMapFor_luint.drop () ;
  gCachedResultForOnceFunction_modifierMapFor_lsint.drop () ;
  gCachedResultForOnceFunction_modifierMapFor_luint64.drop () ;
  gCachedResultForOnceFunction_modifierMapFor_lsint64.drop () ;
  gCachedResultForOnceFunction_modifierMapFor_ldouble.drop () ;
  gCachedResultForOnceFunction_modifierMapFor_stringset.drop () ;
  gCachedResultForOnceFunction_modifierMapFor_binaryset.drop () ;
  gCachedResultForOnceFunction_modifierMapFor_type.drop () ;
  gCachedResultForOnceFunction_modifierMapFor_object.drop () ;
  gCachedResultForOnceFunction_modifierMapFor_data.drop () ;
  gCachedResultForOnceFunction_modifierMapFor_function.drop () ;
  gCachedResultForOnceFunction_modifierMapFor_listmap.drop () ;
}

//---------------------------------------------------------------------------*

C_PrologueEpilogue prologueEpilogueObjectFor_semanticsModifiersEX (prologueRoutineFor_semanticsModifiersEX, epilogueRoutineFor_semanticsModifiersEX) ;

//---------------------------------------------------------------------------*

