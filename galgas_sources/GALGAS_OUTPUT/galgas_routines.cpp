//---------------------------------------------------------------------------*
//                                                                           *
//                        File 'galgas_routines.cpp'                         *
//                 Generated by version GALGAS_BETA_VERSION                  *
//                      march 10th, 2010, at 17h43'12"                       *
//                                                                           *
//---------------------------------------------------------------------------*

//--- START OF USER ZONE 1


//--- END OF USER ZONE 1

//---------------------------------------------------------------------------*

#include "version_libpm.h"
#if LIBPM_VERSION != THE_LIBPM_VERSION
  #error "This file has been compiled with a version of GALGAS different than the version of libpm"
#endif

//---------------------------------------------------------------------------*

#include <typeinfo>
#include "utilities/MF_MemoryControl.h"
#include "files/C_TextFileWrite.h"
#include "galgas/C_galgas_CLI_Options.h"
#include "galgas_routines.h"

//---------------------------------------------------------------------------*

#ifndef DO_NOT_GENERATE_CHECKINGS
  #define SOURCE_FILE_AT_LINE(line) "galgas_routines.gSemantics", line
  #define COMMA_SOURCE_FILE_AT_LINE(line) , SOURCE_FILE_AT_LINE(line)
#else
  #define SOURCE_FILE_AT_LINE(line) 
  #define COMMA_SOURCE_FILE_AT_LINE(line) 
#endif

//---------------------------------------------------------------------------*
//                                                                           *
//             Include directives generated by grammar includes              *
//                                                                           *
//---------------------------------------------------------------------------*

#include "galgas_LL1_grammar.h"
#include "grammarLL1grammar.h"
#include "optionLL1grammar.h"
#include "programSLRgrammar.h"
#include "projectLL1grammar.h"
#include "syntaxSLRgrammar.h"

//--- START OF USER ZONE 2


//--- END OF USER ZONE 2

//---------------------------------------------------------------------------*
//                                                                           *
//               Implementation of function "outputDirectory"                *
//                                                                           *
//---------------------------------------------------------------------------*

GGS_string function_outputDirectory (C_Compiler & inLexique,
                                const GGS_lstring   var_cas_inSourceFile COMMA_UNUSED_LOCATION_ARGS) {
  #ifdef DEBUG_TRACE_ENABLED
    printf ("ENTER function_outputDirectory at %s:%d\n", __FILE__, __LINE__) ;
  #endif
  GGS_string var_cas_outOuputDirectory ;
  const GGS_bool cond_3078 = (var_cas_inSourceFile.ggs_string ().reader_characterAtIndex (inLexique, GGS_uint (0U) COMMA_SOURCE_FILE_AT_LINE (49))).operator_isEqual (GGS_char (TO_UNICODE ('/'))) ;
  if (cond_3078.isBuiltAndTrue ()) {
    var_cas_outOuputDirectory = var_cas_inSourceFile.ggs_string ().reader_stringByDeletingLastPathComponent () ;
    var_cas_outOuputDirectory.appendCString ("/GALGAS_OUTPUT") ;
  }else if (cond_3078.isBuiltAndFalse ()) {
    var_cas_outOuputDirectory = GGS_string ("GALGAS_OUTPUT") ;
  }
  #ifdef DEBUG_TRACE_ENABLED
    printf ("LEAVE function_outputDirectory\n") ;
  #endif
  return var_cas_outOuputDirectory ;
}

//---------------------------------------------------------------------------*

static GGS_object functionForGenericCall_outputDirectory (C_Compiler & inLexique,
                           const GGS_objectlist & inEffectiveParameterArray,
                           const GGS_location & inErrorLocation
                           COMMA_LOCATION_ARGS) {
  const GGS_lstring  arg_0 = GGS_lstring ::castFromObject (inLexique, inEffectiveParameterArray.reader_mValueAtIndex (inLexique, GGS_uint (0) COMMA_THERE), inErrorLocation COMMA_THERE) ;
  const GGS_string result = function_outputDirectory (inLexique,
                            arg_0
                            COMMA_THERE) ;
  return result.reader_object () ;
}

//---------------------------------------------------------------------------*

static const C_galgas_type_descriptorEX *
kArgumentTypeList_outputDirectory [1] = {& kTypeDescriptor_GGS_lstring } ;

const C_galgas_function_descriptorEX
kFunction_descriptor_outputDirectory ("outputDirectory",
                              functionForGenericCall_outputDirectory,
                              & kTypeDescriptor_GGS_string,
                              1,
                              kArgumentTypeList_outputDirectory) ;

//---------------------------------------------------------------------------*
//                                                                           *
//    Implementation of routine "checkCategoryMethodDefinitionForClass"      *
//                                                                           *
//---------------------------------------------------------------------------*

void routine_checkCategoryMethodDefinitionForClass (C_Compiler & inLexique,
                                const GGS_string  var_cas_inClassNameForErrorSignaling,
                                const GGS_string  var_cas_inClassName,
                                const GGS_lstring   var_cas_inAbstractCategoryMethodName,
                                const GGS_descendantClassListMap  var_cas_inDescendantClassListMap,
                                const GGS_overridingMultiMethodListMapAST  var_cas_inOverridingCategoryMethodListMap COMMA_UNUSED_LOCATION_ARGS) {
  #ifdef DEBUG_TRACE_ENABLED
    printf ("ENTER routine_checkCategoryMethodDefinitionForClass at %s:%d\n", __FILE__, __LINE__) ;
  #endif
  GGS_classIndexList  var_cas_descendantClasses = var_cas_inDescendantClassListMap.reader_listForKey (inLexique, var_cas_inClassName COMMA_SOURCE_FILE_AT_LINE (66)) ;
  {
    GGS_classIndexList::cEnumerator enumerator_3626 (var_cas_descendantClasses, true) ;
    const GGS_classIndexList::cElement * operand_3626 = NULL ;
    while (((operand_3626 = enumerator_3626.nextObject ()))) {
      macroValidPointer (operand_3626) ;
      GGS_lstring  var_cas_descendantClassName = operand_3626->mClassMapindex.reader_key (inLexique COMMA_SOURCE_FILE_AT_LINE (68)) ;
      GGS_ACGalgasType  var_cas_t = operand_3626->mClassMapindex.reader_mType (inLexique COMMA_SOURCE_FILE_AT_LINE (69)) ;
      GGS_bool var_cas_isAbstract ;
      { const GGS_ACGalgasType _var_3986 = var_cas_t ; // CAST instruction
        if (_var_3986.getPtr () != NULL) {
          macroValidPointer (_var_3986.getPtr ()) ;
          if (dynamic_cast <cPtr_classGalgasType *> (_var_3986.getPtr ()) != NULL) {
            const GGS_classGalgasType var_cas_classType (_var_3986.getPtr ()) ;
            var_cas_isAbstract = var_cas_classType.reader_mIsAbstract (inLexique COMMA_SOURCE_FILE_AT_LINE (73)) ;
          }else{
            var_cas_descendantClassName.reader_location (inLexique COMMA_HERE).signalGGSSemanticError (inLexique, ((GGS_string ("the '@")).operator_concat (var_cas_descendantClassName)).operator_concat (GGS_string ("' type should be a class")) COMMA_SOURCE_FILE_AT_LINE (76)) ;
            var_cas_isAbstract.drop () ;
          }
        }
      }
      GGS_overridingMultiMethodListAST  var_cas_overridingMethods = var_cas_inOverridingCategoryMethodListMap.reader_listForKey (inLexique, var_cas_descendantClassName.reader_string (inLexique COMMA_SOURCE_FILE_AT_LINE (77)) COMMA_SOURCE_FILE_AT_LINE (77)) ;
      GGS_bool var_cas_found = GGS_bool (false) ;
      {
        GGS_overridingMultiMethodListAST::cEnumerator enumerator_4184 (var_cas_overridingMethods, true) ;
        const GGS_overridingMultiMethodListAST::cElement * operand_4184 = NULL ;
        while (((operand_4184 = enumerator_4184.nextObject ()))
            && ((var_cas_found).operator_not ().isBuiltAndTrue ())) {
          macroValidPointer (operand_4184) ;
          var_cas_found = (var_cas_inAbstractCategoryMethodName.reader_string (inLexique COMMA_SOURCE_FILE_AT_LINE (80))).operator_isEqual (operand_4184->mOverridingCategoryMethodName.reader_string (inLexique COMMA_SOURCE_FILE_AT_LINE (80))) ;
        }
      }
      const GGS_bool cond_4951 = (var_cas_found).operator_not () ;
      if (cond_4951.isBuiltAndTrue ()) {
        const GGS_bool cond_4633 = var_cas_isAbstract ;
        if (cond_4633.isBuiltAndTrue ()) {
          ::routine_checkCategoryMethodDefinitionForClass (inLexique,  var_cas_inClassNameForErrorSignaling,  var_cas_descendantClassName.reader_string (inLexique COMMA_SOURCE_FILE_AT_LINE (86)),  var_cas_inAbstractCategoryMethodName,  var_cas_inDescendantClassListMap,  var_cas_inOverridingCategoryMethodListMap COMMA_SOURCE_FILE_AT_LINE (84)) ;
        }else if (cond_4633.isBuiltAndFalse ()) {
          var_cas_inAbstractCategoryMethodName.reader_location (inLexique COMMA_HERE).signalGGSSemanticError (inLexique, ((((((GGS_string ("an abstract category method '")).operator_concat (var_cas_inAbstractCategoryMethodName)).operator_concat (GGS_string ("' is defined for abstract class '@"))).operator_concat (var_cas_inClassNameForErrorSignaling)).operator_concat (GGS_string ("', but concrete descendant class '@"))).operator_concat (var_cas_descendantClassName)).operator_concat (GGS_string ("' does not implement this method")) COMMA_SOURCE_FILE_AT_LINE (95)) ;
        }
      }
    }
  }
  #ifdef DEBUG_TRACE_ENABLED
    printf ("LEAVE routine_checkCategoryMethodDefinitionForClass\n") ;
  #endif
}

//---------------------------------------------------------------------------*
//                                                                           *
//    Implementation of routine "checkCategoryReaderDefinitionForClass"      *
//                                                                           *
//---------------------------------------------------------------------------*

void routine_checkCategoryReaderDefinitionForClass (C_Compiler & inLexique,
                                const GGS_string  var_cas_inClassNameForErrorSignaling,
                                const GGS_string  var_cas_inClassName,
                                const GGS_lstring   var_cas_inAbstractCategoryReaderName,
                                const GGS_descendantClassListMap  var_cas_inDescendantClassListMap,
                                const GGS_overridingMultiReaderListMapAST  var_cas_inOverridingCategoryReaderListMap COMMA_UNUSED_LOCATION_ARGS) {
  #ifdef DEBUG_TRACE_ENABLED
    printf ("ENTER routine_checkCategoryReaderDefinitionForClass at %s:%d\n", __FILE__, __LINE__) ;
  #endif
  GGS_classIndexList  var_cas_descendantClasses = var_cas_inDescendantClassListMap.reader_listForKey (inLexique, var_cas_inClassName COMMA_SOURCE_FILE_AT_LINE (109)) ;
  {
    GGS_classIndexList::cEnumerator enumerator_5465 (var_cas_descendantClasses, true) ;
    const GGS_classIndexList::cElement * operand_5465 = NULL ;
    while (((operand_5465 = enumerator_5465.nextObject ()))) {
      macroValidPointer (operand_5465) ;
      GGS_lstring  var_cas_descendantClassName = operand_5465->mClassMapindex.reader_key (inLexique COMMA_SOURCE_FILE_AT_LINE (111)) ;
      GGS_ACGalgasType  var_cas_t = operand_5465->mClassMapindex.reader_mType (inLexique COMMA_SOURCE_FILE_AT_LINE (112)) ;
      GGS_bool var_cas_isAbstract ;
      { const GGS_ACGalgasType _var_5825 = var_cas_t ; // CAST instruction
        if (_var_5825.getPtr () != NULL) {
          macroValidPointer (_var_5825.getPtr ()) ;
          if (dynamic_cast <cPtr_classGalgasType *> (_var_5825.getPtr ()) != NULL) {
            const GGS_classGalgasType var_cas_classType (_var_5825.getPtr ()) ;
            var_cas_isAbstract = var_cas_classType.reader_mIsAbstract (inLexique COMMA_SOURCE_FILE_AT_LINE (116)) ;
          }else{
            var_cas_descendantClassName.reader_location (inLexique COMMA_HERE).signalGGSSemanticError (inLexique, ((GGS_string ("the '@")).operator_concat (var_cas_descendantClassName)).operator_concat (GGS_string ("' type should be a class")) COMMA_SOURCE_FILE_AT_LINE (119)) ;
            var_cas_isAbstract.drop () ;
          }
        }
      }
      GGS_overridingMultiReaderListAST  var_cas_overridingReaders = var_cas_inOverridingCategoryReaderListMap.reader_listForKey (inLexique, var_cas_descendantClassName.reader_string (inLexique COMMA_SOURCE_FILE_AT_LINE (120)) COMMA_SOURCE_FILE_AT_LINE (120)) ;
      GGS_bool var_cas_found = GGS_bool (false) ;
      {
        GGS_overridingMultiReaderListAST::cEnumerator enumerator_6023 (var_cas_overridingReaders, true) ;
        const GGS_overridingMultiReaderListAST::cElement * operand_6023 = NULL ;
        while (((operand_6023 = enumerator_6023.nextObject ()))
            && ((var_cas_found).operator_not ().isBuiltAndTrue ())) {
          macroValidPointer (operand_6023) ;
          var_cas_found = (var_cas_inAbstractCategoryReaderName.reader_string (inLexique COMMA_SOURCE_FILE_AT_LINE (123))).operator_isEqual (operand_6023->mOverridingCategoryReaderName.reader_string (inLexique COMMA_SOURCE_FILE_AT_LINE (123))) ;
        }
      }
      const GGS_bool cond_6790 = (var_cas_found).operator_not () ;
      if (cond_6790.isBuiltAndTrue ()) {
        const GGS_bool cond_6472 = var_cas_isAbstract ;
        if (cond_6472.isBuiltAndTrue ()) {
          ::routine_checkCategoryReaderDefinitionForClass (inLexique,  var_cas_inClassNameForErrorSignaling,  var_cas_descendantClassName.reader_string (inLexique COMMA_SOURCE_FILE_AT_LINE (129)),  var_cas_inAbstractCategoryReaderName,  var_cas_inDescendantClassListMap,  var_cas_inOverridingCategoryReaderListMap COMMA_SOURCE_FILE_AT_LINE (127)) ;
        }else if (cond_6472.isBuiltAndFalse ()) {
          var_cas_inAbstractCategoryReaderName.reader_location (inLexique COMMA_HERE).signalGGSSemanticError (inLexique, ((((((GGS_string ("an abstract category reader '")).operator_concat (var_cas_inAbstractCategoryReaderName)).operator_concat (GGS_string ("' is defined for abstract class '@"))).operator_concat (var_cas_inClassNameForErrorSignaling)).operator_concat (GGS_string ("', but concrete descendant class '@"))).operator_concat (var_cas_descendantClassName)).operator_concat (GGS_string ("' does not implement this reader")) COMMA_SOURCE_FILE_AT_LINE (138)) ;
        }
      }
    }
  }
  #ifdef DEBUG_TRACE_ENABLED
    printf ("LEAVE routine_checkCategoryReaderDefinitionForClass\n") ;
  #endif
}

//---------------------------------------------------------------------------*
//                                                                           *
//        Implementation of routine "performProjectGlobalCheckings"          *
//                                                                           *
//---------------------------------------------------------------------------*

void routine_performProjectGlobalCheckings (C_Compiler & inLexique,
                                const GGS_parsedComponentStruct  var_cas_inParsedComponentStruct,
                                const GGS_location   var_cas_inEndOfSourceFile COMMA_UNUSED_LOCATION_ARGS) {
  #ifdef DEBUG_TRACE_ENABLED
    printf ("ENTER routine_performProjectGlobalCheckings at %s:%d\n", __FILE__, __LINE__) ;
  #endif
  GGS_semanticDeclarationListAST  var_cas_semanticDeclarationList = GGS_semanticDeclarationListAST ::constructor_emptyList () ;
  {
    GGS_parsedSemanticsComponentMap::cEnumerator enumerator_7140 (var_cas_inParsedComponentStruct.reader_mParsedSemanticsComponentMap (inLexique COMMA_SOURCE_FILE_AT_LINE (151)), true) ;
    const GGS_parsedSemanticsComponentMap::cElement * operand_7140 = NULL ;
    while (((operand_7140 = enumerator_7140.nextObject ()))) {
      macroValidPointer (operand_7140) ;
      var_cas_semanticDeclarationList.dotAssign_operation (operand_7140->mInfo.mRoot.reader_mSemanticDeclarations (inLexique COMMA_SOURCE_FILE_AT_LINE (152)).reader_mSemanticDeclarationList (inLexique COMMA_SOURCE_FILE_AT_LINE (152))) ;
    }
  }
  GGS_semanticContextEX var_cas_semanticContext ;
  ::routine_buildSemanticContext (inLexique,  var_cas_semanticDeclarationList,  var_cas_inEndOfSourceFile,  var_cas_semanticContext COMMA_SOURCE_FILE_AT_LINE (156)) ;
  const GGS_bool cond_8543 = (GGS_uint ::constructor_errorCount (inLexique COMMA_HERE)).operator_isEqual (GGS_uint (0U)) ;
  if (cond_8543.isBuiltAndTrue ()) {
    GGS_abstractMultiMethodListMapAST var_cas_abstractCategoryMethodListMap = GGS_abstractMultiMethodListMapAST::constructor_emptyMap () ;
    GGS_multiMethodListMapAST var_cas_categoryMethodListMap = GGS_multiMethodListMapAST::constructor_emptyMap () ;
    GGS_overridingMultiMethodListMapAST var_cas_overridingCategoryMethodListMap = GGS_overridingMultiMethodListMapAST::constructor_emptyMap () ;
    {
      GGS_parsedSemanticsComponentMap::cEnumerator enumerator_7844 (var_cas_inParsedComponentStruct.reader_mParsedSemanticsComponentMap (inLexique COMMA_SOURCE_FILE_AT_LINE (163)), true) ;
      const GGS_parsedSemanticsComponentMap::cElement * operand_7844 = NULL ;
      while (((operand_7844 = enumerator_7844.nextObject ()))) {
        macroValidPointer (operand_7844) ;
        var_cas_abstractCategoryMethodListMap.dotAssign_operation (operand_7844->mInfo.mRoot.reader_mSemanticDeclarations (inLexique COMMA_SOURCE_FILE_AT_LINE (164)).reader_mAbstractCategoryMethodListMap (inLexique COMMA_SOURCE_FILE_AT_LINE (164))) ;
        var_cas_overridingCategoryMethodListMap.dotAssign_operation (operand_7844->mInfo.mRoot.reader_mSemanticDeclarations (inLexique COMMA_SOURCE_FILE_AT_LINE (165)).reader_mOverridingCategoryMethodListMap (inLexique COMMA_SOURCE_FILE_AT_LINE (165))) ;
      }
    }
    GGS_descendantClassListMap var_cas_descendantClassListMap = var_cas_semanticContext.reader_mDescendantClassListMap (inLexique COMMA_SOURCE_FILE_AT_LINE (167)) ;
    {
      GGS_abstractMultiMethodListMapAST::cEnumerator enumerator_8270 (var_cas_abstractCategoryMethodListMap, true) ;
      while (enumerator_8270.hasCurrentObject ()) {
        {
          GGS_abstracMultiMethodListAST::cEnumerator enumerator_8294 (enumerator_8270._object (HERE), true) ;
          const GGS_abstracMultiMethodListAST::cElement * operand_8294 = NULL ;
          while (((operand_8294 = enumerator_8294.nextObject ()))) {
            macroValidPointer (operand_8294) ;
            ::routine_checkCategoryMethodDefinitionForClass (inLexique,  enumerator_8270._key (HERE),  enumerator_8270._key (HERE),  operand_8294->mAbstractCategoryMethodName,  var_cas_descendantClassListMap,  var_cas_overridingCategoryMethodListMap COMMA_SOURCE_FILE_AT_LINE (170)) ;
          }
        }
        enumerator_8270.next () ;
      }
    }
  }
  const GGS_bool cond_9635 = (GGS_uint ::constructor_errorCount (inLexique COMMA_HERE)).operator_isEqual (GGS_uint (0U)) ;
  if (cond_9635.isBuiltAndTrue ()) {
    GGS_abstractMultiReaderListMapAST var_cas_abstractCategoryReaderListMap = GGS_abstractMultiReaderListMapAST::constructor_emptyMap () ;
    GGS_multiReaderListMapAST var_cas_categoryReaderListMap = GGS_multiReaderListMapAST::constructor_emptyMap () ;
    GGS_overridingMultiReaderListMapAST var_cas_overridingCategoryReaderListMap = GGS_overridingMultiReaderListMapAST::constructor_emptyMap () ;
    {
      GGS_parsedSemanticsComponentMap::cEnumerator enumerator_8936 (var_cas_inParsedComponentStruct.reader_mParsedSemanticsComponentMap (inLexique COMMA_SOURCE_FILE_AT_LINE (186)), true) ;
      const GGS_parsedSemanticsComponentMap::cElement * operand_8936 = NULL ;
      while (((operand_8936 = enumerator_8936.nextObject ()))) {
        macroValidPointer (operand_8936) ;
        var_cas_abstractCategoryReaderListMap.dotAssign_operation (operand_8936->mInfo.mRoot.reader_mSemanticDeclarations (inLexique COMMA_SOURCE_FILE_AT_LINE (187)).reader_mAbstractCategoryReaderListMap (inLexique COMMA_SOURCE_FILE_AT_LINE (187))) ;
        var_cas_overridingCategoryReaderListMap.dotAssign_operation (operand_8936->mInfo.mRoot.reader_mSemanticDeclarations (inLexique COMMA_SOURCE_FILE_AT_LINE (188)).reader_mOverridingCategoryReaderListMap (inLexique COMMA_SOURCE_FILE_AT_LINE (188))) ;
      }
    }
    GGS_descendantClassListMap var_cas_descendantClassListMap = var_cas_semanticContext.reader_mDescendantClassListMap (inLexique COMMA_SOURCE_FILE_AT_LINE (190)) ;
    {
      GGS_abstractMultiReaderListMapAST::cEnumerator enumerator_9362 (var_cas_abstractCategoryReaderListMap, true) ;
      while (enumerator_9362.hasCurrentObject ()) {
        {
          GGS_abstractMultiReaderListAST::cEnumerator enumerator_9386 (enumerator_9362._object (HERE), true) ;
          const GGS_abstractMultiReaderListAST::cElement * operand_9386 = NULL ;
          while (((operand_9386 = enumerator_9386.nextObject ()))) {
            macroValidPointer (operand_9386) ;
            ::routine_checkCategoryReaderDefinitionForClass (inLexique,  enumerator_9362._key (HERE),  enumerator_9362._key (HERE),  operand_9386->mAbstractCategoryReaderName,  var_cas_descendantClassListMap,  var_cas_overridingCategoryReaderListMap COMMA_SOURCE_FILE_AT_LINE (193)) ;
          }
        }
        enumerator_9362.next () ;
      }
    }
  }
  #ifdef DEBUG_TRACE_ENABLED
    printf ("LEAVE routine_performProjectGlobalCheckings\n") ;
  #endif
}

//---------------------------------------------------------------------------*

const C_galgas_type_descriptorEX kTypeDescriptor_GGS_targetFileListMap ("targetFileListMap", false, NULL) ;

//---------------------------------------------------------------------------*

GGS_targetFileListMap::cElement::cElement (LOCATION_ARGS) :
cPtrListMapObject (THERE),
mListObject (GGS_stringlist::constructor_emptyList ()) {
}

//---------------------------------------------------------------------------*

cPtrObject * GGS_targetFileListMap::cElement::cloneObject (LOCATION_ARGS) {
  cElement * result = NULL ;
  macroMyNew (result, cElement (THERE)) ;
  result->mListObject = mListObject ;
  return result ;
}

//---------------------------------------------------------------------------*

bool GGS_targetFileListMap::cElement::isEqual (const cPtrListMapObject * inOperand) const {
  const GGS_bool equal = mListObject.operator_isEqual (((cElement *) inOperand)->mListObject) ;
  return equal.boolValue () ;
}

//---------------------------------------------------------------------------*

C_String GGS_targetFileListMap::cElement::
performDescription (const PMSInt32 inIndentation) const {
  const GGS_string s = mListObject.reader_description (inIndentation) ;
  return s.string () ;
}

//---------------------------------------------------------------------------*

GGS_targetFileListMap GGS_targetFileListMap::
constructor_emptyMap (void) {
  GGS_targetFileListMap result ;
  result.alloc (HERE) ;
  return result ;
}

//---------------------------------------------------------------------------*

const char * GGS_targetFileListMap::
_typeNameForDescriptionReader (void) const {
  return "@targetFileListMap" ;
}

//---------------------------------------------------------------------------*

GGS_targetFileListMap GGS_targetFileListMap::
operator_concat (const GGS_targetFileListMap & inOperand) const {
  GGS_targetFileListMap result = * this ;
  result.dotAssign_operation (inOperand) ;
  return result ;
}

//---------------------------------------------------------------------------*

void GGS_targetFileListMap::
dotAssign_operation (const GGS_targetFileListMap inOperand) {
  if (isBuilt () && inOperand.isBuilt ()) {
    if (count (HERE) == 0) {
      * this = inOperand ;
    }else if (inOperand.count (HERE) > 0) {
      cPtrDictionary * dictPtr = macroPtr (inOperand, cPtrDictionary)  ;
      cPtrDictionaryNode * nodeSortedArray = dictPtr->nodeSortedArray () ;
      const PMSInt32 objectCount = dictPtr->count () ;
      for (PMSInt32 i=0 ; i<objectCount ; i++) {
        const GGS_string key = nodeSortedArray [i].key () ;
        const PM_C_Object object = nodeSortedArray [i].mObject ;
        cElement * elementPtr = macroPtr (object, cElement) ;
        bool wasInserted = false ;
        cPtrDictionaryNode * nodePtr = findOrAddNodeForKey (key, wasInserted) ;
        if (wasInserted) {
           cElement * p = NULL ;
           macroMyNew (p, cElement (HERE)) ;
           nodePtr->mObject.setPointer (p) ;
        }
        GGS_stringlist & listPtr = macroPtr (nodePtr->mObject, cElement)->mListObject ;
        listPtr.dotAssign_operation (elementPtr->mListObject) ;
      }
    }
  }
}

//---------------------------------------------------------------------------*

void GGS_targetFileListMap::
addAssign_operation (const GGS_string & inKey,
                      const GGS_string& inAttribute0) {
  if (isBuilt () && inKey.isBuilt () && inAttribute0.isBuilt ()) {
    bool wasInserted = false ;
    cPtrDictionaryNode * nodePtr = findOrAddNodeForKey (inKey, wasInserted) ;
    MF_Assert (nodePtr != NULL, "NULL pointer (was inserted %d)", wasInserted, 0) ;
    if (wasInserted) {
       cElement * p = NULL ;
       macroMyNew (p, cElement (HERE)) ;
       nodePtr->mObject.setPointer (p) ;
    }
    GGS_stringlist & listPtr = macroPtr (nodePtr->mObject, cElement)->mListObject ;
    listPtr.addAssign_operation (inAttribute0) ;
  }
}

//---------------------------------------------------------------------------*

GGS_stringlist GGS_targetFileListMap::
reader_listForKey (C_Compiler & /* inLexique */,
                   const GGS_string & inKey
                   COMMA_UNUSED_LOCATION_ARGS) const {
  GGS_stringlist result ;
  if (isBuilt () && inKey.isBuilt ()) {
    cPtrDictionaryNode * nodePtr = dictionaryNodeForKey (inKey.string ()) ; 
    if (nodePtr == NULL) {
      result = GGS_stringlist::constructor_emptyList () ;
    }else{
      result = macroPtr (nodePtr->mObject, cElement)->mListObject ;
    }
  }
  return result ;
}

//---------------------------------------------------------------------------*

GGS_stringset GGS_targetFileListMap::
reader_allKeys (C_Compiler & /* inLexique */
                COMMA_UNUSED_LOCATION_ARGS) const {

  GGS_stringset result ;
  result.setPointer (_pointer ()) ;
  return result ;
}

//---------------------------------------------------------------------------*

GGS_stringlist GGS_targetFileListMap::
reader_keyList (C_Compiler & /* inLexique */
                COMMA_UNUSED_LOCATION_ARGS) const {

  GGS_stringlist result ;
  if (isBuilt ()) {
    result = GGS_stringlist::constructor_emptyList () ;
    cPtrDictionary * dictPtr = macroPtr (*this, cPtrDictionary)  ;
    cPtrDictionaryNode * nodeSortedArray = dictPtr->nodeSortedArray () ;
    const PMSInt32 objectCount = dictPtr->count () ;
    for (PMSInt32 i=0 ; i<objectCount ; i++) {
      const GGS_string key = nodeSortedArray [i].key () ;
      result.addAssign_operation (key) ;
    }
  }
  return result ;
}

//---------------------------------------------------------------------------*

GGS_targetFileListMap::cEnumerator::
cEnumerator (const GGS_targetFileListMap & inListMap,
             const bool inAscending) :
cAbstractDictionaryEnumerator (inListMap, inAscending) {
}

//---------------------------------------------------------------------------*

const GGS_stringlist & GGS_targetFileListMap::cEnumerator::
_object (LOCATION_ARGS) const {
  cPtrDictionary * dictPtr = macroPtr (mEnumeratedDictionary, cPtrDictionary)  ;
  MF_AssertThere (currentIndex () >= 0, "Access with negative index %d", currentIndex (), 0) ;
  MF_AssertThere (currentIndex () < dictPtr->count (), "Access with index %d >= count %d", currentIndex (), dictPtr->count ()) ;
  cPtrDictionaryNode * nodeSortedArray = dictPtr->nodeSortedArray () ;
  PM_C_Object listObject = nodeSortedArray [currentIndex ()].mObject ;
  cElement * objectPtr = macroPtr (listObject, cElement) ;
  return objectPtr->mListObject ;
}

//---------------------------------------------------------------------------*

GGS_object GGS_targetFileListMap::reader_object (void) const {
  GGS_object result ;
  if (isBuilt ()) {
    GGS_targetFileListMap * p = NULL ;
    macroMyNew (p, GGS_targetFileListMap (*this)) ;
    result = GGS_object (p) ;
  }
  return result ;
}

//---------------------------------------------------------------------------*

GGS_targetFileListMap GGS_targetFileListMap::castFromObject (C_Compiler & inLexique,
                                   const GGS_object & inObject,
                                   const GGS_location & inErrorLocation
                                   COMMA_LOCATION_ARGS) {
  GGS_targetFileListMap result ;
  const GGS__root * embeddedObject = inObject.embeddedObject () ;
  if (NULL != embeddedObject) {
    const GGS_targetFileListMap * p = dynamic_cast <const GGS_targetFileListMap *> (embeddedObject) ;
    if (NULL != p) {
      result = * p ;
    }else{
      castFromObjectErrorSignaling (inLexique, inErrorLocation, & kTypeDescriptor_GGS_targetFileListMap, embeddedObject COMMA_THERE) ;
    }
  }
  return result ;
}

//---------------------------------------------------------------------------*

const C_galgas_type_descriptorEX * GGS_targetFileListMap::typeDescriptor (void) const {
  return & kTypeDescriptor_GGS_targetFileListMap ;
}

//---------------------------------------------------------------------------*
//                                                                           *
//                         class 'e_sourceFileMap'                           *
//                                                                           *
//---------------------------------------------------------------------------*

e_sourceFileMap::e_sourceFileMap (void) :
mFullPath (),
mSourceKind () {
}

//---------------------------------------------------------------------------*
//                                                                           *
//                        class map '@sourceFileMap'                         *
//                                                                           *
//---------------------------------------------------------------------------*

const C_galgas_type_descriptorEX kTypeDescriptor_GGS_sourceFileMap ("sourceFileMap", false, NULL) ;

//---------------------------------------------------------------------------*

elementOf_GGS_sourceFileMap::
elementOf_GGS_sourceFileMap (const GGS_lstring & inKey,
              const PMSInt32 inIndex,
              const e_sourceFileMap & inInfo) :
AC_galgas_map_element (inKey, inIndex),
mInfo (inInfo) {
}

//---------------------------------------------------------------------------*

void elementOf_GGS_sourceFileMap::
appendForMapDescription (const PMSInt32 inElementIndex,
                         C_String & ioString,
                         const PMSInt32 inIndentation) const {
  ioString << "\n" ;
  ioString.writeStringMultiple ("| ", inIndentation) ;
  ioString << "|-key " ;
  ioString.appendSigned (inElementIndex) ;
  ioString << ":" << mKey.reader_description (inIndentation + 1) ;
  ioString << "\n" ;
  ioString.writeStringMultiple ("| ", inIndentation) ;
  ioString << "|-value " ;
  ioString.appendSigned (inElementIndex) ;
  ioString << ":" << mInfo.mFullPath.reader_description (inIndentation + 1) ;
  ioString << "\n" ;
  ioString.writeStringMultiple ("| ", inIndentation) ;
  ioString << "|-value " ;
  ioString.appendSigned (inElementIndex) ;
  ioString << ":" << mInfo.mSourceKind.reader_description (inIndentation + 1) ;
}

//---------------------------------------------------------------------------*

bool elementOf_GGS_sourceFileMap::
isEqualToMapElement (const AC_galgas_map_element * inOperand) const {
  const elementOf_GGS_sourceFileMap * ptr = dynamic_cast <const elementOf_GGS_sourceFileMap *> (inOperand) ;
  macroValidPointer (ptr) ;
  return (mInfo.mFullPath.operator_isEqual (ptr->mInfo.mFullPath)).boolValue ()
           && (mInfo.mSourceKind.operator_isEqual (ptr->mInfo.mSourceKind)).boolValue () ;
}

//---------------------------------------------------------------------------*

AC_galgas_map_element * GGS_sourceFileMap::
new_element (const GGS_lstring & inKey, void * inInfo) {
  MF_Assert (reinterpret_cast <e_sourceFileMap *> (inInfo) != NULL, "Dynamic cast error", 0, 0) ;
  AC_galgas_map_element * p = NULL ;
  e_sourceFileMap * info = (e_sourceFileMap *) inInfo ;
  macroMyNew (p, cElement (inKey, nextIndex (), * info)) ;
  return p ;
}

//---------------------------------------------------------------------------*

void GGS_sourceFileMap::
assignInfo (AC_galgas_map_element * inPtr, void * inInfo) {
  MF_Assert (reinterpret_cast <cElement *> (inPtr) != NULL, "Dynamic cast error", 0, 0) ;
  MF_Assert (reinterpret_cast <e_sourceFileMap *> (inInfo) != NULL, "Dynamic cast error", 0, 0) ;
  cElement * p = (cElement *) inPtr ;
  e_sourceFileMap * info = (e_sourceFileMap *) inInfo ;
  p->mInfo = * info ;
}

//---------------------------------------------------------------------------*

GGS_sourceFileMap GGS_sourceFileMap::
constructor_emptyMap (C_Compiler & /* inLexique */ COMMA_UNUSED_LOCATION_ARGS) {
  GGS_sourceFileMap result ;
  macroMyNew (result.mSharedMapRoot, cMapRoot) ;
  return result ;
}

//---------------------------------------------------------------------------*

void GGS_sourceFileMap::
enterIndex (const GGS_lstring & inKey,
            AC_galgas_index_core & outIndex) {
  e_sourceFileMap info  ;
  internalEnterIndex (inKey,
                      (void *) & info,
                      outIndex) ;
}

//---------------------------------------------------------------------------*

GGS_bool GGS_sourceFileMap::
operator_isEqual (const GGS_sourceFileMap & inOperand) const {
  return GGS_bool (isBuilt () && inOperand.isBuilt (), isEqualToMap (inOperand)) ;
}

//---------------------------------------------------------------------------*

GGS_bool GGS_sourceFileMap::
operator_isNotEqual (const GGS_sourceFileMap & inOperand) const {
  return GGS_bool (isBuilt () && inOperand.isBuilt (), ! isEqualToMap (inOperand)) ;
}

//---------------------------------------------------------------------------*

void GGS_sourceFileMap::
internalInsertForDuplication (AC_galgas_map_element * inPtr) {
  MF_Assert (reinterpret_cast <cElement *> (inPtr) != NULL, "Dynamic cast error", 0, 0) ;
  cElement * p = (cElement *) inPtr ;
  PMSInt32 attributeIndex = -1 ; // Unused here
  GGS_location existingKeyLocation ; // Unused here
  internalInsert (p->mKey, (void *) & p->mInfo, attributeIndex, existingKeyLocation) ;
}

//---------------------------------------------------------------------------*

void GGS_sourceFileMap::
insertElement (C_Compiler & inLexique,
                const utf32 * inErrorMessage,
                const GGS_lstring & inKey,
                const GGS_string& inParameter0,
                const GGS_sourceFileKind& inParameter1,
                GGS_luint * outIndex
                COMMA_LOCATION_ARGS) {
  PMSInt32 elementID = - 1 ;
  if (isBuilt ()
   && inParameter0.isBuilt ()
   && inParameter1.isBuilt ()
   && inKey.isBuilt ()) {
    insulateMap () ;
    e_sourceFileMap info  ;
    info.mFullPath = inParameter0 ;
    info.mSourceKind = inParameter1 ;
    GGS_location existingKeyLocation ;
    internalInsert (inKey, (void *) & info, elementID, existingKeyLocation) ;
    if (elementID < 0) {
      emitInsertMapSemanticErrorMessage (inLexique, inKey, inErrorMessage, existingKeyLocation COMMA_THERE) ;
    }
  }
  if (outIndex != NULL) {
    * outIndex = GGS_luint (GGS_uint (elementID >= 0, (PMUInt32) elementID), inKey) ;
  }
}

//---------------------------------------------------------------------------*

void GGS_sourceFileMap::
searchElement (C_Compiler & inLexique,
               const utf32 * inErrorMessage,
               const GGS_lstring & inKey,
               GGS_string  & outParameter0,
               GGS_sourceFileKind  & outParameter1,
               GGS_luint * outIndex
               COMMA_LOCATION_ARGS) const {
  cElement * node = NULL  ;
  if (isBuilt () && inKey.isBuilt ()) {
    AC_galgas_map_element * p = internal_search (inKey.string ()) ;
    MF_Assert ((p == NULL) || (reinterpret_cast <cElement *> (p) != NULL), "Dynamic cast error", 0, 0) ;
    node = (cElement *) p ;
    if (node == NULL) {
      emitMapSemanticErrorMessage (inLexique, inKey, inErrorMessage COMMA_THERE) ;
    }
  }
  if (node == NULL) {
    outParameter0.drop () ;
    outParameter1.drop () ;
    if (outIndex != NULL) {
      outIndex->drop () ;
     }
  }else{
    outParameter0 = node->mInfo.mFullPath ;
    outParameter1 = node->mInfo.mSourceKind ;
    if (outIndex != NULL) {
      * outIndex = GGS_luint (GGS_uint (true, (PMUInt32) node->mID), inKey) ;
    }
  }
}

//---------------------------------------------------------------------------*

const utf32 GGS_sourceFileMap::kSearchMessage_searchKey [] = {
  TO_UNICODE ('t'),
  TO_UNICODE ('h'),
  TO_UNICODE ('e'),
  TO_UNICODE (' '),
  TO_UNICODE ('\''),
  TO_UNICODE ('%'),
  TO_UNICODE ('K'),
  TO_UNICODE ('\''),
  TO_UNICODE (' '),
  TO_UNICODE ('s'),
  TO_UNICODE ('o'),
  TO_UNICODE ('u'),
  TO_UNICODE ('r'),
  TO_UNICODE ('c'),
  TO_UNICODE ('e'),
  TO_UNICODE (' '),
  TO_UNICODE ('b'),
  TO_UNICODE ('a'),
  TO_UNICODE ('s'),
  TO_UNICODE ('e'),
  TO_UNICODE (' '),
  TO_UNICODE ('n'),
  TO_UNICODE ('a'),
  TO_UNICODE ('m'),
  TO_UNICODE ('e'),
  TO_UNICODE (' '),
  TO_UNICODE ('i'),
  TO_UNICODE ('s'),
  TO_UNICODE (' '),
  TO_UNICODE ('n'),
  TO_UNICODE ('o'),
  TO_UNICODE ('t'),
  TO_UNICODE (' '),
  TO_UNICODE ('d'),
  TO_UNICODE ('e'),
  TO_UNICODE ('c'),
  TO_UNICODE ('l'),
  TO_UNICODE ('a'),
  TO_UNICODE ('r'),
  TO_UNICODE ('e'),
  TO_UNICODE ('d'),
  TO_UNICODE (0)
} ;

//---------------------------------------------------------------------------*

void GGS_sourceFileMap::
method_searchKey (C_Compiler & inLexique,
                                const GGS_lstring & inKey,
                                GGS_string  & outParameter0,
                                GGS_sourceFileKind  & outParameter1 COMMA_LOCATION_ARGS) const {
  searchElement (inLexique,
                  kSearchMessage_searchKey,
                  inKey,
                  outParameter0,
                  outParameter1,
                  NULL
                  COMMA_THERE) ;
}

//---------------------------------------------------------------------------*

const utf32 GGS_sourceFileMap::kInsertMessage_insertKey [] = {
  TO_UNICODE ('t'),
  TO_UNICODE ('h'),
  TO_UNICODE ('e'),
  TO_UNICODE (' '),
  TO_UNICODE ('\''),
  TO_UNICODE ('%'),
  TO_UNICODE ('K'),
  TO_UNICODE ('\''),
  TO_UNICODE (' '),
  TO_UNICODE ('s'),
  TO_UNICODE ('o'),
  TO_UNICODE ('u'),
  TO_UNICODE ('r'),
  TO_UNICODE ('c'),
  TO_UNICODE ('e'),
  TO_UNICODE (' '),
  TO_UNICODE ('b'),
  TO_UNICODE ('a'),
  TO_UNICODE ('s'),
  TO_UNICODE ('e'),
  TO_UNICODE (' '),
  TO_UNICODE ('n'),
  TO_UNICODE ('a'),
  TO_UNICODE ('m'),
  TO_UNICODE ('e'),
  TO_UNICODE (' '),
  TO_UNICODE ('h'),
  TO_UNICODE ('a'),
  TO_UNICODE ('s'),
  TO_UNICODE (' '),
  TO_UNICODE ('b'),
  TO_UNICODE ('e'),
  TO_UNICODE ('e'),
  TO_UNICODE ('n'),
  TO_UNICODE (' '),
  TO_UNICODE ('a'),
  TO_UNICODE ('l'),
  TO_UNICODE ('r'),
  TO_UNICODE ('e'),
  TO_UNICODE ('a'),
  TO_UNICODE ('d'),
  TO_UNICODE ('y'),
  TO_UNICODE (' '),
  TO_UNICODE ('d'),
  TO_UNICODE ('e'),
  TO_UNICODE ('c'),
  TO_UNICODE ('l'),
  TO_UNICODE ('a'),
  TO_UNICODE ('r'),
  TO_UNICODE ('e'),
  TO_UNICODE ('d'),
  TO_UNICODE (' '),
  TO_UNICODE ('i'),
  TO_UNICODE ('n'),
  TO_UNICODE (' '),
  TO_UNICODE ('%'),
  TO_UNICODE ('L'),
  TO_UNICODE (0)
} ;

//---------------------------------------------------------------------------*

void GGS_sourceFileMap::
modifier_insertKey (C_Compiler & inLexique,
                                const GGS_lstring & inKey,
                                const GGS_string& inParameter0,
                                const GGS_sourceFileKind& inParameter1 COMMA_LOCATION_ARGS) {
  insertElement (inLexique,
                 kInsertMessage_insertKey,
                 inKey,
                 inParameter0,
                 inParameter1,
                 NULL
                 COMMA_THERE) ;
}

//---------------------------------------------------------------------------*

GGS_sourceFileMap GGS_sourceFileMap::
constructor_mapWithMapToOverride (C_Compiler & /* inLexique */,
                                  const GGS_sourceFileMap & inMapToOverride
                                  COMMA_UNUSED_LOCATION_ARGS) {
  GGS_sourceFileMap result ; // Not Built
  if (inMapToOverride.mSharedMapRoot != NULL) {
    macroValidPointer (inMapToOverride.mSharedMapRoot) ;
    macroMyNew (result.mSharedMapRoot, cMapRoot) ;
    result.mSharedMapRoot->mNextMap = inMapToOverride.mSharedMapRoot ;
    inMapToOverride.mSharedMapRoot->mReferenceCount ++ ;
    result.mSharedMapRoot->mSequenceNumber = inMapToOverride.mSharedMapRoot->mSequenceNumber ;
  }
  return result ;
}

//---------------------------------------------------------------------------*

GGS_sourceFileMap GGS_sourceFileMap::
reader_overriddenMap (C_Compiler & /* inLexique */
                      COMMA_UNUSED_LOCATION_ARGS) const {
  GGS_sourceFileMap result ; // Not Built
  if (mSharedMapRoot != NULL) {
    macroValidPointer (mSharedMapRoot) ;
    result.mSharedMapRoot = mSharedMapRoot->mNextMap ;
    if (result.mSharedMapRoot != NULL) {
      macroValidPointer (result.mSharedMapRoot) ;
      result.mSharedMapRoot->mReferenceCount ++ ;
    }else{
      macroMyNew (result.mSharedMapRoot, cMapRoot) ;
    }
  }
  return result ;
}

//---------------------------------------------------------------------------*

GGS_string GGS_sourceFileMap::
reader_description (const PMSInt32 inIndentation) const {
  C_String s ;
  s << "<map @sourceFileMap " ;
  if (isBuilt ()) {
    s.appendSigned (count ()) ;
    s << " object" << ((count () > 1) ? "s " : " ") ;
    cMapRoot * mapRoot = mSharedMapRoot ;
    PMSInt32 level = 0 ;
    while (mapRoot != NULL) {
      if (level > 0) {
        s << "\n" ;
        s.writeStringMultiple ("| ", inIndentation) ;
        s << "------- level " << cStringWithSigned (level) ;
      }
      macroValidPointer (mapRoot) ;
      cElement * p = (cElement *) mapRoot->mFirstItem ;
      PMSInt32 elementID = 0 ;
      while (p != NULL) {
        macroValidPointer (p) ;
        p->appendForMapDescription (elementID, s, inIndentation) ;
        p = p->nextObject () ;
        elementID ++ ;
      }
      mapRoot = mapRoot->mNextMap ;
      level ++ ;
    }
  }else{
    s << "not built" ;
  }
  s << "\n" ;
  s.writeStringMultiple ("| ", inIndentation) ;
  s << ">" ;
  return GGS_string (true, s) ;
}

//---------------------------------------------------------------------------*

/* const */ GGS_string & GGS_sourceFileMap::cEnumerator::_mFullPath (LOCATION_ARGS) const {
  return ((cElement *) mObjectArray (mCurrentIndex COMMA_THERE))->mInfo.mFullPath ;
}

//---------------------------------------------------------------------------*

/* const */ GGS_sourceFileKind & GGS_sourceFileMap::cEnumerator::_mSourceKind (LOCATION_ARGS) const {
  return ((cElement *) mObjectArray (mCurrentIndex COMMA_THERE))->mInfo.mSourceKind ;
}

//---------------------------------------------------------------------------*

GGS_object GGS_sourceFileMap::reader_object (void) const {
  GGS_object result ;
  if (isBuilt ()) {
    GGS_sourceFileMap * p = NULL ;
    macroMyNew (p, GGS_sourceFileMap (*this)) ;
    result = GGS_object (p) ;
  }
  return result ;
}

//---------------------------------------------------------------------------*

GGS_sourceFileMap GGS_sourceFileMap::castFromObject (C_Compiler & inLexique,
                                   const GGS_object & inObject,
                                   const GGS_location & inErrorLocation
                                   COMMA_LOCATION_ARGS) {
  GGS_sourceFileMap result ;
  const GGS__root * embeddedObject = inObject.embeddedObject () ;
  if (NULL != embeddedObject) {
    const GGS_sourceFileMap * p = dynamic_cast <const GGS_sourceFileMap *> (embeddedObject) ;
    if (NULL != p) {
      result = * p ;
    }else{
      castFromObjectErrorSignaling (inLexique, inErrorLocation, & kTypeDescriptor_GGS_sourceFileMap, embeddedObject COMMA_THERE) ;
    }
  }
  return result ;
}

//---------------------------------------------------------------------------*

const C_galgas_type_descriptorEX * GGS_sourceFileMap::typeDescriptor (void) const {
  return & kTypeDescriptor_GGS_sourceFileMap ;
}

//---------------------------------------------------------------------------*
//                                                                           *
//         Implementation of wrapper 'fileListTemplateFileWrapper'           *
//                                                                           *
//---------------------------------------------------------------------------*

//---------------------------------------------------------------------------*

//--- All files of '' directory

static const cRegularFileWrapper * gWrapperAllFiles_fileListTemplateFileWrapper_0 [1] = {
  NULL
} ;

//---------------------------------------------------------------------------*

//--- All sub-directories of '' directory

static const cDirectoryWrapper * gWrapperAllDirectories_fileListTemplateFileWrapper_0 [1] = {
  NULL
} ;

//---------------------------------------------------------------------------*

//--- Directory ''

const cDirectoryWrapper gWrapperDirectory_0_fileListTemplateFileWrapper (
  "",
  0,
  gWrapperAllFiles_fileListTemplateFileWrapper_0,
  0,
  gWrapperAllDirectories_fileListTemplateFileWrapper_0
) ;

//---------------------------------------------------------------------------*
//                                                                           *
// 'fileListTemplate' template of 'fileListTemplateFileWrapper' filewrapper  *
//                                                                           *
//---------------------------------------------------------------------------*

GGS_string
template_filewrapper_fileListTemplateFileWrapper_fileListTemplate (C_Compiler & /* inLexique */,
                                const GGS_string& var_cas_HAND_CODED_SOURCES_SUB_DIRS,
                                const GGS_string& var_cas_GALGAS_SOURCE_LIST,
                                const GGS_string& var_cas_HAND_CODED_SOURCE_LIST) {
  C_String result ;
  const bool isBuilt = var_cas_HAND_CODED_SOURCES_SUB_DIRS.isBuilt ()
    && var_cas_GALGAS_SOURCE_LIST.isBuilt ()
    && var_cas_HAND_CODED_SOURCE_LIST.isBuilt () ;
  if (isBuilt) {
    result << "#---------------------------------------------------------------*\n"
      "\n"
      "#--- Lib PM directory\n"
      "ifdef LIBPM_PATH_ENV_VAR\n"
      "  LIB_PM_PATH := $(LIBPM_PATH_ENV_VAR)\n"
      "  $(info *** LIBPM path:\"$(LIB_PM_PATH)\" (given by LIBPM_PATH_ENV_VAR environment variable))\n"
      "else\n"
      "  ifeq ($(shell if [ -d ../libpm ] ; then echo 1 ; else echo 0 ; fi), 1) \n"
      "    LIB_PM_PATH := ../libpm\n"
      "    $(info *** LIBPM path:\"$(LIB_PM_PATH)\" (libpm found at this path))\n"
      "  else\n"
      "    ifeq ($(shell if [ -d ../../libpm ] ; then echo 1 ; else echo 0 ; fi), 1) \n"
      "      LIB_PM_PATH := ../../libpm\n"
      "      $(info *** LIBPM path:\"$(LIB_PM_PATH)\" (libpm found at this path))\n"
      "    else\n"
      "      $(error Cannot find libpm: neither ../libpm nor ../../libpm exist, LIBPM_PATH_ENV_VAR environment variable does not exist)\n"
      "      LIB_PM_PATH :=\n"
      "    endif\n"
      "  endif\n"
      "endif\n"
      "\n"
      "#---------------------------------------------------------------*\n"
      "#                                                               *\n"
      "#     Project source files directories                          *\n"
      "#                                                               *\n"
      "#---------------------------------------------------------------*\n"
      "\n"
      "SOURCES_DIR := ../galgas_sources/GALGAS_OUTPUT\n" ;
    result << var_cas_HAND_CODED_SOURCES_SUB_DIRS ;
    result << "\n"
      "\n"
      "#---------------------------------------------------------------*\n"
      "#                                                               *\n"
      "#     Source files names list (without their actual path)       *\n"
      "#                                                               *\n"
      "#---------------------------------------------------------------*\n"
      "\n"
      "SOURCES :=\n"
      "\n"
      "#--- Files from libpm --------------------\n"
      "include $(LIB_PM_PATH)/galgas/galgas_sources_for_makefile.mke\n"
      "\n"
      "#--- Hand-coded files ---------------------\n" ;
    result << var_cas_HAND_CODED_SOURCE_LIST ;
    result << "\n"
      "\n"
      "#--- Files generated by GALGAS ------------\n" ;
    result << var_cas_GALGAS_SOURCE_LIST ;
    result << "\n"
      "\n"
      "#---------------------------------------------------------------*\n" ;
  }
  return GGS_string (isBuilt, result) ;
}

//---------------------------------------------------------------------------*

