//---------------------------------------------------------------------------*
//                                                                           *
//                        File 'optionMetamodel.cpp'                         *
//                 Generated by version GALGAS_BETA_VERSION                  *
//                       may 21th, 2009, at 14h42'29"                        *
//                                                                           *
//---------------------------------------------------------------------------*

//--- START OF USER ZONE 1


//--- END OF USER ZONE 1

//---------------------------------------------------------------------------*

#include "version_libpm.h"
#if LIBPM_VERSION != THE_LIBPM_VERSION
  #error "This file has been compiled with a version of GALGAS different than the version of libpm"
#endif

//---------------------------------------------------------------------------*

#include <typeinfo>
#include "utilities/MF_MemoryControl.h"
#include "files/C_TextFileWrite.h"
#include "optionMetamodel.h"

//---------------------------------------------------------------------------*

#ifndef DO_NOT_GENERATE_CHECKINGS
  #define SOURCE_FILE_AT_LINE(line) "optionMetamodel.gSemantics", line
  #define COMMA_SOURCE_FILE_AT_LINE(line) , SOURCE_FILE_AT_LINE(line)
#else
  #define SOURCE_FILE_AT_LINE(line) 
  #define COMMA_SOURCE_FILE_AT_LINE(line) 
#endif


//--- START OF USER ZONE 2


//--- END OF USER ZONE 2

//---------------------------------------------------------------------------*
//                                                                           *
//                 Element of list '@commandLineOptionList'                  *
//                                                                           *
//---------------------------------------------------------------------------*

elementOf_GGS_commandLineOptionList::
elementOf_GGS_commandLineOptionList (const GGS_lstring & argument_0,
                                const GGS_lstring & argument_1,
                                const GGS_lchar & argument_2,
                                const GGS_lstring & argument_3,
                                const GGS_lstring & argument_4
                                COMMA_LOCATION_ARGS) :
AC_galgas_list::cListElement (THERE),
mOptionTypeName (argument_0),
mOptionInternalName (argument_1),
mOptionInvocationLetter (argument_2),
mOptionInvocationString (argument_3),
mOptionComment (argument_4) {
}

//---------------------------------------------------------------------------*

bool elementOf_GGS_commandLineOptionList::
isEqualToObject (const cListElement * inOperand) const {
  bool equal = inOperand == this ;
  if (! equal) {
    const elementOf_GGS_commandLineOptionList * ptr = dynamic_cast <const elementOf_GGS_commandLineOptionList *> (inOperand) ;
    macroValidPointer (ptr) ;
    equal = mOptionTypeName._operator_isEqual (ptr->mOptionTypeName).boolValue ()
         && mOptionInternalName._operator_isEqual (ptr->mOptionInternalName).boolValue ()
         && mOptionInvocationLetter._operator_isEqual (ptr->mOptionInvocationLetter).boolValue ()
         && mOptionInvocationString._operator_isEqual (ptr->mOptionInvocationString).boolValue ()
         && mOptionComment._operator_isEqual (ptr->mOptionComment).boolValue () ;
  }
  return equal ;
}

//---------------------------------------------------------------------------*

void elementOf_GGS_commandLineOptionList::
appendForDescription (C_Compiler & inLexique,
                          C_String & ioString,
                          const sint32 inIndentation
                          COMMA_LOCATION_ARGS) const {
  ioString << "\n" ;
  ioString.writeStringMultiple ("| ", inIndentation) ;
  ioString << "|-" ;
  ioString << mOptionTypeName.reader_description  (inLexique COMMA_THERE, inIndentation) ;
  ioString << "\n" ;
  ioString.writeStringMultiple ("| ", inIndentation) ;
  ioString << "|-" ;
  ioString << mOptionInternalName.reader_description  (inLexique COMMA_THERE, inIndentation) ;
  ioString << "\n" ;
  ioString.writeStringMultiple ("| ", inIndentation) ;
  ioString << "|-" ;
  ioString << mOptionInvocationLetter.reader_description  (inLexique COMMA_THERE, inIndentation) ;
  ioString << "\n" ;
  ioString.writeStringMultiple ("| ", inIndentation) ;
  ioString << "|-" ;
  ioString << mOptionInvocationString.reader_description  (inLexique COMMA_THERE, inIndentation) ;
  ioString << "\n" ;
  ioString.writeStringMultiple ("| ", inIndentation) ;
  ioString << "|-" ;
  ioString << mOptionComment.reader_description  (inLexique COMMA_THERE, inIndentation) ;
}

//---------------------------------------------------------------------------*
//                                                                           *
//                      List '@commandLineOptionList'                        *
//                                                                           *
//---------------------------------------------------------------------------*

void GGS_commandLineOptionList::
_internalAppendValues (const GGS_lstring & argument_0,
                    const GGS_lstring & argument_1,
                    const GGS_lchar & argument_2,
                    const GGS_lstring & argument_3,
                    const GGS_lstring & argument_4
                    COMMA_LOCATION_ARGS) {
  cElement * nouvelElement = (cElement *) NULL ;
  macroMyNew (nouvelElement, cElement (argument_0,
                                argument_1,
                                argument_2,
                                argument_3,
                                argument_4
                                COMMA_THERE)) ;
  _internalAppendItem (nouvelElement) ;
}

//---------------------------------------------------------------------------*

void GGS_commandLineOptionList::
_internalPrependValues (const GGS_lstring & argument_0,
                    const GGS_lstring & argument_1,
                    const GGS_lchar & argument_2,
                    const GGS_lstring & argument_3,
                    const GGS_lstring & argument_4
                    COMMA_LOCATION_ARGS) {
  cElement * nouvelElement = (cElement *) NULL ;
  macroMyNew (nouvelElement, cElement (argument_0,
                                argument_1,
                                argument_2,
                                argument_3,
                                argument_4
                                COMMA_THERE)) ;
  _internalPrependItem (nouvelElement) ;
}

//---------------------------------------------------------------------------*

void GGS_commandLineOptionList::
_addAssign_operation (const GGS_lstring & argument_0,
                                const GGS_lstring & argument_1,
                                const GGS_lchar & argument_2,
                                const GGS_lstring & argument_3,
                                const GGS_lstring & argument_4) {
  if (isBuilt ()&& argument_0.isBuilt ()&& argument_1.isBuilt ()&& argument_2.isBuilt ()&& argument_3.isBuilt ()&& argument_4.isBuilt ()) {
    _insulateList () ;
    _internalAppendValues (argument_0,
                                argument_1,
                                argument_2,
                                argument_3,
                                argument_4
                                COMMA_HERE) ;
  }
}

//---------------------------------------------------------------------------*

GGS_commandLineOptionList GGS_commandLineOptionList::
_operator_concat (const GGS_commandLineOptionList & inOperand) const {
  GGS_commandLineOptionList result = * this ;
  result._dotAssign_operation (inOperand) ;
  return result ;
}

//---------------------------------------------------------------------------*

void GGS_commandLineOptionList::
_dotAssign_operation (const GGS_commandLineOptionList inOperand) {
  if (isBuilt () && inOperand.isBuilt ()) {
    if (count () == 0) {
      * this = inOperand ;
    }else{
      if (inOperand.count () > 0) {
        _insulateList () ;
        elementOf_GGS_commandLineOptionList * p = inOperand.firstObject () ;
        while (p != NULL) {
          macroValidPointer (p) ;
          GGS_lstring  p_0 = p->mOptionTypeName ;
          GGS_lstring  p_1 = p->mOptionInternalName ;
          GGS_lchar  p_2 = p->mOptionInvocationLetter ;
          GGS_lstring  p_3 = p->mOptionInvocationString ;
          GGS_lstring  p_4 = p->mOptionComment ;
          _internalAppendValues (p_0, p_1, p_2, p_3, p_4 COMMA_HERE) ;
          p = p->nextObject () ;
        }
      }
    }
  }
}

//---------------------------------------------------------------------------*

void GGS_commandLineOptionList::
modifier_prependValue (C_Compiler & /* inLexique */,
                     const GGS_lstring & argument_0,
                     const GGS_lstring & argument_1,
                     const GGS_lchar & argument_2,
                     const GGS_lstring & argument_3,
                     const GGS_lstring & argument_4
                     COMMA_UNUSED_LOCATION_ARGS) {
  if (isBuilt ()) {
    _insulateList () ;
    _internalPrependValues (argument_0,
                                argument_1,
                                argument_2,
                                argument_3,
                                argument_4
                                COMMA_HERE) ;
  }
}

//---------------------------------------------------------------------------*

void GGS_commandLineOptionList::
_insulateList (void) {
  if (_shared ()) {
    cElement * ptr = firstObject () ;
    alloc () ;
    while (ptr != NULL) {
      macroValidPointer (ptr) ;
      _internalAppendValues (ptr->mOptionTypeName,
                                ptr->mOptionInternalName,
                                ptr->mOptionInvocationLetter,
                                ptr->mOptionInvocationString,
                                ptr->mOptionComment
                                COMMA_HERE) ;
      ptr = ptr->nextObject () ;
    }
  }
}

//---------------------------------------------------------------------------*

GGS_commandLineOptionList  GGS_commandLineOptionList::
constructor_emptyList (void) {
  GGS_commandLineOptionList result ;
  result.alloc () ;
  return result ;
}

//---------------------------------------------------------------------------*

GGS_commandLineOptionList  GGS_commandLineOptionList::
constructor_listWithValue (const GGS_lstring & argument_0,
                                const GGS_lstring & argument_1,
                                const GGS_lchar & argument_2,
                                const GGS_lstring & argument_3,
                                const GGS_lstring & argument_4) {
  GGS_commandLineOptionList result ;
  result.alloc () ;
  result._addAssign_operation (argument_0, argument_1, argument_2, argument_3, argument_4) ;
  return result ;
}

//---------------------------------------------------------------------------*

void GGS_commandLineOptionList::
internalSubListWithRange (GGS_commandLineOptionList & ioList,
                          const sint32 inFirstIndex,
                          const sint32 inCount) const {
  ioList.alloc () ;
  if (inCount > 0) {
    cElement * ptr = firstObject () ;
    for (sint32 i=0 ; i<inFirstIndex ; i++) {
      macroValidPointer (ptr) ;
      ptr = ptr->nextObject () ;
    }
    for (sint32 i=0 ; i<inCount ; i++) {
      macroValidPointer (ptr) ;
      ioList._addAssign_operation (ptr->mOptionTypeName, ptr->mOptionInternalName, ptr->mOptionInvocationLetter, ptr->mOptionInvocationString, ptr->mOptionComment) ;
      ptr = ptr->nextObject () ;
    }
  }
}

//---------------------------------------------------------------------------*

GGS_commandLineOptionList GGS_commandLineOptionList::
reader_subListWithRange (C_Compiler & inLexique,
                         const GGS_uint & inFirstIndex,
                         const GGS_uint & inCount
                         COMMA_LOCATION_ARGS) const {
  GGS_commandLineOptionList result ;
  if (isBuilt () && inFirstIndex.isBuilt () && inCount.isBuilt ()) {
    const sint32 firstIndex = (sint32) inFirstIndex.uintValue () ;
    const sint32 rangeCount = (sint32) inCount.uintValue () ;
    if ((firstIndex + rangeCount) > count ()) {
      inLexique.onTheFlyRunTimeError ("'subListWithRange' method invoked with upper bound greater than list object count" COMMA_THERE) ;
    }else{
      internalSubListWithRange (result, firstIndex, rangeCount) ;
    }
  }
  return result ;
}

//---------------------------------------------------------------------------*

GGS_commandLineOptionList GGS_commandLineOptionList::
reader_subListFromIndex (C_Compiler & inLexique,
                         const GGS_uint & inIndex
                         COMMA_LOCATION_ARGS) const {
  GGS_commandLineOptionList result ;
  if (isBuilt () && inIndex.isBuilt ()) {
    const sint32 startIndex = (sint32) inIndex.uintValue () ;
    if (startIndex > count ()) {
      inLexique.onTheFlyRunTimeError ("'subListFromIndex' method invoked with start index greater than list object count" COMMA_THERE) ;
    }else{
      internalSubListWithRange (result, startIndex, count () - startIndex) ;
    }
  }
  return result ;
}

//---------------------------------------------------------------------------*

GGS_string GGS_commandLineOptionList::
reader_description (C_Compiler & inLexique
                    COMMA_LOCATION_ARGS,
                    const sint32 inIndentation) const {
  return _description (inLexique, "@commandLineOptionList", inIndentation COMMA_THERE) ;
}

//---------------------------------------------------------------------------*

void GGS_commandLineOptionList::
method_first (C_Compiler & inLexique,
              GGS_lstring & _out_0,
              GGS_lstring & _out_1,
              GGS_lchar & _out_2,
              GGS_lstring & _out_3,
              GGS_lstring & _out_4
              COMMA_LOCATION_ARGS) const {
  cElement * ptr = NULL ;
  if (isBuilt ()) {
    ptr = firstObject () ;
    if (ptr == NULL) {
      inLexique.onTheFlyRunTimeError ("'first' method invoked on an empty list" COMMA_THERE) ;
    }
  }
  if (ptr != NULL) {
    _out_0 = ptr->mOptionTypeName ;
    _out_1 = ptr->mOptionInternalName ;
    _out_2 = ptr->mOptionInvocationLetter ;
    _out_3 = ptr->mOptionInvocationString ;
    _out_4 = ptr->mOptionComment ;
  }else{
    _out_0.drop () ;
    _out_1.drop () ;
    _out_2.drop () ;
    _out_3.drop () ;
    _out_4.drop () ;
  }
}

//---------------------------------------------------------------------------*

void GGS_commandLineOptionList::
method_last (C_Compiler & inLexique,
             GGS_lstring & _out_0,
             GGS_lstring & _out_1,
             GGS_lchar & _out_2,
             GGS_lstring & _out_3,
             GGS_lstring & _out_4
             COMMA_LOCATION_ARGS) const {
  cElement * ptr = NULL ;
  if (isBuilt ()) {
    ptr = lastObject () ;
    if (ptr == NULL) {
      inLexique.onTheFlyRunTimeError ("'last' method invoked on an empty list" COMMA_THERE) ;
    }
  }
  if (ptr != NULL) {
    _out_0 = ptr->mOptionTypeName ;
    _out_1 = ptr->mOptionInternalName ;
    _out_2 = ptr->mOptionInvocationLetter ;
    _out_3 = ptr->mOptionInvocationString ;
    _out_4 = ptr->mOptionComment ;
  }else{
    _out_0.drop () ;
    _out_1.drop () ;
    _out_2.drop () ;
    _out_3.drop () ;
    _out_4.drop () ;
  }
}

//---------------------------------------------------------------------------*

void GGS_commandLineOptionList::
modifier_popFirst (C_Compiler & inLexique,
                 GGS_lstring & _out_0,
                 GGS_lstring & _out_1,
                 GGS_lchar & _out_2,
                 GGS_lstring & _out_3,
                 GGS_lstring & _out_4
                 COMMA_LOCATION_ARGS) {
  cElement * ptr = NULL ;
  if (isBuilt ()) {
    ptr = firstObject () ;
    if (ptr == NULL) {
      inLexique.onTheFlyRunTimeError ("'popFirst' modifier invoked on an empty list" COMMA_THERE) ;
    }
  }
  if (ptr != NULL) {
    _out_0 = ptr->mOptionTypeName ;
    _out_1 = ptr->mOptionInternalName ;
    _out_2 = ptr->mOptionInvocationLetter ;
    _out_3 = ptr->mOptionInvocationString ;
    _out_4 = ptr->mOptionComment ;
    _insulateList () ;
    _internalRemoveFirst () ;
  }else{
    _out_0.drop () ;
    _out_1.drop () ;
    _out_2.drop () ;
    _out_3.drop () ;
    _out_4.drop () ;
  }
}

//---------------------------------------------------------------------------*

void GGS_commandLineOptionList::
modifier_popLast (C_Compiler & inLexique,
                GGS_lstring & _out_0,
                GGS_lstring & _out_1,
                GGS_lchar & _out_2,
                GGS_lstring & _out_3,
                GGS_lstring & _out_4
                COMMA_LOCATION_ARGS) {
  cElement * ptr = NULL ;
  if (isBuilt ()) {
    ptr = lastObject () ;
    if (ptr == NULL) {
      inLexique.onTheFlyRunTimeError ("'popLast' modifier invoked on an empty list" COMMA_THERE) ;
    }
  }
  if (ptr != NULL) {
    _out_0 = ptr->mOptionTypeName ;
    _out_1 = ptr->mOptionInternalName ;
    _out_2 = ptr->mOptionInvocationLetter ;
    _out_3 = ptr->mOptionInvocationString ;
    _out_4 = ptr->mOptionComment ;
    _insulateList () ;
    _internalRemoveLast () ;
  }else{
    _out_0.drop () ;
    _out_1.drop () ;
    _out_2.drop () ;
    _out_3.drop () ;
    _out_4.drop () ;
  }
}

//---------------------------------------------------------------------------*

GGS_lstring  GGS_commandLineOptionList::
reader_mOptionTypeNameAtIndex (C_Compiler & inLexique, const GGS_uint & inIndex COMMA_LOCATION_ARGS) const {
  GGS_lstring  result ;
  if (isBuilt () && inIndex.isBuilt ()) {
    cElement * object = (cElement *) objectAtIndex (inLexique, inIndex.uintValue () COMMA_THERE) ;
    if (object != NULL) {
      result = object->mOptionTypeName ;
    }
  }
  return result ;
}

//---------------------------------------------------------------------------*

GGS_lstring  GGS_commandLineOptionList::
reader_mOptionInternalNameAtIndex (C_Compiler & inLexique, const GGS_uint & inIndex COMMA_LOCATION_ARGS) const {
  GGS_lstring  result ;
  if (isBuilt () && inIndex.isBuilt ()) {
    cElement * object = (cElement *) objectAtIndex (inLexique, inIndex.uintValue () COMMA_THERE) ;
    if (object != NULL) {
      result = object->mOptionInternalName ;
    }
  }
  return result ;
}

//---------------------------------------------------------------------------*

GGS_lchar  GGS_commandLineOptionList::
reader_mOptionInvocationLetterAtIndex (C_Compiler & inLexique, const GGS_uint & inIndex COMMA_LOCATION_ARGS) const {
  GGS_lchar  result ;
  if (isBuilt () && inIndex.isBuilt ()) {
    cElement * object = (cElement *) objectAtIndex (inLexique, inIndex.uintValue () COMMA_THERE) ;
    if (object != NULL) {
      result = object->mOptionInvocationLetter ;
    }
  }
  return result ;
}

//---------------------------------------------------------------------------*

GGS_lstring  GGS_commandLineOptionList::
reader_mOptionInvocationStringAtIndex (C_Compiler & inLexique, const GGS_uint & inIndex COMMA_LOCATION_ARGS) const {
  GGS_lstring  result ;
  if (isBuilt () && inIndex.isBuilt ()) {
    cElement * object = (cElement *) objectAtIndex (inLexique, inIndex.uintValue () COMMA_THERE) ;
    if (object != NULL) {
      result = object->mOptionInvocationString ;
    }
  }
  return result ;
}

//---------------------------------------------------------------------------*

GGS_lstring  GGS_commandLineOptionList::
reader_mOptionCommentAtIndex (C_Compiler & inLexique, const GGS_uint & inIndex COMMA_LOCATION_ARGS) const {
  GGS_lstring  result ;
  if (isBuilt () && inIndex.isBuilt ()) {
    cElement * object = (cElement *) objectAtIndex (inLexique, inIndex.uintValue () COMMA_THERE) ;
    if (object != NULL) {
      result = object->mOptionComment ;
    }
  }
  return result ;
}

//---------------------------------------------------------------------------*

void GGS_commandLineOptionList::
modifier_setMOptionTypeNameAtIndex (C_Compiler & inLexique,
                              const GGS_lstring  & inObject,
                              const GGS_uint & inIndex
                              COMMA_LOCATION_ARGS) const {
  if (isBuilt () && inIndex.isBuilt ()) {
    cElement * object = (cElement *) objectAtIndex (inLexique, inIndex.uintValue () COMMA_THERE) ;
    if (object != NULL) {
      object->mOptionTypeName = inObject ;
    }
  }
}

//---------------------------------------------------------------------------*

void GGS_commandLineOptionList::
modifier_setMOptionInternalNameAtIndex (C_Compiler & inLexique,
                              const GGS_lstring  & inObject,
                              const GGS_uint & inIndex
                              COMMA_LOCATION_ARGS) const {
  if (isBuilt () && inIndex.isBuilt ()) {
    cElement * object = (cElement *) objectAtIndex (inLexique, inIndex.uintValue () COMMA_THERE) ;
    if (object != NULL) {
      object->mOptionInternalName = inObject ;
    }
  }
}

//---------------------------------------------------------------------------*

void GGS_commandLineOptionList::
modifier_setMOptionInvocationLetterAtIndex (C_Compiler & inLexique,
                              const GGS_lchar  & inObject,
                              const GGS_uint & inIndex
                              COMMA_LOCATION_ARGS) const {
  if (isBuilt () && inIndex.isBuilt ()) {
    cElement * object = (cElement *) objectAtIndex (inLexique, inIndex.uintValue () COMMA_THERE) ;
    if (object != NULL) {
      object->mOptionInvocationLetter = inObject ;
    }
  }
}

//---------------------------------------------------------------------------*

void GGS_commandLineOptionList::
modifier_setMOptionInvocationStringAtIndex (C_Compiler & inLexique,
                              const GGS_lstring  & inObject,
                              const GGS_uint & inIndex
                              COMMA_LOCATION_ARGS) const {
  if (isBuilt () && inIndex.isBuilt ()) {
    cElement * object = (cElement *) objectAtIndex (inLexique, inIndex.uintValue () COMMA_THERE) ;
    if (object != NULL) {
      object->mOptionInvocationString = inObject ;
    }
  }
}

//---------------------------------------------------------------------------*

void GGS_commandLineOptionList::
modifier_setMOptionCommentAtIndex (C_Compiler & inLexique,
                              const GGS_lstring  & inObject,
                              const GGS_uint & inIndex
                              COMMA_LOCATION_ARGS) const {
  if (isBuilt () && inIndex.isBuilt ()) {
    cElement * object = (cElement *) objectAtIndex (inLexique, inIndex.uintValue () COMMA_THERE) ;
    if (object != NULL) {
      object->mOptionComment = inObject ;
    }
  }
}

//---------------------------------------------------------------------------*

/* const */ GGS_lstring  & GGS_commandLineOptionList::cEnumerator::_mOptionTypeName (LOCATION_ARGS) const {
  macroValidPointerThere (mCurrentEnumeratedObject) ;
  return ((cElement *) mCurrentEnumeratedObject)->mOptionTypeName ;
}

//---------------------------------------------------------------------------*

/* const */ GGS_lstring  & GGS_commandLineOptionList::cEnumerator::_mOptionInternalName (LOCATION_ARGS) const {
  macroValidPointerThere (mCurrentEnumeratedObject) ;
  return ((cElement *) mCurrentEnumeratedObject)->mOptionInternalName ;
}

//---------------------------------------------------------------------------*

/* const */ GGS_lchar  & GGS_commandLineOptionList::cEnumerator::_mOptionInvocationLetter (LOCATION_ARGS) const {
  macroValidPointerThere (mCurrentEnumeratedObject) ;
  return ((cElement *) mCurrentEnumeratedObject)->mOptionInvocationLetter ;
}

//---------------------------------------------------------------------------*

/* const */ GGS_lstring  & GGS_commandLineOptionList::cEnumerator::_mOptionInvocationString (LOCATION_ARGS) const {
  macroValidPointerThere (mCurrentEnumeratedObject) ;
  return ((cElement *) mCurrentEnumeratedObject)->mOptionInvocationString ;
}

//---------------------------------------------------------------------------*

/* const */ GGS_lstring  & GGS_commandLineOptionList::cEnumerator::_mOptionComment (LOCATION_ARGS) const {
  macroValidPointerThere (mCurrentEnumeratedObject) ;
  return ((cElement *) mCurrentEnumeratedObject)->mOptionComment ;
}

//---------------------------------------------------------------------------*
//                                                                           *
//                     class 'cPtr_optionComponentRoot'                      *
//                                                                           *
//---------------------------------------------------------------------------*

cPtr_optionComponentRoot::
cPtr_optionComponentRoot (const GGS_lstring & argument_0,
                                const GGS_commandLineOptionList & argument_1
                                COMMA_LOCATION_ARGS)
:cPtr__AC_galgas_class (THERE),
mOptionComponentName (argument_0),
mOptions (argument_1) {
}

//---------------------------------------------------------------------------*

#ifndef DO_NOT_GENERATE_CHECKINGS
  cPtr_optionComponentRoot * GGS_optionComponentRoot::
  operator () (LOCATION_ARGS) const {
    macroValidPointerThere (mPointer) ;
    MF_Assert (dynamic_cast <cPtr_optionComponentRoot *> (mPointer) != NULL,
               "dynamic cast error", 0, 0) ;
    return (cPtr_optionComponentRoot *) mPointer ;
  }
#endif

//---------------------------------------------------------------------------*

bool cPtr_optionComponentRoot::
isEqualToObject (const cPtr__AC_galgas_class * inOperand) const {
  bool equal = typeid (this) == typeid (inOperand) ;
  if (equal) {
    const cPtr_optionComponentRoot * ptr = dynamic_cast <const cPtr_optionComponentRoot *> (inOperand) ;
    macroValidPointer (ptr) ;
    equal = mOptionComponentName._operator_isEqual (ptr->mOptionComponentName).boolValue ()
         && mOptions._operator_isEqual (ptr->mOptions).boolValue () ;
  }
  return equal ;
}

//---------------------------------------------------------------------------*

void cPtr_optionComponentRoot::
appendForDescription (C_Compiler & inLexique,
                      C_String & ioString,
                      const sint32 inIndentation
                      COMMA_LOCATION_ARGS) const {
  ioString << "->@optionComponentRoot:"
           << mOptionComponentName.reader_description  (inLexique COMMA_THERE, inIndentation + 1)
           << mOptions.reader_description  (inLexique COMMA_THERE, inIndentation + 1) ;
}

//---------------------------------------------------------------------------*
//                                                                           *
//                              Class message                                *
//                                                                           *
//---------------------------------------------------------------------------*

const char * cPtr_optionComponentRoot::
_message (void) const {
  return "" ;
}

//---------------------------------------------------------------------------*

const char * cPtr_optionComponentRoot::
_static_message (void) {
  return "" ;
}

//---------------------------------------------------------------------------*

C_galgas_class_inspector _gInspectorFor_optionComponentRoot (& typeid (cPtr_optionComponentRoot), NULL, "") ;

//---------------------------------------------------------------------------*

AC_galgasClassRunTimeInformation * cPtr_optionComponentRoot::galgasRTTI (void) const {
  return & gClassInfoFor__optionComponentRoot ;
}

//---------------------------------------------------------------------------*

cPtr__AC_galgas_class * cPtr_optionComponentRoot::makeClone (void) const {
  cPtr__AC_galgas_class * result = NULL ;
  macroMyNew (result, cPtr_optionComponentRoot (mOptionComponentName, mOptions COMMA_HERE)) ;
  return result ;
}

//---------------------------------------------------------------------------*
//                                                                           *
//                  GALGAS class 'GGS_optionComponentRoot'                   *
//                                                                           *
//---------------------------------------------------------------------------*

GGS_optionComponentRoot::
GGS_optionComponentRoot (cPtr__AC_galgas_class * inPointer) {
  macroAssignPointer (mPointer, inPointer) ;
}

//---------------------------------------------------------------------------*

GGS_optionComponentRoot::
GGS_optionComponentRoot (cPtr__AC_galgas_class & inObject) {
  macroAssignPointer (mPointer, & inObject) ;
}

//---------------------------------------------------------------------------*

//--- _castFrom class method (implements cast expression)
GGS_optionComponentRoot GGS_optionComponentRoot::
_castFrom (C_Compiler & inLexique,
           cPtr__AC_galgas_class * inPointer,
           const bool inUseKindOfClass,
           const GGS_location & inErrorLocation
           COMMA_LOCATION_ARGS) {
  GGS_optionComponentRoot _result ;
  if (inPointer != NULL) {
    macroValidPointer (inPointer) ;
    const bool ok = inUseKindOfClass
      ? (dynamic_cast <cPtr_optionComponentRoot *> (inPointer) != NULL)
      : (typeid (cPtr_optionComponentRoot) == typeid (*inPointer)) ;
    if (ok) {
      _result = GGS_optionComponentRoot (inPointer) ;
    }else{
      inErrorLocation.signalCastError (inLexique,
                                       & typeid (cPtr_optionComponentRoot),
                                       inUseKindOfClass,
                                       inPointer->_message ()
                                       COMMA_THERE) ;
    }
  }
  return _result ;
}

//---------------------------------------------------------------------------*

GGS_optionComponentRoot GGS_optionComponentRoot::
constructor_new (C_Compiler & /* inLexique */,
                 const GGS_lstring & argument_0,
                 const GGS_commandLineOptionList & argument_1
                                COMMA_LOCATION_ARGS) {
  GGS_optionComponentRoot result ;
  macroMyNew (result.mPointer, cPtr_optionComponentRoot (argument_0,
                                argument_1 COMMA_THERE)) ;
  return result ;
}

//---------------------------------------------------------------------------*

GGS_lstring  GGS_optionComponentRoot::
reader_mOptionComponentName (C_Compiler & /* inLexique */ COMMA_UNUSED_LOCATION_ARGS) const {
  GGS_lstring   result ;
  if (mPointer != NULL) {
    macroValidPointer (mPointer) ;
    MF_Assert (dynamic_cast <cPtr_optionComponentRoot *> (mPointer) != NULL,
               "dynamic cast error", 0, 0) ;
    result = ((cPtr_optionComponentRoot *) mPointer)->mOptionComponentName ;
  }
  return result ;
}

//---------------------------------------------------------------------------*

GGS_commandLineOptionList  GGS_optionComponentRoot::
reader_mOptions (C_Compiler & /* inLexique */ COMMA_UNUSED_LOCATION_ARGS) const {
  GGS_commandLineOptionList   result ;
  if (mPointer != NULL) {
    macroValidPointer (mPointer) ;
    MF_Assert (dynamic_cast <cPtr_optionComponentRoot *> (mPointer) != NULL,
               "dynamic cast error", 0, 0) ;
    result = ((cPtr_optionComponentRoot *) mPointer)->mOptions ;
  }
  return result ;
}

//---------------------------------------------------------------------------*

const char * GGS_optionComponentRoot::actualTypeName (void) const {
  return "optionComponentRoot" ;
}

//---------------------------------------------------------------------------*

AC_galgasClassRunTimeInformation * GGS_optionComponentRoot::_galgasObjectRunTimeInfo (void) const {
  AC_galgasClassRunTimeInformation * result = NULL ;
  if (mPointer != NULL) {
    result = mPointer->galgasRTTI () ;
  }
  return result ;
}

//---------------------------------------------------------------------------*

C_galgasRootClassRunTimeInformation gClassInfoFor__optionComponentRoot ("optionComponentRoot") ;

//---------------------------------------------------------------------------*

