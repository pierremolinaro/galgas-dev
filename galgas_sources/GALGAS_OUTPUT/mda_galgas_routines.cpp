//---------------------------------------------------------------------------*
//                                                                           *
//                      File 'mda_galgas_routines.cpp'                       *
//                 Generated by version GALGAS_BETA_VERSION                  *
//                     january 24th, 2010, at 11h6'14"                       *
//                                                                           *
//---------------------------------------------------------------------------*

//--- START OF USER ZONE 1


//--- END OF USER ZONE 1

//---------------------------------------------------------------------------*

#include "version_libpm.h"
#if LIBPM_VERSION != THE_LIBPM_VERSION
  #error "This file has been compiled with a version of GALGAS different than the version of libpm"
#endif

//---------------------------------------------------------------------------*

#include <typeinfo>
#include "utilities/MF_MemoryControl.h"
#include "files/C_TextFileWrite.h"
#include "galgas/C_galgas_CLI_Options.h"
#include "mda_galgas_routines.h"

//---------------------------------------------------------------------------*

#ifndef DO_NOT_GENERATE_CHECKINGS
  #define SOURCE_FILE_AT_LINE(line) "mda_galgas_routines.gSemantics", line
  #define COMMA_SOURCE_FILE_AT_LINE(line) , SOURCE_FILE_AT_LINE(line)
#else
  #define SOURCE_FILE_AT_LINE(line) 
  #define COMMA_SOURCE_FILE_AT_LINE(line) 
#endif

//---------------------------------------------------------------------------*
//                                                                           *
//             Include directives generated by grammar includes              *
//                                                                           *
//---------------------------------------------------------------------------*

#include "galgas_LL1_grammar.h"
#include "grammarLL1grammar.h"
#include "optionLL1grammar.h"
#include "programSLRgrammar.h"
#include "projectLL1grammar.h"
#include "syntaxSLRgrammar.h"

//--- START OF USER ZONE 2


//--- END OF USER ZONE 2

//---------------------------------------------------------------------------*
//                                                                           *
//             Implementation of function "outputDirectoryTEMP"              *
//                                                                           *
//---------------------------------------------------------------------------*

GGS_string function_outputDirectoryTEMP (C_Compiler &,
                                const GGS_lstring   var_cas_inSourceFile COMMA_UNUSED_LOCATION_ARGS) {
  #ifdef DEBUG_TRACE_ENABLED
    printf ("ENTER function_outputDirectoryTEMP at %s:%d\n", __FILE__, __LINE__) ;
  #endif
  GGS_string var_cas_outOuputDirectory ;
  var_cas_outOuputDirectory = var_cas_inSourceFile.ggs_string ().reader_stringByDeletingLastPathComponent () ;
  var_cas_outOuputDirectory.appendCString ("/GALGAS_OUTPUT_TEMP") ;
  #ifdef DEBUG_TRACE_ENABLED
    printf ("LEAVE function_outputDirectoryTEMP\n") ;
  #endif
  return var_cas_outOuputDirectory ;
}

//---------------------------------------------------------------------------*

static GGS_object functionForGenericCall_outputDirectoryTEMP (C_Compiler & inLexique,
                           const GGS_objectlist & inEffectiveParameterArray,
                           const GGS_location & inErrorLocation
                           COMMA_LOCATION_ARGS) {
  const GGS_lstring  arg_0 = GGS_lstring ::castFromObject (inLexique, inEffectiveParameterArray.reader_mValueAtIndex (inLexique, GGS_uint (0) COMMA_THERE), inErrorLocation COMMA_THERE) ;
  const GGS_string result = function_outputDirectoryTEMP (inLexique,
                            arg_0
                            COMMA_THERE) ;
  return result.reader_object () ;
}

//---------------------------------------------------------------------------*

static const C_galgas_type_descriptorEX *
kArgumentTypeList_outputDirectoryTEMP [1] = {& kTypeDescriptor_GGS_lstring } ;

const C_galgas_function_descriptorEX
kFunction_descriptor_outputDirectoryTEMP ("outputDirectoryTEMP",
                              functionForGenericCall_outputDirectoryTEMP,
                              & kTypeDescriptor_GGS_string,
                              1,
                              kArgumentTypeList_outputDirectoryTEMP) ;

//---------------------------------------------------------------------------*
//                                                                           *
//               Implementation of function "outputDirectory"                *
//                                                                           *
//---------------------------------------------------------------------------*

GGS_string function_outputDirectory (C_Compiler & inLexique,
                                const GGS_lstring   var_cas_inSourceFile COMMA_UNUSED_LOCATION_ARGS) {
  #ifdef DEBUG_TRACE_ENABLED
    printf ("ENTER function_outputDirectory at %s:%d\n", __FILE__, __LINE__) ;
  #endif
  GGS_string var_cas_outOuputDirectory ;
  const GGS_bool cond_3457 = (var_cas_inSourceFile.ggs_string ().reader_characterAtIndex (inLexique, GGS_uint (0U) COMMA_SOURCE_FILE_AT_LINE (61))).operator_isEqual (GGS_char (TO_UNICODE ('/'))) ;
  if (cond_3457.isBuiltAndTrue ()) {
    var_cas_outOuputDirectory = var_cas_inSourceFile.ggs_string ().reader_stringByDeletingLastPathComponent () ;
    var_cas_outOuputDirectory.appendCString ("/GALGAS_OUTPUT") ;
  }else if (cond_3457.isBuiltAndFalse ()) {
    var_cas_outOuputDirectory = GGS_string ("GALGAS_OUTPUT") ;
  }
  #ifdef DEBUG_TRACE_ENABLED
    printf ("LEAVE function_outputDirectory\n") ;
  #endif
  return var_cas_outOuputDirectory ;
}

//---------------------------------------------------------------------------*

static GGS_object functionForGenericCall_outputDirectory (C_Compiler & inLexique,
                           const GGS_objectlist & inEffectiveParameterArray,
                           const GGS_location & inErrorLocation
                           COMMA_LOCATION_ARGS) {
  const GGS_lstring  arg_0 = GGS_lstring ::castFromObject (inLexique, inEffectiveParameterArray.reader_mValueAtIndex (inLexique, GGS_uint (0) COMMA_THERE), inErrorLocation COMMA_THERE) ;
  const GGS_string result = function_outputDirectory (inLexique,
                            arg_0
                            COMMA_THERE) ;
  return result.reader_object () ;
}

//---------------------------------------------------------------------------*

static const C_galgas_type_descriptorEX *
kArgumentTypeList_outputDirectory [1] = {& kTypeDescriptor_GGS_lstring } ;

const C_galgas_function_descriptorEX
kFunction_descriptor_outputDirectory ("outputDirectory",
                              functionForGenericCall_outputDirectory,
                              & kTypeDescriptor_GGS_string,
                              1,
                              kArgumentTypeList_outputDirectory) ;

//---------------------------------------------------------------------------*
//                                                                           *
//    Implementation of routine "checkCategoryMethodDefinitionForClass"      *
//                                                                           *
//---------------------------------------------------------------------------*

void routine_checkCategoryMethodDefinitionForClass (C_Compiler & inLexique,
                                const GGS_string  var_cas_inClassNameForErrorSignaling,
                                const GGS_string  var_cas_inClassName,
                                const GGS_lstring   var_cas_inAbstractCategoryMethodName,
                                const GGS_descendantClassListMap  var_cas_inDescendantClassListMap,
                                const GGS_overridingCategoryMethodListMap  var_cas_inOverridingCategoryMethodListMap COMMA_UNUSED_LOCATION_ARGS) {
  #ifdef DEBUG_TRACE_ENABLED
    printf ("ENTER routine_checkCategoryMethodDefinitionForClass at %s:%d\n", __FILE__, __LINE__) ;
  #endif
  GGS_classIndexList  var_cas_descendantClasses = var_cas_inDescendantClassListMap.reader_listForKey (inLexique, var_cas_inClassName COMMA_SOURCE_FILE_AT_LINE (78)) ;
  {
    GGS_classIndexList::cEnumerator enumerator_4005 (var_cas_descendantClasses, true) ;
    const GGS_classIndexList::cElement * operand_4005 = NULL ;
    while (((operand_4005 = enumerator_4005.nextObject ()))) {
      macroValidPointer (operand_4005) ;
      GGS_lstring  var_cas_descendantClassName ;
      GGS_ACGalgasType  var_cas_t ;
      const GGS_typeMapIndex  temp_4087 = operand_4005->mClassMapindex ;
      if (temp_4087.isBuilt ()) {
        temp_4087 (HERE)->method_searchKey (inLexique, var_cas_descendantClassName, var_cas_t COMMA_SOURCE_FILE_AT_LINE (80)) ;
      }
      GGS_bool var_cas_isAbstract ;
      { const GGS_ACGalgasType _var_4364 = var_cas_t ; // CAST instruction
        if (_var_4364.getPtr () != NULL) {
          macroValidPointer (_var_4364.getPtr ()) ;
          if (dynamic_cast <cPtr_classGalgasType *> (_var_4364.getPtr ()) != NULL) {
            const GGS_classGalgasType var_cas_classType (_var_4364.getPtr ()) ;
            var_cas_isAbstract = var_cas_classType.reader_mIsAbstract (inLexique COMMA_SOURCE_FILE_AT_LINE (84)) ;
          }else{
            var_cas_descendantClassName.reader_location (inLexique COMMA_HERE).signalGGSSemanticError (inLexique, ((GGS_string ("the '@")).operator_concat (var_cas_descendantClassName)).operator_concat (GGS_string ("' type should be a class")) COMMA_SOURCE_FILE_AT_LINE (87)) ;
            var_cas_isAbstract.drop () ;
          }
        }
      }
      GGS_overridingCategoryMethodList  var_cas_overridingMethods = var_cas_inOverridingCategoryMethodListMap.reader_listForKey (inLexique, var_cas_descendantClassName.reader_string (inLexique COMMA_SOURCE_FILE_AT_LINE (88)) COMMA_SOURCE_FILE_AT_LINE (88)) ;
      GGS_bool var_cas_found = GGS_bool (false) ;
      {
        GGS_overridingCategoryMethodList::cEnumerator enumerator_4562 (var_cas_overridingMethods, true) ;
        const GGS_overridingCategoryMethodList::cElement * operand_4562 = NULL ;
        while (((operand_4562 = enumerator_4562.nextObject ()))
            && ((var_cas_found).operator_not ().isBuiltAndTrue ())) {
          macroValidPointer (operand_4562) ;
          var_cas_found = (var_cas_inAbstractCategoryMethodName.reader_string (inLexique COMMA_SOURCE_FILE_AT_LINE (91))).operator_isEqual (operand_4562->mOverridingCategoryMethodName.reader_string (inLexique COMMA_SOURCE_FILE_AT_LINE (91))) ;
        }
      }
      const GGS_bool cond_5329 = (var_cas_found).operator_not () ;
      if (cond_5329.isBuiltAndTrue ()) {
        const GGS_bool cond_5011 = var_cas_isAbstract ;
        if (cond_5011.isBuiltAndTrue ()) {
          ::routine_checkCategoryMethodDefinitionForClass (inLexique,  var_cas_inClassNameForErrorSignaling,  var_cas_descendantClassName.reader_string (inLexique COMMA_SOURCE_FILE_AT_LINE (97)),  var_cas_inAbstractCategoryMethodName,  var_cas_inDescendantClassListMap,  var_cas_inOverridingCategoryMethodListMap COMMA_SOURCE_FILE_AT_LINE (95)) ;
        }else if (cond_5011.isBuiltAndFalse ()) {
          var_cas_inAbstractCategoryMethodName.reader_location (inLexique COMMA_HERE).signalGGSSemanticError (inLexique, ((((((GGS_string ("an abstract category method '")).operator_concat (var_cas_inAbstractCategoryMethodName)).operator_concat (GGS_string ("' is defined for abstract class '@"))).operator_concat (var_cas_inClassNameForErrorSignaling)).operator_concat (GGS_string ("', but concrete descendant class '@"))).operator_concat (var_cas_descendantClassName)).operator_concat (GGS_string ("' does not implement this method")) COMMA_SOURCE_FILE_AT_LINE (106)) ;
        }
      }
    }
  }
  #ifdef DEBUG_TRACE_ENABLED
    printf ("LEAVE routine_checkCategoryMethodDefinitionForClass\n") ;
  #endif
}

//---------------------------------------------------------------------------*
//                                                                           *
//    Implementation of routine "checkCategoryReaderDefinitionForClass"      *
//                                                                           *
//---------------------------------------------------------------------------*

void routine_checkCategoryReaderDefinitionForClass (C_Compiler & inLexique,
                                const GGS_string  var_cas_inClassNameForErrorSignaling,
                                const GGS_string  var_cas_inClassName,
                                const GGS_lstring   var_cas_inAbstractCategoryReaderName,
                                const GGS_descendantClassListMap  var_cas_inDescendantClassListMap,
                                const GGS_overridingCategoryReaderListMap  var_cas_inOverridingCategoryReaderListMap COMMA_UNUSED_LOCATION_ARGS) {
  #ifdef DEBUG_TRACE_ENABLED
    printf ("ENTER routine_checkCategoryReaderDefinitionForClass at %s:%d\n", __FILE__, __LINE__) ;
  #endif
  GGS_classIndexList  var_cas_descendantClasses = var_cas_inDescendantClassListMap.reader_listForKey (inLexique, var_cas_inClassName COMMA_SOURCE_FILE_AT_LINE (120)) ;
  {
    GGS_classIndexList::cEnumerator enumerator_5843 (var_cas_descendantClasses, true) ;
    const GGS_classIndexList::cElement * operand_5843 = NULL ;
    while (((operand_5843 = enumerator_5843.nextObject ()))) {
      macroValidPointer (operand_5843) ;
      GGS_lstring  var_cas_descendantClassName ;
      GGS_ACGalgasType  var_cas_t ;
      const GGS_typeMapIndex  temp_5925 = operand_5843->mClassMapindex ;
      if (temp_5925.isBuilt ()) {
        temp_5925 (HERE)->method_searchKey (inLexique, var_cas_descendantClassName, var_cas_t COMMA_SOURCE_FILE_AT_LINE (122)) ;
      }
      GGS_bool var_cas_isAbstract ;
      { const GGS_ACGalgasType _var_6202 = var_cas_t ; // CAST instruction
        if (_var_6202.getPtr () != NULL) {
          macroValidPointer (_var_6202.getPtr ()) ;
          if (dynamic_cast <cPtr_classGalgasType *> (_var_6202.getPtr ()) != NULL) {
            const GGS_classGalgasType var_cas_classType (_var_6202.getPtr ()) ;
            var_cas_isAbstract = var_cas_classType.reader_mIsAbstract (inLexique COMMA_SOURCE_FILE_AT_LINE (126)) ;
          }else{
            var_cas_descendantClassName.reader_location (inLexique COMMA_HERE).signalGGSSemanticError (inLexique, ((GGS_string ("the '@")).operator_concat (var_cas_descendantClassName)).operator_concat (GGS_string ("' type should be a class")) COMMA_SOURCE_FILE_AT_LINE (129)) ;
            var_cas_isAbstract.drop () ;
          }
        }
      }
      GGS_overridingCategoryReaderList  var_cas_overridingReaders = var_cas_inOverridingCategoryReaderListMap.reader_listForKey (inLexique, var_cas_descendantClassName.reader_string (inLexique COMMA_SOURCE_FILE_AT_LINE (130)) COMMA_SOURCE_FILE_AT_LINE (130)) ;
      GGS_bool var_cas_found = GGS_bool (false) ;
      {
        GGS_overridingCategoryReaderList::cEnumerator enumerator_6400 (var_cas_overridingReaders, true) ;
        const GGS_overridingCategoryReaderList::cElement * operand_6400 = NULL ;
        while (((operand_6400 = enumerator_6400.nextObject ()))
            && ((var_cas_found).operator_not ().isBuiltAndTrue ())) {
          macroValidPointer (operand_6400) ;
          var_cas_found = (var_cas_inAbstractCategoryReaderName.reader_string (inLexique COMMA_SOURCE_FILE_AT_LINE (133))).operator_isEqual (operand_6400->mOverridingCategoryReaderName.reader_string (inLexique COMMA_SOURCE_FILE_AT_LINE (133))) ;
        }
      }
      const GGS_bool cond_7167 = (var_cas_found).operator_not () ;
      if (cond_7167.isBuiltAndTrue ()) {
        const GGS_bool cond_6849 = var_cas_isAbstract ;
        if (cond_6849.isBuiltAndTrue ()) {
          ::routine_checkCategoryReaderDefinitionForClass (inLexique,  var_cas_inClassNameForErrorSignaling,  var_cas_descendantClassName.reader_string (inLexique COMMA_SOURCE_FILE_AT_LINE (139)),  var_cas_inAbstractCategoryReaderName,  var_cas_inDescendantClassListMap,  var_cas_inOverridingCategoryReaderListMap COMMA_SOURCE_FILE_AT_LINE (137)) ;
        }else if (cond_6849.isBuiltAndFalse ()) {
          var_cas_inAbstractCategoryReaderName.reader_location (inLexique COMMA_HERE).signalGGSSemanticError (inLexique, ((((((GGS_string ("an abstract category reader '")).operator_concat (var_cas_inAbstractCategoryReaderName)).operator_concat (GGS_string ("' is defined for abstract class '@"))).operator_concat (var_cas_inClassNameForErrorSignaling)).operator_concat (GGS_string ("', but concrete descendant class '@"))).operator_concat (var_cas_descendantClassName)).operator_concat (GGS_string ("' does not implement this reader")) COMMA_SOURCE_FILE_AT_LINE (148)) ;
        }
      }
    }
  }
  #ifdef DEBUG_TRACE_ENABLED
    printf ("LEAVE routine_checkCategoryReaderDefinitionForClass\n") ;
  #endif
}

//---------------------------------------------------------------------------*
//                                                                           *
//        Implementation of routine "performProjectGlobalCheckings"          *
//                                                                           *
//---------------------------------------------------------------------------*

void routine_performProjectGlobalCheckings (C_Compiler & inLexique,
                                const GGS_parsedComponentStruct  var_cas_inParsedComponentStruct,
                                const GGS_location   var_cas_inEndOfSourceFile COMMA_UNUSED_LOCATION_ARGS) {
  #ifdef DEBUG_TRACE_ENABLED
    printf ("ENTER routine_performProjectGlobalCheckings at %s:%d\n", __FILE__, __LINE__) ;
  #endif
  GGS_semanticDeclarationList  var_cas_semanticDeclarationList = GGS_semanticDeclarationList ::constructor_emptyList () ;
  {
    GGS_parsedSemanticsComponentMap::cEnumerator enumerator_7514 (var_cas_inParsedComponentStruct.reader_mParsedSemanticsComponentMap (inLexique COMMA_SOURCE_FILE_AT_LINE (161)), true) ;
    const GGS_parsedSemanticsComponentMap::cElement * operand_7514 = NULL ;
    while (((operand_7514 = enumerator_7514.nextObject ()))) {
      macroValidPointer (operand_7514) ;
      var_cas_semanticDeclarationList.dotAssign_operation (operand_7514->mInfo.mRoot.reader_mSemanticDeclarations (inLexique COMMA_SOURCE_FILE_AT_LINE (162)).reader_mSemanticDeclarationList (inLexique COMMA_SOURCE_FILE_AT_LINE (162))) ;
    }
  }
  GGS_semanticContext var_cas_semanticContext ;
  ::routine_buildSemanticContext (inLexique,  var_cas_semanticDeclarationList,  var_cas_inEndOfSourceFile,  var_cas_semanticContext COMMA_SOURCE_FILE_AT_LINE (166)) ;
  const GGS_bool cond_8915 = (GGS_uint ::constructor_errorCount (inLexique COMMA_HERE)).operator_isEqual (GGS_uint (0U)) ;
  if (cond_8915.isBuiltAndTrue ()) {
    GGS_abstractCategoryMethodListMap var_cas_abstractCategoryMethodListMap = GGS_abstractCategoryMethodListMap::constructor_emptyMap () ;
    GGS_categoryMethodListMap var_cas_categoryMethodListMap = GGS_categoryMethodListMap::constructor_emptyMap () ;
    GGS_overridingCategoryMethodListMap var_cas_overridingCategoryMethodListMap = GGS_overridingCategoryMethodListMap::constructor_emptyMap () ;
    {
      GGS_parsedSemanticsComponentMap::cEnumerator enumerator_8216 (var_cas_inParsedComponentStruct.reader_mParsedSemanticsComponentMap (inLexique COMMA_SOURCE_FILE_AT_LINE (173)), true) ;
      const GGS_parsedSemanticsComponentMap::cElement * operand_8216 = NULL ;
      while (((operand_8216 = enumerator_8216.nextObject ()))) {
        macroValidPointer (operand_8216) ;
        var_cas_abstractCategoryMethodListMap.dotAssign_operation (operand_8216->mInfo.mRoot.reader_mSemanticDeclarations (inLexique COMMA_SOURCE_FILE_AT_LINE (174)).reader_mAbstractCategoryMethodListMap (inLexique COMMA_SOURCE_FILE_AT_LINE (174))) ;
        var_cas_overridingCategoryMethodListMap.dotAssign_operation (operand_8216->mInfo.mRoot.reader_mSemanticDeclarations (inLexique COMMA_SOURCE_FILE_AT_LINE (175)).reader_mOverridingCategoryMethodListMap (inLexique COMMA_SOURCE_FILE_AT_LINE (175))) ;
      }
    }
    GGS_descendantClassListMap var_cas_descendantClassListMap = var_cas_semanticContext.reader_mDescendantClassListMap (inLexique COMMA_SOURCE_FILE_AT_LINE (177)) ;
    {
      GGS_abstractCategoryMethodListMap::cEnumerator enumerator_8642 (var_cas_abstractCategoryMethodListMap, true) ;
      while (enumerator_8642.hasCurrentObject ()) {
        {
          GGS_abstractCategoryMethodList::cEnumerator enumerator_8666 (enumerator_8642._object (HERE), true) ;
          const GGS_abstractCategoryMethodList::cElement * operand_8666 = NULL ;
          while (((operand_8666 = enumerator_8666.nextObject ()))) {
            macroValidPointer (operand_8666) ;
            ::routine_checkCategoryMethodDefinitionForClass (inLexique,  enumerator_8642._key (HERE),  enumerator_8642._key (HERE),  operand_8666->mAbstractCategoryMethodName,  var_cas_descendantClassListMap,  var_cas_overridingCategoryMethodListMap COMMA_SOURCE_FILE_AT_LINE (180)) ;
          }
        }
        enumerator_8642.next () ;
      }
    }
  }
  const GGS_bool cond_10007 = (GGS_uint ::constructor_errorCount (inLexique COMMA_HERE)).operator_isEqual (GGS_uint (0U)) ;
  if (cond_10007.isBuiltAndTrue ()) {
    GGS_abstractCategoryReaderListMap var_cas_abstractCategoryReaderListMap = GGS_abstractCategoryReaderListMap::constructor_emptyMap () ;
    GGS_categoryReaderListMap var_cas_categoryReaderListMap = GGS_categoryReaderListMap::constructor_emptyMap () ;
    GGS_overridingCategoryReaderListMap var_cas_overridingCategoryReaderListMap = GGS_overridingCategoryReaderListMap::constructor_emptyMap () ;
    {
      GGS_parsedSemanticsComponentMap::cEnumerator enumerator_9308 (var_cas_inParsedComponentStruct.reader_mParsedSemanticsComponentMap (inLexique COMMA_SOURCE_FILE_AT_LINE (196)), true) ;
      const GGS_parsedSemanticsComponentMap::cElement * operand_9308 = NULL ;
      while (((operand_9308 = enumerator_9308.nextObject ()))) {
        macroValidPointer (operand_9308) ;
        var_cas_abstractCategoryReaderListMap.dotAssign_operation (operand_9308->mInfo.mRoot.reader_mSemanticDeclarations (inLexique COMMA_SOURCE_FILE_AT_LINE (197)).reader_mAbstractCategoryReaderListMap (inLexique COMMA_SOURCE_FILE_AT_LINE (197))) ;
        var_cas_overridingCategoryReaderListMap.dotAssign_operation (operand_9308->mInfo.mRoot.reader_mSemanticDeclarations (inLexique COMMA_SOURCE_FILE_AT_LINE (198)).reader_mOverridingCategoryReaderListMap (inLexique COMMA_SOURCE_FILE_AT_LINE (198))) ;
      }
    }
    GGS_descendantClassListMap var_cas_descendantClassListMap = var_cas_semanticContext.reader_mDescendantClassListMap (inLexique COMMA_SOURCE_FILE_AT_LINE (200)) ;
    {
      GGS_abstractCategoryReaderListMap::cEnumerator enumerator_9734 (var_cas_abstractCategoryReaderListMap, true) ;
      while (enumerator_9734.hasCurrentObject ()) {
        {
          GGS_abstractCategoryReaderList::cEnumerator enumerator_9758 (enumerator_9734._object (HERE), true) ;
          const GGS_abstractCategoryReaderList::cElement * operand_9758 = NULL ;
          while (((operand_9758 = enumerator_9758.nextObject ()))) {
            macroValidPointer (operand_9758) ;
            ::routine_checkCategoryReaderDefinitionForClass (inLexique,  enumerator_9734._key (HERE),  enumerator_9734._key (HERE),  operand_9758->mAbstractCategoryReaderName,  var_cas_descendantClassListMap,  var_cas_overridingCategoryReaderListMap COMMA_SOURCE_FILE_AT_LINE (203)) ;
          }
        }
        enumerator_9734.next () ;
      }
    }
  }
  #ifdef DEBUG_TRACE_ENABLED
    printf ("LEAVE routine_performProjectGlobalCheckings\n") ;
  #endif
}

//---------------------------------------------------------------------------*

const C_galgas_type_descriptorEX kTypeDescriptor_GGS_targetFileListMap ("targetFileListMap", false, NULL) ;

//---------------------------------------------------------------------------*

GGS_targetFileListMap::cElement::cElement (LOCATION_ARGS) :
cPtrListMapObject (THERE),
mListObject (GGS_stringlist::constructor_emptyList ()) {
}

//---------------------------------------------------------------------------*

cPtrObject * GGS_targetFileListMap::cElement::cloneObject (LOCATION_ARGS) {
  cElement * result = NULL ;
  macroMyNew (result, cElement (THERE)) ;
  result->mListObject = mListObject ;
  return result ;
}

//---------------------------------------------------------------------------*

bool GGS_targetFileListMap::cElement::isEqual (const cPtrListMapObject * inOperand) const {
  const GGS_bool equal = mListObject.operator_isEqual (((cElement *) inOperand)->mListObject) ;
  return equal.boolValue () ;
}

//---------------------------------------------------------------------------*

C_String GGS_targetFileListMap::cElement::
performDescription (const PMSInt32 inIndentation) const {
  const GGS_string s = mListObject.reader_description (inIndentation) ;
  return s.string () ;
}

//---------------------------------------------------------------------------*

GGS_targetFileListMap GGS_targetFileListMap::
constructor_emptyMap (void) {
  GGS_targetFileListMap result ;
  result.alloc (HERE) ;
  return result ;
}

//---------------------------------------------------------------------------*

const char * GGS_targetFileListMap::
_typeNameForDescriptionReader (void) const {
  return "@targetFileListMap" ;
}

//---------------------------------------------------------------------------*

GGS_targetFileListMap GGS_targetFileListMap::
operator_concat (const GGS_targetFileListMap & inOperand) const {
  GGS_targetFileListMap result = * this ;
  result.dotAssign_operation (inOperand) ;
  return result ;
}

//---------------------------------------------------------------------------*

void GGS_targetFileListMap::
dotAssign_operation (const GGS_targetFileListMap inOperand) {
  if (isBuilt () && inOperand.isBuilt ()) {
    if (count (HERE) == 0) {
      * this = inOperand ;
    }else if (inOperand.count (HERE) > 0) {
      cPtrDictionary * dictPtr = macroPtr (inOperand, cPtrDictionary)  ;
      cPtrDictionaryNode * nodeSortedArray = dictPtr->nodeSortedArray () ;
      const PMSInt32 objectCount = dictPtr->count () ;
      for (PMSInt32 i=0 ; i<objectCount ; i++) {
        const GGS_string key = nodeSortedArray [i].key () ;
        const PM_C_Object object = nodeSortedArray [i].mObject ;
        cElement * elementPtr = macroPtr (object, cElement) ;
        bool wasInserted = false ;
        cPtrDictionaryNode * nodePtr = findOrAddNodeForKey (key, wasInserted) ;
        if (wasInserted) {
           cElement * p = NULL ;
           macroMyNew (p, cElement (HERE)) ;
           nodePtr->mObject.setPointer (p) ;
        }
        GGS_stringlist & listPtr = macroPtr (nodePtr->mObject, cElement)->mListObject ;
        listPtr.dotAssign_operation (elementPtr->mListObject) ;
      }
    }
  }
}

//---------------------------------------------------------------------------*

void GGS_targetFileListMap::
addAssign_operation (const GGS_string & inKey,
                      const GGS_string& inAttribute0) {
  if (isBuilt () && inKey.isBuilt () && inAttribute0.isBuilt ()) {
    bool wasInserted = false ;
    cPtrDictionaryNode * nodePtr = findOrAddNodeForKey (inKey, wasInserted) ;
    MF_Assert (nodePtr != NULL, "NULL pointer (was inserted %d)", wasInserted, 0) ;
    if (wasInserted) {
       cElement * p = NULL ;
       macroMyNew (p, cElement (HERE)) ;
       nodePtr->mObject.setPointer (p) ;
    }
    GGS_stringlist & listPtr = macroPtr (nodePtr->mObject, cElement)->mListObject ;
    listPtr.addAssign_operation (inAttribute0) ;
  }
}

//---------------------------------------------------------------------------*

GGS_stringlist GGS_targetFileListMap::
reader_listForKey (C_Compiler & /* inLexique */,
                   const GGS_string & inKey
                   COMMA_UNUSED_LOCATION_ARGS) const {
  GGS_stringlist result ;
  if (isBuilt () && inKey.isBuilt ()) {
    cPtrDictionaryNode * nodePtr = dictionaryNodeForKey (inKey.string ()) ; 
    if (nodePtr == NULL) {
      result = GGS_stringlist::constructor_emptyList () ;
    }else{
      result = macroPtr (nodePtr->mObject, cElement)->mListObject ;
    }
  }
  return result ;
}

//---------------------------------------------------------------------------*

GGS_stringset GGS_targetFileListMap::
reader_allKeys (C_Compiler & /* inLexique */
                COMMA_UNUSED_LOCATION_ARGS) const {

  GGS_stringset result ;
  result.setPointer (_pointer ()) ;
  return result ;
}

//---------------------------------------------------------------------------*

GGS_stringlist GGS_targetFileListMap::
reader_keyList (C_Compiler & /* inLexique */
                COMMA_UNUSED_LOCATION_ARGS) const {

  GGS_stringlist result ;
  if (isBuilt ()) {
    result = GGS_stringlist::constructor_emptyList () ;
    cPtrDictionary * dictPtr = macroPtr (*this, cPtrDictionary)  ;
    cPtrDictionaryNode * nodeSortedArray = dictPtr->nodeSortedArray () ;
    const PMSInt32 objectCount = dictPtr->count () ;
    for (PMSInt32 i=0 ; i<objectCount ; i++) {
      const GGS_string key = nodeSortedArray [i].key () ;
      result.addAssign_operation (key) ;
    }
  }
  return result ;
}

//---------------------------------------------------------------------------*

GGS_targetFileListMap::cEnumerator::
cEnumerator (const GGS_targetFileListMap & inListMap,
             const bool inAscending) :
cAbstractDictionaryEnumerator (inListMap, inAscending) {
}

//---------------------------------------------------------------------------*

const GGS_stringlist & GGS_targetFileListMap::cEnumerator::
_object (LOCATION_ARGS) const {
  cPtrDictionary * dictPtr = macroPtr (mEnumeratedDictionary, cPtrDictionary)  ;
  MF_AssertThere (currentIndex () >= 0, "Access with negative index %d", currentIndex (), 0) ;
  MF_AssertThere (currentIndex () < dictPtr->count (), "Access with index %d >= count %d", currentIndex (), dictPtr->count ()) ;
  cPtrDictionaryNode * nodeSortedArray = dictPtr->nodeSortedArray () ;
  PM_C_Object listObject = nodeSortedArray [currentIndex ()].mObject ;
  cElement * objectPtr = macroPtr (listObject, cElement) ;
  return objectPtr->mListObject ;
}

//---------------------------------------------------------------------------*

GGS_object GGS_targetFileListMap::reader_object (void) const {
  GGS_object result ;
  if (isBuilt ()) {
    GGS_targetFileListMap * p = NULL ;
    macroMyNew (p, GGS_targetFileListMap (*this)) ;
    result = GGS_object (p) ;
  }
  return result ;
}

//---------------------------------------------------------------------------*

GGS_targetFileListMap GGS_targetFileListMap::castFromObject (C_Compiler & inLexique,
                                   const GGS_object & inObject,
                                   const GGS_location & inErrorLocation
                                   COMMA_LOCATION_ARGS) {
  GGS_targetFileListMap result ;
  const GGS__root * embeddedObject = inObject.embeddedObject () ;
  if (NULL != embeddedObject) {
    const GGS_targetFileListMap * p = dynamic_cast <const GGS_targetFileListMap *> (embeddedObject) ;
    if (NULL != p) {
      result = * p ;
    }else{
      castFromObjectErrorSignaling (inLexique, inErrorLocation, & kTypeDescriptor_GGS_targetFileListMap, embeddedObject COMMA_THERE) ;
    }
  }
  return result ;
}

//---------------------------------------------------------------------------*

const C_galgas_type_descriptorEX * GGS_targetFileListMap::typeDescriptor (void) const {
  return & kTypeDescriptor_GGS_targetFileListMap ;
}

//---------------------------------------------------------------------------*
//                                                                           *
//                         class 'e_sourceFileMap'                           *
//                                                                           *
//---------------------------------------------------------------------------*

e_sourceFileMap::e_sourceFileMap (void) :
mFullPath (),
mSourceKind () {
}

//---------------------------------------------------------------------------*
//                                                                           *
//                        class map '@sourceFileMap'                         *
//                                                                           *
//---------------------------------------------------------------------------*

const C_galgas_type_descriptorEX kTypeDescriptor_GGS_sourceFileMap ("sourceFileMap", false, NULL) ;

//---------------------------------------------------------------------------*

elementOf_GGS_sourceFileMap::
elementOf_GGS_sourceFileMap (const GGS_lstring & inKey,
              const PMSInt32 inIndex,
              const e_sourceFileMap & inInfo) :
AC_galgas_map_element (inKey, inIndex),
mInfo (inInfo) {
}

//---------------------------------------------------------------------------*

void elementOf_GGS_sourceFileMap::
appendForMapDescription (const PMSInt32 inElementIndex,
                         C_String & ioString,
                         const PMSInt32 inIndentation) const {
  ioString << "\n" ;
  ioString.writeStringMultiple ("| ", inIndentation) ;
  ioString << "|-key " ;
  ioString.appendSigned (inElementIndex) ;
  ioString << ":" << mKey.reader_description (inIndentation + 1) ;
  ioString << "\n" ;
  ioString.writeStringMultiple ("| ", inIndentation) ;
  ioString << "|-value " ;
  ioString.appendSigned (inElementIndex) ;
  ioString << ":" << mInfo.mFullPath.reader_description (inIndentation + 1) ;
  ioString << "\n" ;
  ioString.writeStringMultiple ("| ", inIndentation) ;
  ioString << "|-value " ;
  ioString.appendSigned (inElementIndex) ;
  ioString << ":" << mInfo.mSourceKind.reader_description (inIndentation + 1) ;
}

//---------------------------------------------------------------------------*

bool elementOf_GGS_sourceFileMap::
isEqualToMapElement (const AC_galgas_map_element * inOperand) const {
  const elementOf_GGS_sourceFileMap * ptr = dynamic_cast <const elementOf_GGS_sourceFileMap *> (inOperand) ;
  macroValidPointer (ptr) ;
  return (mInfo.mFullPath.operator_isEqual (ptr->mInfo.mFullPath)).boolValue ()
           && (mInfo.mSourceKind.operator_isEqual (ptr->mInfo.mSourceKind)).boolValue () ;
}

//---------------------------------------------------------------------------*

AC_galgas_map_element * GGS_sourceFileMap::
new_element (const GGS_lstring & inKey, void * inInfo) {
  MF_Assert (reinterpret_cast <e_sourceFileMap *> (inInfo) != NULL, "Dynamic cast error", 0, 0) ;
  AC_galgas_map_element * p = NULL ;
  e_sourceFileMap * info = (e_sourceFileMap *) inInfo ;
  macroMyNew (p, cElement (inKey, nextIndex (), * info)) ;
  return p ;
}

//---------------------------------------------------------------------------*

void GGS_sourceFileMap::
assignInfo (AC_galgas_map_element * inPtr, void * inInfo) {
  MF_Assert (reinterpret_cast <cElement *> (inPtr) != NULL, "Dynamic cast error", 0, 0) ;
  MF_Assert (reinterpret_cast <e_sourceFileMap *> (inInfo) != NULL, "Dynamic cast error", 0, 0) ;
  cElement * p = (cElement *) inPtr ;
  e_sourceFileMap * info = (e_sourceFileMap *) inInfo ;
  p->mInfo = * info ;
}

//---------------------------------------------------------------------------*

GGS_sourceFileMap GGS_sourceFileMap::
constructor_emptyMap (C_Compiler & /* inLexique */ COMMA_UNUSED_LOCATION_ARGS) {
  GGS_sourceFileMap result ;
  macroMyNew (result.mSharedMapRoot, cMapRoot) ;
  return result ;
}

//---------------------------------------------------------------------------*

void GGS_sourceFileMap::
enterIndex (const GGS_lstring & inKey,
            AC_galgas_index_core & outIndex) {
  e_sourceFileMap info  ;
  internalEnterIndex (inKey,
                      (void *) & info,
                      outIndex) ;
}

//---------------------------------------------------------------------------*

GGS_bool GGS_sourceFileMap::
operator_isEqual (const GGS_sourceFileMap & inOperand) const {
  return GGS_bool (isBuilt () && inOperand.isBuilt (), isEqualToMap (inOperand)) ;
}

//---------------------------------------------------------------------------*

GGS_bool GGS_sourceFileMap::
operator_isNotEqual (const GGS_sourceFileMap & inOperand) const {
  return GGS_bool (isBuilt () && inOperand.isBuilt (), ! isEqualToMap (inOperand)) ;
}

//---------------------------------------------------------------------------*

void GGS_sourceFileMap::
internalInsertForDuplication (AC_galgas_map_element * inPtr) {
  MF_Assert (reinterpret_cast <cElement *> (inPtr) != NULL, "Dynamic cast error", 0, 0) ;
  cElement * p = (cElement *) inPtr ;
  PMSInt32 attributeIndex = -1 ; // Unused here
  GGS_location existingKeyLocation ; // Unused here
  internalInsert (p->mKey, (void *) & p->mInfo, attributeIndex, existingKeyLocation) ;
}

//---------------------------------------------------------------------------*

void GGS_sourceFileMap::
insertElement (C_Compiler & inLexique,
                const utf32 * inErrorMessage,
                const GGS_lstring & inKey,
                const GGS_string& inParameter0,
                const GGS_sourceFileKind& inParameter1,
                GGS_luint * outIndex
                COMMA_LOCATION_ARGS) {
  PMSInt32 elementID = - 1 ;
  if (isBuilt ()
   && inParameter0.isBuilt ()
   && inParameter1.isBuilt ()
   && inKey.isBuilt ()) {
    insulateMap () ;
    e_sourceFileMap info  ;
    info.mFullPath = inParameter0 ;
    info.mSourceKind = inParameter1 ;
    GGS_location existingKeyLocation ;
    internalInsert (inKey, (void *) & info, elementID, existingKeyLocation) ;
    if (elementID < 0) {
      emitInsertMapSemanticErrorMessage (inLexique, inKey, inErrorMessage, existingKeyLocation COMMA_THERE) ;
    }
  }
  if (outIndex != NULL) {
    * outIndex = GGS_luint (GGS_uint (elementID >= 0, (PMUInt32) elementID), inKey) ;
  }
}

//---------------------------------------------------------------------------*

void GGS_sourceFileMap::
searchElement (C_Compiler & inLexique,
               const utf32 * inErrorMessage,
               const GGS_lstring & inKey,
               GGS_string  & outParameter0,
               GGS_sourceFileKind  & outParameter1,
               GGS_luint * outIndex
               COMMA_LOCATION_ARGS) const {
  cElement * node = NULL  ;
  if (isBuilt () && inKey.isBuilt ()) {
    AC_galgas_map_element * p = internal_search (inKey.string ()) ;
    MF_Assert ((p == NULL) || (reinterpret_cast <cElement *> (p) != NULL), "Dynamic cast error", 0, 0) ;
    node = (cElement *) p ;
    if (node == NULL) {
      emitMapSemanticErrorMessage (inLexique, inKey, inErrorMessage COMMA_THERE) ;
    }
  }
  if (node == NULL) {
    outParameter0.drop () ;
    outParameter1.drop () ;
    if (outIndex != NULL) {
      outIndex->drop () ;
     }
  }else{
    outParameter0 = node->mInfo.mFullPath ;
    outParameter1 = node->mInfo.mSourceKind ;
    if (outIndex != NULL) {
      * outIndex = GGS_luint (GGS_uint (true, (PMUInt32) node->mID), inKey) ;
    }
  }
}

//---------------------------------------------------------------------------*

const utf32 GGS_sourceFileMap::kSearchMessage_searchKey [] = {
  TO_UNICODE ('t'),
  TO_UNICODE ('h'),
  TO_UNICODE ('e'),
  TO_UNICODE (' '),
  TO_UNICODE ('\''),
  TO_UNICODE ('%'),
  TO_UNICODE ('K'),
  TO_UNICODE ('\''),
  TO_UNICODE (' '),
  TO_UNICODE ('s'),
  TO_UNICODE ('o'),
  TO_UNICODE ('u'),
  TO_UNICODE ('r'),
  TO_UNICODE ('c'),
  TO_UNICODE ('e'),
  TO_UNICODE (' '),
  TO_UNICODE ('b'),
  TO_UNICODE ('a'),
  TO_UNICODE ('s'),
  TO_UNICODE ('e'),
  TO_UNICODE (' '),
  TO_UNICODE ('n'),
  TO_UNICODE ('a'),
  TO_UNICODE ('m'),
  TO_UNICODE ('e'),
  TO_UNICODE (' '),
  TO_UNICODE ('i'),
  TO_UNICODE ('s'),
  TO_UNICODE (' '),
  TO_UNICODE ('n'),
  TO_UNICODE ('o'),
  TO_UNICODE ('t'),
  TO_UNICODE (' '),
  TO_UNICODE ('d'),
  TO_UNICODE ('e'),
  TO_UNICODE ('c'),
  TO_UNICODE ('l'),
  TO_UNICODE ('a'),
  TO_UNICODE ('r'),
  TO_UNICODE ('e'),
  TO_UNICODE ('d'),
  TO_UNICODE (0)
} ;

//---------------------------------------------------------------------------*

void GGS_sourceFileMap::
method_searchKey (C_Compiler & inLexique,
                                const GGS_lstring & inKey,
                                GGS_string  & outParameter0,
                                GGS_sourceFileKind  & outParameter1 COMMA_LOCATION_ARGS) const {
  searchElement (inLexique,
                  kSearchMessage_searchKey,
                  inKey,
                  outParameter0,
                  outParameter1,
                  NULL
                  COMMA_THERE) ;
}

//---------------------------------------------------------------------------*

const utf32 GGS_sourceFileMap::kInsertMessage_insertKey [] = {
  TO_UNICODE ('t'),
  TO_UNICODE ('h'),
  TO_UNICODE ('e'),
  TO_UNICODE (' '),
  TO_UNICODE ('\''),
  TO_UNICODE ('%'),
  TO_UNICODE ('K'),
  TO_UNICODE ('\''),
  TO_UNICODE (' '),
  TO_UNICODE ('s'),
  TO_UNICODE ('o'),
  TO_UNICODE ('u'),
  TO_UNICODE ('r'),
  TO_UNICODE ('c'),
  TO_UNICODE ('e'),
  TO_UNICODE (' '),
  TO_UNICODE ('b'),
  TO_UNICODE ('a'),
  TO_UNICODE ('s'),
  TO_UNICODE ('e'),
  TO_UNICODE (' '),
  TO_UNICODE ('n'),
  TO_UNICODE ('a'),
  TO_UNICODE ('m'),
  TO_UNICODE ('e'),
  TO_UNICODE (' '),
  TO_UNICODE ('h'),
  TO_UNICODE ('a'),
  TO_UNICODE ('s'),
  TO_UNICODE (' '),
  TO_UNICODE ('b'),
  TO_UNICODE ('e'),
  TO_UNICODE ('e'),
  TO_UNICODE ('n'),
  TO_UNICODE (' '),
  TO_UNICODE ('a'),
  TO_UNICODE ('l'),
  TO_UNICODE ('r'),
  TO_UNICODE ('e'),
  TO_UNICODE ('a'),
  TO_UNICODE ('d'),
  TO_UNICODE ('y'),
  TO_UNICODE (' '),
  TO_UNICODE ('d'),
  TO_UNICODE ('e'),
  TO_UNICODE ('c'),
  TO_UNICODE ('l'),
  TO_UNICODE ('a'),
  TO_UNICODE ('r'),
  TO_UNICODE ('e'),
  TO_UNICODE ('d'),
  TO_UNICODE (' '),
  TO_UNICODE ('i'),
  TO_UNICODE ('n'),
  TO_UNICODE (' '),
  TO_UNICODE ('%'),
  TO_UNICODE ('L'),
  TO_UNICODE (0)
} ;

//---------------------------------------------------------------------------*

void GGS_sourceFileMap::
modifier_insertKey (C_Compiler & inLexique,
                                const GGS_lstring & inKey,
                                const GGS_string& inParameter0,
                                const GGS_sourceFileKind& inParameter1 COMMA_LOCATION_ARGS) {
  insertElement (inLexique,
                 kInsertMessage_insertKey,
                 inKey,
                 inParameter0,
                 inParameter1,
                 NULL
                 COMMA_THERE) ;
}

//---------------------------------------------------------------------------*

GGS_sourceFileMap GGS_sourceFileMap::
constructor_mapWithMapToOverride (C_Compiler & /* inLexique */,
                                  const GGS_sourceFileMap & inMapToOverride
                                  COMMA_UNUSED_LOCATION_ARGS) {
  GGS_sourceFileMap result ; // Not Built
  if (inMapToOverride.mSharedMapRoot != NULL) {
    macroValidPointer (inMapToOverride.mSharedMapRoot) ;
    macroMyNew (result.mSharedMapRoot, cMapRoot) ;
    result.mSharedMapRoot->mNextMap = inMapToOverride.mSharedMapRoot ;
    inMapToOverride.mSharedMapRoot->mReferenceCount ++ ;
    result.mSharedMapRoot->mSequenceNumber = inMapToOverride.mSharedMapRoot->mSequenceNumber ;
  }
  return result ;
}

//---------------------------------------------------------------------------*

GGS_sourceFileMap GGS_sourceFileMap::
reader_overriddenMap (C_Compiler & /* inLexique */
                      COMMA_UNUSED_LOCATION_ARGS) const {
  GGS_sourceFileMap result ; // Not Built
  if (mSharedMapRoot != NULL) {
    macroValidPointer (mSharedMapRoot) ;
    result.mSharedMapRoot = mSharedMapRoot->mNextMap ;
    if (result.mSharedMapRoot != NULL) {
      macroValidPointer (result.mSharedMapRoot) ;
      result.mSharedMapRoot->mReferenceCount ++ ;
    }else{
      macroMyNew (result.mSharedMapRoot, cMapRoot) ;
    }
  }
  return result ;
}

//---------------------------------------------------------------------------*

GGS_string GGS_sourceFileMap::
reader_description (const PMSInt32 inIndentation) const {
  C_String s ;
  s << "<map @sourceFileMap " ;
  if (isBuilt ()) {
    s.appendSigned (count ()) ;
    s << " object" << ((count () > 1) ? "s " : " ") ;
    cMapRoot * mapRoot = mSharedMapRoot ;
    PMSInt32 level = 0 ;
    while (mapRoot != NULL) {
      if (level > 0) {
        s << "\n" ;
        s.writeStringMultiple ("| ", inIndentation) ;
        s << "------- level " << cStringWithSigned (level) ;
      }
      macroValidPointer (mapRoot) ;
      cElement * p = (cElement *) mapRoot->mFirstItem ;
      PMSInt32 elementID = 0 ;
      while (p != NULL) {
        macroValidPointer (p) ;
        p->appendForMapDescription (elementID, s, inIndentation) ;
        p = p->nextObject () ;
        elementID ++ ;
      }
      mapRoot = mapRoot->mNextMap ;
      level ++ ;
    }
  }else{
    s << "not built" ;
  }
  s << "\n" ;
  s.writeStringMultiple ("| ", inIndentation) ;
  s << ">" ;
  return GGS_string (true, s) ;
}

//---------------------------------------------------------------------------*

/* const */ GGS_string & GGS_sourceFileMap::cEnumerator::_mFullPath (LOCATION_ARGS) const {
  return ((cElement *) mObjectArray (mCurrentIndex COMMA_THERE))->mInfo.mFullPath ;
}

//---------------------------------------------------------------------------*

/* const */ GGS_sourceFileKind & GGS_sourceFileMap::cEnumerator::_mSourceKind (LOCATION_ARGS) const {
  return ((cElement *) mObjectArray (mCurrentIndex COMMA_THERE))->mInfo.mSourceKind ;
}

//---------------------------------------------------------------------------*

GGS_object GGS_sourceFileMap::reader_object (void) const {
  GGS_object result ;
  if (isBuilt ()) {
    GGS_sourceFileMap * p = NULL ;
    macroMyNew (p, GGS_sourceFileMap (*this)) ;
    result = GGS_object (p) ;
  }
  return result ;
}

//---------------------------------------------------------------------------*

GGS_sourceFileMap GGS_sourceFileMap::castFromObject (C_Compiler & inLexique,
                                   const GGS_object & inObject,
                                   const GGS_location & inErrorLocation
                                   COMMA_LOCATION_ARGS) {
  GGS_sourceFileMap result ;
  const GGS__root * embeddedObject = inObject.embeddedObject () ;
  if (NULL != embeddedObject) {
    const GGS_sourceFileMap * p = dynamic_cast <const GGS_sourceFileMap *> (embeddedObject) ;
    if (NULL != p) {
      result = * p ;
    }else{
      castFromObjectErrorSignaling (inLexique, inErrorLocation, & kTypeDescriptor_GGS_sourceFileMap, embeddedObject COMMA_THERE) ;
    }
  }
  return result ;
}

//---------------------------------------------------------------------------*

const C_galgas_type_descriptorEX * GGS_sourceFileMap::typeDescriptor (void) const {
  return & kTypeDescriptor_GGS_sourceFileMap ;
}

//---------------------------------------------------------------------------*
//                                                                           *
//         Implementation of wrapper 'fileListTemplateFileWrapper'           *
//                                                                           *
//---------------------------------------------------------------------------*

//---------------------------------------------------------------------------*

//--- All files of '' directory

static const cRegularFileWrapper * gWrapperAllFiles_fileListTemplateFileWrapper_0 [1] = {
  NULL
} ;

//---------------------------------------------------------------------------*

//--- All sub-directories of '' directory

static const cDirectoryWrapper * gWrapperAllDirectories_fileListTemplateFileWrapper_0 [1] = {
  NULL
} ;

//---------------------------------------------------------------------------*

//--- Directory ''

const cDirectoryWrapper gWrapperDirectory_0_fileListTemplateFileWrapper (
  "",
  0,
  gWrapperAllFiles_fileListTemplateFileWrapper_0,
  0,
  gWrapperAllDirectories_fileListTemplateFileWrapper_0
) ;

//---------------------------------------------------------------------------*
//                                                                           *
// 'fileListTemplate' template of 'fileListTemplateFileWrapper' filewrapper  *
//                                                                           *
//---------------------------------------------------------------------------*

GGS_string
template_filewrapper_fileListTemplateFileWrapper_fileListTemplate (C_Compiler & /* inLexique */,
                                const GGS_string& var_cas_HAND_CODED_SOURCES_SUB_DIRS,
                                const GGS_string& var_cas_GALGAS_SOURCE_LIST,
                                const GGS_string& var_cas_HAND_CODED_SOURCE_LIST) {
  C_String result ;
  const bool isBuilt = var_cas_HAND_CODED_SOURCES_SUB_DIRS.isBuilt ()
    && var_cas_GALGAS_SOURCE_LIST.isBuilt ()
    && var_cas_HAND_CODED_SOURCE_LIST.isBuilt () ;
  if (isBuilt) {
    result << "#---------------------------------------------------------------*\n"
      "\n"
      "#--- Lib PM directory\n"
      "ifdef LIBPM_PATH_ENV_VAR\n"
      "  LIB_PM_PATH := $(LIBPM_PATH_ENV_VAR)\n"
      "  $(info *** LIBPM path:\"$(LIB_PM_PATH)\" (given by LIBPM_PATH_ENV_VAR environment variable))\n"
      "else\n"
      "  ifeq ($(shell if [ -d ../libpm ] ; then echo 1 ; else echo 0 ; fi), 1) \n"
      "    LIB_PM_PATH := ../libpm\n"
      "    $(info *** LIBPM path:\"$(LIB_PM_PATH)\" (libpm found at this path))\n"
      "  else\n"
      "    ifeq ($(shell if [ -d ../../libpm ] ; then echo 1 ; else echo 0 ; fi), 1) \n"
      "      LIB_PM_PATH := ../../libpm\n"
      "      $(info *** LIBPM path:\"$(LIB_PM_PATH)\" (libpm found at this path))\n"
      "    else\n"
      "      $(error Cannot find libpm: neither ../libpm nor ../../libpm exist, LIBPM_PATH_ENV_VAR environment variable does not exist)\n"
      "      LIB_PM_PATH :=\n"
      "    endif\n"
      "  endif\n"
      "endif\n"
      "\n"
      "#---------------------------------------------------------------*\n"
      "#                                                               *\n"
      "#     Project source files directories                          *\n"
      "#                                                               *\n"
      "#---------------------------------------------------------------*\n"
      "\n"
      "SOURCES_DIR := ../galgas_sources/GALGAS_OUTPUT\n" ;
    result << var_cas_HAND_CODED_SOURCES_SUB_DIRS ;
    result << "\n"
      "\n"
      "#---------------------------------------------------------------*\n"
      "#                                                               *\n"
      "#     Source files names list (without their actual path)       *\n"
      "#                                                               *\n"
      "#---------------------------------------------------------------*\n"
      "\n"
      "SOURCES :=\n"
      "\n"
      "#--- Files from libpm --------------------\n"
      "include $(LIB_PM_PATH)/galgas/galgas_sources_for_makefile.mke\n"
      "\n"
      "#--- Hand-coded files ---------------------\n" ;
    result << var_cas_HAND_CODED_SOURCE_LIST ;
    result << "\n"
      "\n"
      "#--- Files generated by GALGAS ------------\n" ;
    result << var_cas_GALGAS_SOURCE_LIST ;
    result << "\n"
      "\n"
      "#---------------------------------------------------------------*\n" ;
  }
  return GGS_string (isBuilt, result) ;
}

//---------------------------------------------------------------------------*

