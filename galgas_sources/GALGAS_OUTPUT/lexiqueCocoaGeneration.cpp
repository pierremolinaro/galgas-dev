//-----------------------------------------------------------------------------*
//                                                                             *
//                    File 'lexiqueCocoaGeneration.cpp'                      *
//                        Generated by version 2.5.4                         *
//                    december 23th, 2013, at 19h50'52"                      *
//                                                                             *
//-----------------------------------------------------------------------------*

//--- START OF USER ZONE 1


//--- END OF USER ZONE 1

#include "lexiqueCocoaGeneration.h"
#include "galgas2/C_Compiler.h"
#include "galgas2/C_galgas_io.h"
#include "galgas2/C_galgas_CLI_Options.h"
#include "utilities/C_PrologueEpilogue.h"

//-----------------------------------------------------------------------------*


//-----------------------------------------------------------------------------*

#ifndef DO_NOT_GENERATE_CHECKINGS
  #define SOURCE_FILE_AT_LINE(line) "lexiqueCocoaGeneration.gSemantics", line
  #define COMMA_SOURCE_FILE_AT_LINE(line) , SOURCE_FILE_AT_LINE(line)
#else
  #define SOURCE_FILE_AT_LINE(line) 
  #define COMMA_SOURCE_FILE_AT_LINE(line) 
#endif

//-----------------------------------------------------------------------------*
//                                                                             *
//Abstract category reader '@lexicalExpressionAST generateCocoaConditionCode'*
//                                                                             *
//-----------------------------------------------------------------------------*

static TC_UniqueArray <categoryReaderSignature_lexicalExpressionAST_generateCocoaConditionCode> gCategoryReaderTable_lexicalExpressionAST_generateCocoaConditionCode ;

//-----------------------------------------------------------------------------*

void enterCategoryReader_generateCocoaConditionCode (const PMSInt32 inClassIndex,
                                                     categoryReaderSignature_lexicalExpressionAST_generateCocoaConditionCode inReader) {
  gCategoryReaderTable_lexicalExpressionAST_generateCocoaConditionCode.forceObjectAtIndex (inClassIndex, inReader, NULL COMMA_HERE) ;
}

//-----------------------------------------------------------------------------*

static void freeCategoryReader_lexicalExpressionAST_generateCocoaConditionCode (void) {
  gCategoryReaderTable_lexicalExpressionAST_generateCocoaConditionCode.free () ;
}

//-----------------------------------------------------------------------------*

C_PrologueEpilogue gReader_lexicalExpressionAST_generateCocoaConditionCode (NULL,
                                                                            freeCategoryReader_lexicalExpressionAST_generateCocoaConditionCode) ;

//-----------------------------------------------------------------------------*

GALGAS_string callCategoryReader_generateCocoaConditionCode (const cPtr_lexicalExpressionAST * inObject,
                                                             GALGAS_lexiqueAnalysisContext in_inLexiqueAnalysisContext,
                                                             C_Compiler * inCompiler
                                                             COMMA_LOCATION_ARGS) {
  GALGAS_string result ;
//--- Find Reader
  if (NULL != inObject) {
    macroValidSharedObject (inObject, const cPtr_lexicalExpressionAST) ;
    const C_galgas_type_descriptor * info = inObject->classDescriptor () ;
    const PMSInt32 classIndex = info->mSlotID ;
    categoryReaderSignature_lexicalExpressionAST_generateCocoaConditionCode f = NULL ;
    if (classIndex < gCategoryReaderTable_lexicalExpressionAST_generateCocoaConditionCode.count ()) {
      f = gCategoryReaderTable_lexicalExpressionAST_generateCocoaConditionCode (classIndex COMMA_HERE) ;
    }
    if (NULL == f) {
       const C_galgas_type_descriptor * p = info->mSuperclassDescriptor ;
       while ((NULL == f) && (NULL != p)) {
         if (p->mSlotID < gCategoryReaderTable_lexicalExpressionAST_generateCocoaConditionCode.count ()) {
           f = gCategoryReaderTable_lexicalExpressionAST_generateCocoaConditionCode (p->mSlotID COMMA_HERE) ;
         }
         p = p->mSuperclassDescriptor ;
       }
       gCategoryReaderTable_lexicalExpressionAST_generateCocoaConditionCode.forceObjectAtIndex (classIndex, f, NULL COMMA_HERE) ;
    }
    if (NULL == f) {
      fatalError ("FATAL CATEGORY READER CALL ERROR", __FILE__, __LINE__) ;
    }else{
      result = f (inObject, in_inLexiqueAnalysisContext, inCompiler COMMA_THERE) ;
    }
  }
  return result ;
}

//-----------------------------------------------------------------------------*
//                                                                             *
//Overriding category reader '@lexicalOrExpressionAST generateCocoaConditionCode'*
//                                                                             *
//-----------------------------------------------------------------------------*

static GALGAS_string categoryReader_lexicalOrExpressionAST_generateCocoaConditionCode (const cPtr_lexicalExpressionAST * inObject,
                                                                                       GALGAS_lexiqueAnalysisContext inArgument_inLexiqueAnalysisContext,
                                                                                       C_Compiler * inCompiler
                                                                                       COMMA_UNUSED_LOCATION_ARGS) {
  GALGAS_string result_outGeneratedCode ; // Returned variable
  const cPtr_lexicalOrExpressionAST * object = (const cPtr_lexicalOrExpressionAST *) inObject ;
  macroValidSharedObject (object, const cPtr_lexicalOrExpressionAST) ;
  result_outGeneratedCode = callCategoryReader_generateCocoaConditionCode ((const cPtr_lexicalExpressionAST *) object->mAttribute_mLeftOperand.ptr (), inArgument_inLexiqueAnalysisContext, inCompiler COMMA_SOURCE_FILE_AT_LINE (38)) ;
  result_outGeneratedCode.dotAssign_operation (GALGAS_string (" || ") COMMA_SOURCE_FILE_AT_LINE (39)) ;
  result_outGeneratedCode.dotAssign_operation (callCategoryReader_generateCocoaConditionCode ((const cPtr_lexicalExpressionAST *) object->mAttribute_mRightOperand.ptr (), inArgument_inLexiqueAnalysisContext, inCompiler COMMA_SOURCE_FILE_AT_LINE (40)) COMMA_SOURCE_FILE_AT_LINE (40)) ;
//---
  return result_outGeneratedCode ;
}


//-----------------------------------------------------------------------------*

static void defineCategoryReader_lexicalOrExpressionAST_generateCocoaConditionCode (void) {
  enterCategoryReader_generateCocoaConditionCode (kTypeDescriptor_GALGAS_lexicalOrExpressionAST.mSlotID,
                                                  categoryReader_lexicalOrExpressionAST_generateCocoaConditionCode) ;
}

//-----------------------------------------------------------------------------*

C_PrologueEpilogue gReader_lexicalOrExpressionAST_generateCocoaConditionCode (defineCategoryReader_lexicalOrExpressionAST_generateCocoaConditionCode, NULL) ;

//-----------------------------------------------------------------------------*
//                                                                             *
//Overriding category reader '@lexicalCharacterIntervalMatchAST generateCocoaConditionCode'*
//                                                                             *
//-----------------------------------------------------------------------------*

static GALGAS_string categoryReader_lexicalCharacterIntervalMatchAST_generateCocoaConditionCode (const cPtr_lexicalExpressionAST * inObject,
                                                                                                 GALGAS_lexiqueAnalysisContext /* inArgument_inLexiqueAnalysisContext */,
                                                                                                 C_Compiler * /* inCompiler */
                                                                                                 COMMA_UNUSED_LOCATION_ARGS) {
  GALGAS_string result_outGeneratedCode ; // Returned variable
  const cPtr_lexicalCharacterIntervalMatchAST * object = (const cPtr_lexicalCharacterIntervalMatchAST *) inObject ;
  macroValidSharedObject (object, const cPtr_lexicalCharacterIntervalMatchAST) ;
  result_outGeneratedCode = GALGAS_string::makeEmptyString () ;
  result_outGeneratedCode = GALGAS_string ("[self testForInputFromChar:") ;
  result_outGeneratedCode.dotAssign_operation (object->mAttribute_mLowerBound.reader_char (SOURCE_FILE_AT_LINE (51)).reader_uint (SOURCE_FILE_AT_LINE (51)).reader_string (SOURCE_FILE_AT_LINE (51)) COMMA_SOURCE_FILE_AT_LINE (51)) ;
  result_outGeneratedCode.dotAssign_operation (GALGAS_string (" toChar:") COMMA_SOURCE_FILE_AT_LINE (52)) ;
  result_outGeneratedCode.dotAssign_operation (object->mAttribute_mUpperBound.reader_char (SOURCE_FILE_AT_LINE (53)).reader_uint (SOURCE_FILE_AT_LINE (53)).reader_string (SOURCE_FILE_AT_LINE (53)) COMMA_SOURCE_FILE_AT_LINE (53)) ;
  result_outGeneratedCode.dotAssign_operation (GALGAS_string ("]") COMMA_SOURCE_FILE_AT_LINE (54)) ;
//---
  return result_outGeneratedCode ;
}


//-----------------------------------------------------------------------------*

static void defineCategoryReader_lexicalCharacterIntervalMatchAST_generateCocoaConditionCode (void) {
  enterCategoryReader_generateCocoaConditionCode (kTypeDescriptor_GALGAS_lexicalCharacterIntervalMatchAST.mSlotID,
                                                  categoryReader_lexicalCharacterIntervalMatchAST_generateCocoaConditionCode) ;
}

//-----------------------------------------------------------------------------*

C_PrologueEpilogue gReader_lexicalCharacterIntervalMatchAST_generateCocoaConditionCode (defineCategoryReader_lexicalCharacterIntervalMatchAST_generateCocoaConditionCode, NULL) ;

//-----------------------------------------------------------------------------*
//                                                                             *
//Overriding category reader '@lexicalStringMatchAST generateCocoaConditionCode'*
//                                                                             *
//-----------------------------------------------------------------------------*

static GALGAS_string categoryReader_lexicalStringMatchAST_generateCocoaConditionCode (const cPtr_lexicalExpressionAST * inObject,
                                                                                      GALGAS_lexiqueAnalysisContext /* inArgument_inLexiqueAnalysisContext */,
                                                                                      C_Compiler * /* inCompiler */
                                                                                      COMMA_UNUSED_LOCATION_ARGS) {
  GALGAS_string result_outGeneratedCode ; // Returned variable
  const cPtr_lexicalStringMatchAST * object = (const cPtr_lexicalStringMatchAST *) inObject ;
  macroValidSharedObject (object, const cPtr_lexicalStringMatchAST) ;
  result_outGeneratedCode = GALGAS_string ("[self testForInputString:@").operator_concat (object->mAttribute_mString.reader_string (SOURCE_FILE_AT_LINE (63)).reader_utf_38_Representation (SOURCE_FILE_AT_LINE (63)) COMMA_SOURCE_FILE_AT_LINE (63)) ;
  result_outGeneratedCode.dotAssign_operation (GALGAS_string (" advance:YES]") COMMA_SOURCE_FILE_AT_LINE (64)) ;
//---
  return result_outGeneratedCode ;
}


//-----------------------------------------------------------------------------*

static void defineCategoryReader_lexicalStringMatchAST_generateCocoaConditionCode (void) {
  enterCategoryReader_generateCocoaConditionCode (kTypeDescriptor_GALGAS_lexicalStringMatchAST.mSlotID,
                                                  categoryReader_lexicalStringMatchAST_generateCocoaConditionCode) ;
}

//-----------------------------------------------------------------------------*

C_PrologueEpilogue gReader_lexicalStringMatchAST_generateCocoaConditionCode (defineCategoryReader_lexicalStringMatchAST_generateCocoaConditionCode, NULL) ;

//-----------------------------------------------------------------------------*
//                                                                             *
//Overriding category reader '@lexicalStringNotMatchAST generateCocoaConditionCode'*
//                                                                             *
//-----------------------------------------------------------------------------*

static GALGAS_string categoryReader_lexicalStringNotMatchAST_generateCocoaConditionCode (const cPtr_lexicalExpressionAST * inObject,
                                                                                         GALGAS_lexiqueAnalysisContext /* inArgument_inLexiqueAnalysisContext */,
                                                                                         C_Compiler * /* inCompiler */
                                                                                         COMMA_UNUSED_LOCATION_ARGS) {
  GALGAS_string result_outGeneratedCode ; // Returned variable
  const cPtr_lexicalStringNotMatchAST * object = (const cPtr_lexicalStringNotMatchAST *) inObject ;
  macroValidSharedObject (object, const cPtr_lexicalStringNotMatchAST) ;
  result_outGeneratedCode = GALGAS_string ("[self notTestForInputString:@") ;
  result_outGeneratedCode.dotAssign_operation (object->mAttribute_mString.reader_string (SOURCE_FILE_AT_LINE (74)).reader_utf_38_Representation (SOURCE_FILE_AT_LINE (74)) COMMA_SOURCE_FILE_AT_LINE (74)) ;
  result_outGeneratedCode.dotAssign_operation (GALGAS_string (" error:& scanningOk]") COMMA_SOURCE_FILE_AT_LINE (75)) ;
//---
  return result_outGeneratedCode ;
}


//-----------------------------------------------------------------------------*

static void defineCategoryReader_lexicalStringNotMatchAST_generateCocoaConditionCode (void) {
  enterCategoryReader_generateCocoaConditionCode (kTypeDescriptor_GALGAS_lexicalStringNotMatchAST.mSlotID,
                                                  categoryReader_lexicalStringNotMatchAST_generateCocoaConditionCode) ;
}

//-----------------------------------------------------------------------------*

C_PrologueEpilogue gReader_lexicalStringNotMatchAST_generateCocoaConditionCode (defineCategoryReader_lexicalStringNotMatchAST_generateCocoaConditionCode, NULL) ;

//-----------------------------------------------------------------------------*
//                                                                             *
//Overriding category reader '@lexicalCharacterMatchAST generateCocoaConditionCode'*
//                                                                             *
//-----------------------------------------------------------------------------*

static GALGAS_string categoryReader_lexicalCharacterMatchAST_generateCocoaConditionCode (const cPtr_lexicalExpressionAST * inObject,
                                                                                         GALGAS_lexiqueAnalysisContext /* inArgument_inLexiqueAnalysisContext */,
                                                                                         C_Compiler * /* inCompiler */
                                                                                         COMMA_UNUSED_LOCATION_ARGS) {
  GALGAS_string result_outGeneratedCode ; // Returned variable
  const cPtr_lexicalCharacterMatchAST * object = (const cPtr_lexicalCharacterMatchAST *) inObject ;
  macroValidSharedObject (object, const cPtr_lexicalCharacterMatchAST) ;
  result_outGeneratedCode = GALGAS_string ("[self testForInputChar:") ;
  result_outGeneratedCode.dotAssign_operation (object->mAttribute_mCharacter.reader_char (SOURCE_FILE_AT_LINE (85)).reader_uint (SOURCE_FILE_AT_LINE (85)).reader_string (SOURCE_FILE_AT_LINE (85)) COMMA_SOURCE_FILE_AT_LINE (85)) ;
  result_outGeneratedCode.dotAssign_operation (GALGAS_string ("]") COMMA_SOURCE_FILE_AT_LINE (86)) ;
//---
  return result_outGeneratedCode ;
}


//-----------------------------------------------------------------------------*

static void defineCategoryReader_lexicalCharacterMatchAST_generateCocoaConditionCode (void) {
  enterCategoryReader_generateCocoaConditionCode (kTypeDescriptor_GALGAS_lexicalCharacterMatchAST.mSlotID,
                                                  categoryReader_lexicalCharacterMatchAST_generateCocoaConditionCode) ;
}

//-----------------------------------------------------------------------------*

C_PrologueEpilogue gReader_lexicalCharacterMatchAST_generateCocoaConditionCode (defineCategoryReader_lexicalCharacterMatchAST_generateCocoaConditionCode, NULL) ;

//-----------------------------------------------------------------------------*
//                                                                             *
//Overriding category reader '@lexicalCharacterSetMatchAST generateCocoaConditionCode'*
//                                                                             *
//-----------------------------------------------------------------------------*

static GALGAS_string categoryReader_lexicalCharacterSetMatchAST_generateCocoaConditionCode (const cPtr_lexicalExpressionAST * inObject,
                                                                                            GALGAS_lexiqueAnalysisContext /* inArgument_inLexiqueAnalysisContext */,
                                                                                            C_Compiler * /* inCompiler */
                                                                                            COMMA_UNUSED_LOCATION_ARGS) {
  GALGAS_string result_outGeneratedCode ; // Returned variable
  const cPtr_lexicalCharacterSetMatchAST * object = (const cPtr_lexicalCharacterSetMatchAST *) inObject ;
  macroValidSharedObject (object, const cPtr_lexicalCharacterSetMatchAST) ;
  result_outGeneratedCode = GALGAS_string ("[self testForCharWithFunction:") ;
  result_outGeneratedCode.dotAssign_operation (object->mAttribute_mCharacterSetName.reader_string (SOURCE_FILE_AT_LINE (96)) COMMA_SOURCE_FILE_AT_LINE (96)) ;
  result_outGeneratedCode.dotAssign_operation (GALGAS_string ("]") COMMA_SOURCE_FILE_AT_LINE (97)) ;
//---
  return result_outGeneratedCode ;
}


//-----------------------------------------------------------------------------*

static void defineCategoryReader_lexicalCharacterSetMatchAST_generateCocoaConditionCode (void) {
  enterCategoryReader_generateCocoaConditionCode (kTypeDescriptor_GALGAS_lexicalCharacterSetMatchAST.mSlotID,
                                                  categoryReader_lexicalCharacterSetMatchAST_generateCocoaConditionCode) ;
}

//-----------------------------------------------------------------------------*

C_PrologueEpilogue gReader_lexicalCharacterSetMatchAST_generateCocoaConditionCode (defineCategoryReader_lexicalCharacterSetMatchAST_generateCocoaConditionCode, NULL) ;

//-----------------------------------------------------------------------------*
//                                                                             *
//Abstract category reader '@lexicalRoutineOrFunctionFormalInputArgumentAST generateCocoaRoutineOrFunctionArgument'*
//                                                                             *
//-----------------------------------------------------------------------------*

static TC_UniqueArray <categoryReaderSignature_lexicalRoutineOrFunctionFormalInputArgumentAST_generateCocoaRoutineOrFunctionArgument> gCategoryReaderTable_lexicalRoutineOrFunctionFormalInputArgumentAST_generateCocoaRoutineOrFunctionArgument ;

//-----------------------------------------------------------------------------*

void enterCategoryReader_generateCocoaRoutineOrFunctionArgument (const PMSInt32 inClassIndex,
                                                                 categoryReaderSignature_lexicalRoutineOrFunctionFormalInputArgumentAST_generateCocoaRoutineOrFunctionArgument inReader) {
  gCategoryReaderTable_lexicalRoutineOrFunctionFormalInputArgumentAST_generateCocoaRoutineOrFunctionArgument.forceObjectAtIndex (inClassIndex, inReader, NULL COMMA_HERE) ;
}

//-----------------------------------------------------------------------------*

static void freeCategoryReader_lexicalRoutineOrFunctionFormalInputArgumentAST_generateCocoaRoutineOrFunctionArgument (void) {
  gCategoryReaderTable_lexicalRoutineOrFunctionFormalInputArgumentAST_generateCocoaRoutineOrFunctionArgument.free () ;
}

//-----------------------------------------------------------------------------*

C_PrologueEpilogue gReader_lexicalRoutineOrFunctionFormalInputArgumentAST_generateCocoaRoutineOrFunctionArgument (NULL,
                                                                                                                  freeCategoryReader_lexicalRoutineOrFunctionFormalInputArgumentAST_generateCocoaRoutineOrFunctionArgument) ;

//-----------------------------------------------------------------------------*

GALGAS_string callCategoryReader_generateCocoaRoutineOrFunctionArgument (const cPtr_lexicalRoutineOrFunctionFormalInputArgumentAST * inObject,
                                                                         C_Compiler * inCompiler
                                                                         COMMA_LOCATION_ARGS) {
  GALGAS_string result ;
//--- Find Reader
  if (NULL != inObject) {
    macroValidSharedObject (inObject, const cPtr_lexicalRoutineOrFunctionFormalInputArgumentAST) ;
    const C_galgas_type_descriptor * info = inObject->classDescriptor () ;
    const PMSInt32 classIndex = info->mSlotID ;
    categoryReaderSignature_lexicalRoutineOrFunctionFormalInputArgumentAST_generateCocoaRoutineOrFunctionArgument f = NULL ;
    if (classIndex < gCategoryReaderTable_lexicalRoutineOrFunctionFormalInputArgumentAST_generateCocoaRoutineOrFunctionArgument.count ()) {
      f = gCategoryReaderTable_lexicalRoutineOrFunctionFormalInputArgumentAST_generateCocoaRoutineOrFunctionArgument (classIndex COMMA_HERE) ;
    }
    if (NULL == f) {
       const C_galgas_type_descriptor * p = info->mSuperclassDescriptor ;
       while ((NULL == f) && (NULL != p)) {
         if (p->mSlotID < gCategoryReaderTable_lexicalRoutineOrFunctionFormalInputArgumentAST_generateCocoaRoutineOrFunctionArgument.count ()) {
           f = gCategoryReaderTable_lexicalRoutineOrFunctionFormalInputArgumentAST_generateCocoaRoutineOrFunctionArgument (p->mSlotID COMMA_HERE) ;
         }
         p = p->mSuperclassDescriptor ;
       }
       gCategoryReaderTable_lexicalRoutineOrFunctionFormalInputArgumentAST_generateCocoaRoutineOrFunctionArgument.forceObjectAtIndex (classIndex, f, NULL COMMA_HERE) ;
    }
    if (NULL == f) {
      fatalError ("FATAL CATEGORY READER CALL ERROR", __FILE__, __LINE__) ;
    }else{
      result = f (inObject, inCompiler COMMA_THERE) ;
    }
  }
  return result ;
}

//-----------------------------------------------------------------------------*
//                                                                             *
//Overriding category reader '@lexicalAttributeInputArgumentAST generateCocoaRoutineOrFunctionArgument'*
//                                                                             *
//-----------------------------------------------------------------------------*

static GALGAS_string categoryReader_lexicalAttributeInputArgumentAST_generateCocoaRoutineOrFunctionArgument (const cPtr_lexicalRoutineOrFunctionFormalInputArgumentAST * inObject,
                                                                                                             C_Compiler * /* inCompiler */
                                                                                                             COMMA_UNUSED_LOCATION_ARGS) {
  GALGAS_string result_outGeneratedCode ; // Returned variable
  const cPtr_lexicalAttributeInputArgumentAST * object = (const cPtr_lexicalAttributeInputArgumentAST *) inObject ;
  macroValidSharedObject (object, const cPtr_lexicalAttributeInputArgumentAST) ;
  result_outGeneratedCode = GALGAS_string ("mLexicalAttribute_").operator_concat (object->mAttribute_mAttributeName.reader_string (SOURCE_FILE_AT_LINE (113)) COMMA_SOURCE_FILE_AT_LINE (113)) ;
//---
  return result_outGeneratedCode ;
}


//-----------------------------------------------------------------------------*

static void defineCategoryReader_lexicalAttributeInputArgumentAST_generateCocoaRoutineOrFunctionArgument (void) {
  enterCategoryReader_generateCocoaRoutineOrFunctionArgument (kTypeDescriptor_GALGAS_lexicalAttributeInputArgumentAST.mSlotID,
                                                              categoryReader_lexicalAttributeInputArgumentAST_generateCocoaRoutineOrFunctionArgument) ;
}

//-----------------------------------------------------------------------------*

C_PrologueEpilogue gReader_lexicalAttributeInputArgumentAST_generateCocoaRoutineOrFunctionArgument (defineCategoryReader_lexicalAttributeInputArgumentAST_generateCocoaRoutineOrFunctionArgument, NULL) ;

//-----------------------------------------------------------------------------*
//                                                                             *
//Overriding category reader '@lexicalCharacterInputArgumentAST generateCocoaRoutineOrFunctionArgument'*
//                                                                             *
//-----------------------------------------------------------------------------*

static GALGAS_string categoryReader_lexicalCharacterInputArgumentAST_generateCocoaRoutineOrFunctionArgument (const cPtr_lexicalRoutineOrFunctionFormalInputArgumentAST * inObject,
                                                                                                             C_Compiler * /* inCompiler */
                                                                                                             COMMA_UNUSED_LOCATION_ARGS) {
  GALGAS_string result_outGeneratedCode ; // Returned variable
  const cPtr_lexicalCharacterInputArgumentAST * object = (const cPtr_lexicalCharacterInputArgumentAST *) inObject ;
  macroValidSharedObject (object, const cPtr_lexicalCharacterInputArgumentAST) ;
  result_outGeneratedCode = object->mAttribute_mCharacter.reader_char (SOURCE_FILE_AT_LINE (121)).reader_uint (SOURCE_FILE_AT_LINE (121)).reader_string (SOURCE_FILE_AT_LINE (121)) ;
//---
  return result_outGeneratedCode ;
}


//-----------------------------------------------------------------------------*

static void defineCategoryReader_lexicalCharacterInputArgumentAST_generateCocoaRoutineOrFunctionArgument (void) {
  enterCategoryReader_generateCocoaRoutineOrFunctionArgument (kTypeDescriptor_GALGAS_lexicalCharacterInputArgumentAST.mSlotID,
                                                              categoryReader_lexicalCharacterInputArgumentAST_generateCocoaRoutineOrFunctionArgument) ;
}

//-----------------------------------------------------------------------------*

C_PrologueEpilogue gReader_lexicalCharacterInputArgumentAST_generateCocoaRoutineOrFunctionArgument (defineCategoryReader_lexicalCharacterInputArgumentAST_generateCocoaRoutineOrFunctionArgument, NULL) ;

//-----------------------------------------------------------------------------*
//                                                                             *
//Overriding category reader '@lexicalUnsignedInputArgumentAST generateCocoaRoutineOrFunctionArgument'*
//                                                                             *
//-----------------------------------------------------------------------------*

static GALGAS_string categoryReader_lexicalUnsignedInputArgumentAST_generateCocoaRoutineOrFunctionArgument (const cPtr_lexicalRoutineOrFunctionFormalInputArgumentAST * inObject,
                                                                                                            C_Compiler * /* inCompiler */
                                                                                                            COMMA_UNUSED_LOCATION_ARGS) {
  GALGAS_string result_outGeneratedCode ; // Returned variable
  const cPtr_lexicalUnsignedInputArgumentAST * object = (const cPtr_lexicalUnsignedInputArgumentAST *) inObject ;
  macroValidSharedObject (object, const cPtr_lexicalUnsignedInputArgumentAST) ;
  result_outGeneratedCode = object->mAttribute_mUnsigned.reader_uint (SOURCE_FILE_AT_LINE (129)).reader_string (SOURCE_FILE_AT_LINE (129)) ;
//---
  return result_outGeneratedCode ;
}


//-----------------------------------------------------------------------------*

static void defineCategoryReader_lexicalUnsignedInputArgumentAST_generateCocoaRoutineOrFunctionArgument (void) {
  enterCategoryReader_generateCocoaRoutineOrFunctionArgument (kTypeDescriptor_GALGAS_lexicalUnsignedInputArgumentAST.mSlotID,
                                                              categoryReader_lexicalUnsignedInputArgumentAST_generateCocoaRoutineOrFunctionArgument) ;
}

//-----------------------------------------------------------------------------*

C_PrologueEpilogue gReader_lexicalUnsignedInputArgumentAST_generateCocoaRoutineOrFunctionArgument (defineCategoryReader_lexicalUnsignedInputArgumentAST_generateCocoaRoutineOrFunctionArgument, NULL) ;

//-----------------------------------------------------------------------------*
//                                                                             *
//Overriding category reader '@lexicalCurrentCharacterInputArgumentAST generateCocoaRoutineOrFunctionArgument'*
//                                                                             *
//-----------------------------------------------------------------------------*

static GALGAS_string categoryReader_lexicalCurrentCharacterInputArgumentAST_generateCocoaRoutineOrFunctionArgument (const cPtr_lexicalRoutineOrFunctionFormalInputArgumentAST * /* inObject */,
                                                                                                                    C_Compiler * /* inCompiler */
                                                                                                                    COMMA_UNUSED_LOCATION_ARGS) {
  GALGAS_string result_outGeneratedCode ; // Returned variable
  result_outGeneratedCode = GALGAS_string ("mPreviousChar") ;
//---
  return result_outGeneratedCode ;
}


//-----------------------------------------------------------------------------*

static void defineCategoryReader_lexicalCurrentCharacterInputArgumentAST_generateCocoaRoutineOrFunctionArgument (void) {
  enterCategoryReader_generateCocoaRoutineOrFunctionArgument (kTypeDescriptor_GALGAS_lexicalCurrentCharacterInputArgumentAST.mSlotID,
                                                              categoryReader_lexicalCurrentCharacterInputArgumentAST_generateCocoaRoutineOrFunctionArgument) ;
}

//-----------------------------------------------------------------------------*

C_PrologueEpilogue gReader_lexicalCurrentCharacterInputArgumentAST_generateCocoaRoutineOrFunctionArgument (defineCategoryReader_lexicalCurrentCharacterInputArgumentAST_generateCocoaRoutineOrFunctionArgument, NULL) ;

//-----------------------------------------------------------------------------*
//                                                                             *
//Overriding category reader '@lexicalFunctionInputArgumentAST generateCocoaRoutineOrFunctionArgument'*
//                                                                             *
//-----------------------------------------------------------------------------*

static GALGAS_string categoryReader_lexicalFunctionInputArgumentAST_generateCocoaRoutineOrFunctionArgument (const cPtr_lexicalRoutineOrFunctionFormalInputArgumentAST * inObject,
                                                                                                            C_Compiler * inCompiler
                                                                                                            COMMA_UNUSED_LOCATION_ARGS) {
  GALGAS_string result_outGeneratedCode ; // Returned variable
  const cPtr_lexicalFunctionInputArgumentAST * object = (const cPtr_lexicalFunctionInputArgumentAST *) inObject ;
  macroValidSharedObject (object, const cPtr_lexicalFunctionInputArgumentAST) ;
  result_outGeneratedCode = GALGAS_string ("scanner_cocoa_function_").operator_concat (object->mAttribute_mFunctionName.reader_string (SOURCE_FILE_AT_LINE (145)) COMMA_SOURCE_FILE_AT_LINE (145)).operator_concat (GALGAS_string (" (") COMMA_SOURCE_FILE_AT_LINE (145)) ;
  cEnumerator_lexicalFunctionCallActualArgumentListAST enumerator_6196 (object->mAttribute_mFunctionActualArgumentList, kEnumeration_up) ;
  while (enumerator_6196.hasCurrentObject ()) {
    result_outGeneratedCode.dotAssign_operation (callCategoryReader_generateCocoaRoutineOrFunctionArgument ((const cPtr_lexicalRoutineOrFunctionFormalInputArgumentAST *) enumerator_6196.current_mLexicalActualInputArgument (HERE).ptr (), inCompiler COMMA_SOURCE_FILE_AT_LINE (147)) COMMA_SOURCE_FILE_AT_LINE (147)) ;
    if (enumerator_6196.hasNextObject ()) {
      result_outGeneratedCode.dotAssign_operation (GALGAS_string (", ") COMMA_SOURCE_FILE_AT_LINE (148)) ;
    }
    enumerator_6196.gotoNextObject () ;
  }
  result_outGeneratedCode.dotAssign_operation (GALGAS_string (")") COMMA_SOURCE_FILE_AT_LINE (150)) ;
//---
  return result_outGeneratedCode ;
}


//-----------------------------------------------------------------------------*

static void defineCategoryReader_lexicalFunctionInputArgumentAST_generateCocoaRoutineOrFunctionArgument (void) {
  enterCategoryReader_generateCocoaRoutineOrFunctionArgument (kTypeDescriptor_GALGAS_lexicalFunctionInputArgumentAST.mSlotID,
                                                              categoryReader_lexicalFunctionInputArgumentAST_generateCocoaRoutineOrFunctionArgument) ;
}

//-----------------------------------------------------------------------------*

C_PrologueEpilogue gReader_lexicalFunctionInputArgumentAST_generateCocoaRoutineOrFunctionArgument (defineCategoryReader_lexicalFunctionInputArgumentAST_generateCocoaRoutineOrFunctionArgument, NULL) ;

//-----------------------------------------------------------------------------*
//                                                                             *
//Abstract category reader '@abstractLexicalRoutineActualArgumentAST generateCocoaRoutineArgument'*
//                                                                             *
//-----------------------------------------------------------------------------*

static TC_UniqueArray <categoryReaderSignature_abstractLexicalRoutineActualArgumentAST_generateCocoaRoutineArgument> gCategoryReaderTable_abstractLexicalRoutineActualArgumentAST_generateCocoaRoutineArgument ;

//-----------------------------------------------------------------------------*

void enterCategoryReader_generateCocoaRoutineArgument (const PMSInt32 inClassIndex,
                                                       categoryReaderSignature_abstractLexicalRoutineActualArgumentAST_generateCocoaRoutineArgument inReader) {
  gCategoryReaderTable_abstractLexicalRoutineActualArgumentAST_generateCocoaRoutineArgument.forceObjectAtIndex (inClassIndex, inReader, NULL COMMA_HERE) ;
}

//-----------------------------------------------------------------------------*

static void freeCategoryReader_abstractLexicalRoutineActualArgumentAST_generateCocoaRoutineArgument (void) {
  gCategoryReaderTable_abstractLexicalRoutineActualArgumentAST_generateCocoaRoutineArgument.free () ;
}

//-----------------------------------------------------------------------------*

C_PrologueEpilogue gReader_abstractLexicalRoutineActualArgumentAST_generateCocoaRoutineArgument (NULL,
                                                                                                 freeCategoryReader_abstractLexicalRoutineActualArgumentAST_generateCocoaRoutineArgument) ;

//-----------------------------------------------------------------------------*

GALGAS_string callCategoryReader_generateCocoaRoutineArgument (const cPtr_abstractLexicalRoutineActualArgumentAST * inObject,
                                                               GALGAS_lexiqueAnalysisContext in_inLexiqueAnalysisContext,
                                                               C_Compiler * inCompiler
                                                               COMMA_LOCATION_ARGS) {
  GALGAS_string result ;
//--- Find Reader
  if (NULL != inObject) {
    macroValidSharedObject (inObject, const cPtr_abstractLexicalRoutineActualArgumentAST) ;
    const C_galgas_type_descriptor * info = inObject->classDescriptor () ;
    const PMSInt32 classIndex = info->mSlotID ;
    categoryReaderSignature_abstractLexicalRoutineActualArgumentAST_generateCocoaRoutineArgument f = NULL ;
    if (classIndex < gCategoryReaderTable_abstractLexicalRoutineActualArgumentAST_generateCocoaRoutineArgument.count ()) {
      f = gCategoryReaderTable_abstractLexicalRoutineActualArgumentAST_generateCocoaRoutineArgument (classIndex COMMA_HERE) ;
    }
    if (NULL == f) {
       const C_galgas_type_descriptor * p = info->mSuperclassDescriptor ;
       while ((NULL == f) && (NULL != p)) {
         if (p->mSlotID < gCategoryReaderTable_abstractLexicalRoutineActualArgumentAST_generateCocoaRoutineArgument.count ()) {
           f = gCategoryReaderTable_abstractLexicalRoutineActualArgumentAST_generateCocoaRoutineArgument (p->mSlotID COMMA_HERE) ;
         }
         p = p->mSuperclassDescriptor ;
       }
       gCategoryReaderTable_abstractLexicalRoutineActualArgumentAST_generateCocoaRoutineArgument.forceObjectAtIndex (classIndex, f, NULL COMMA_HERE) ;
    }
    if (NULL == f) {
      fatalError ("FATAL CATEGORY READER CALL ERROR", __FILE__, __LINE__) ;
    }else{
      result = f (inObject, in_inLexiqueAnalysisContext, inCompiler COMMA_THERE) ;
    }
  }
  return result ;
}

//-----------------------------------------------------------------------------*
//                                                                             *
//Overriding category reader '@lexicalAttributeInputOutputArgumentAST generateCocoaRoutineArgument'*
//                                                                             *
//-----------------------------------------------------------------------------*

static GALGAS_string categoryReader_lexicalAttributeInputOutputArgumentAST_generateCocoaRoutineArgument (const cPtr_abstractLexicalRoutineActualArgumentAST * inObject,
                                                                                                         GALGAS_lexiqueAnalysisContext inArgument_inLexiqueAnalysisContext,
                                                                                                         C_Compiler * inCompiler
                                                                                                         COMMA_UNUSED_LOCATION_ARGS) {
  GALGAS_string result_outGeneratedCode ; // Returned variable
  const cPtr_lexicalAttributeInputOutputArgumentAST * object = (const cPtr_lexicalAttributeInputOutputArgumentAST *) inObject ;
  macroValidSharedObject (object, const cPtr_lexicalAttributeInputOutputArgumentAST) ;
  GALGAS_lexicalTypeEnum var_lexicalType ;
  inArgument_inLexiqueAnalysisContext.reader_mLexicalAttributeMap (SOURCE_FILE_AT_LINE (169)).method_searchKey (object->mAttribute_mAttributeName, var_lexicalType, inCompiler COMMA_SOURCE_FILE_AT_LINE (169)) ;
  result_outGeneratedCode = GALGAS_string::makeEmptyString () ;
  const enumGalgasBool test_0 = GALGAS_bool (kIsNotEqual, var_lexicalType.objectCompare (GALGAS_lexicalTypeEnum::constructor_lexicalType_5F_string (SOURCE_FILE_AT_LINE (171)))).boolEnum () ;
  if (kBoolTrue == test_0) {
    result_outGeneratedCode.dotAssign_operation (GALGAS_string ("& ") COMMA_SOURCE_FILE_AT_LINE (172)) ;
  }
  result_outGeneratedCode.dotAssign_operation (GALGAS_string ("mLexicalAttribute_").operator_concat (object->mAttribute_mAttributeName.reader_string (SOURCE_FILE_AT_LINE (174)) COMMA_SOURCE_FILE_AT_LINE (174)) COMMA_SOURCE_FILE_AT_LINE (174)) ;
//---
  return result_outGeneratedCode ;
}


//-----------------------------------------------------------------------------*

static void defineCategoryReader_lexicalAttributeInputOutputArgumentAST_generateCocoaRoutineArgument (void) {
  enterCategoryReader_generateCocoaRoutineArgument (kTypeDescriptor_GALGAS_lexicalAttributeInputOutputArgumentAST.mSlotID,
                                                    categoryReader_lexicalAttributeInputOutputArgumentAST_generateCocoaRoutineArgument) ;
}

//-----------------------------------------------------------------------------*

C_PrologueEpilogue gReader_lexicalAttributeInputOutputArgumentAST_generateCocoaRoutineArgument (defineCategoryReader_lexicalAttributeInputOutputArgumentAST_generateCocoaRoutineArgument, NULL) ;

//-----------------------------------------------------------------------------*
//                                                                             *
//Overriding category reader '@lexicalFormalInputArgumentAST generateCocoaRoutineArgument'*
//                                                                             *
//-----------------------------------------------------------------------------*

static GALGAS_string categoryReader_lexicalFormalInputArgumentAST_generateCocoaRoutineArgument (const cPtr_abstractLexicalRoutineActualArgumentAST * inObject,
                                                                                                GALGAS_lexiqueAnalysisContext /* inArgument_inLexiqueAnalysisContext */,
                                                                                                C_Compiler * inCompiler
                                                                                                COMMA_UNUSED_LOCATION_ARGS) {
  GALGAS_string result_outGeneratedCode ; // Returned variable
  const cPtr_lexicalFormalInputArgumentAST * object = (const cPtr_lexicalFormalInputArgumentAST *) inObject ;
  macroValidSharedObject (object, const cPtr_lexicalFormalInputArgumentAST) ;
  result_outGeneratedCode = callCategoryReader_generateCocoaRoutineOrFunctionArgument ((const cPtr_lexicalRoutineOrFunctionFormalInputArgumentAST *) object->mAttribute_mRoutineOrFunctionFormalInputArgument.ptr (), inCompiler COMMA_SOURCE_FILE_AT_LINE (183)) ;
//---
  return result_outGeneratedCode ;
}


//-----------------------------------------------------------------------------*

static void defineCategoryReader_lexicalFormalInputArgumentAST_generateCocoaRoutineArgument (void) {
  enterCategoryReader_generateCocoaRoutineArgument (kTypeDescriptor_GALGAS_lexicalFormalInputArgumentAST.mSlotID,
                                                    categoryReader_lexicalFormalInputArgumentAST_generateCocoaRoutineArgument) ;
}

//-----------------------------------------------------------------------------*

C_PrologueEpilogue gReader_lexicalFormalInputArgumentAST_generateCocoaRoutineArgument (defineCategoryReader_lexicalFormalInputArgumentAST_generateCocoaRoutineArgument, NULL) ;

//-----------------------------------------------------------------------------*
//                                                                             *
//Abstract category reader '@lexicalSendDefaultActionAST generateCocoaDefaultSendCode'*
//                                                                             *
//-----------------------------------------------------------------------------*

static TC_UniqueArray <categoryReaderSignature_lexicalSendDefaultActionAST_generateCocoaDefaultSendCode> gCategoryReaderTable_lexicalSendDefaultActionAST_generateCocoaDefaultSendCode ;

//-----------------------------------------------------------------------------*

void enterCategoryReader_generateCocoaDefaultSendCode (const PMSInt32 inClassIndex,
                                                       categoryReaderSignature_lexicalSendDefaultActionAST_generateCocoaDefaultSendCode inReader) {
  gCategoryReaderTable_lexicalSendDefaultActionAST_generateCocoaDefaultSendCode.forceObjectAtIndex (inClassIndex, inReader, NULL COMMA_HERE) ;
}

//-----------------------------------------------------------------------------*

static void freeCategoryReader_lexicalSendDefaultActionAST_generateCocoaDefaultSendCode (void) {
  gCategoryReaderTable_lexicalSendDefaultActionAST_generateCocoaDefaultSendCode.free () ;
}

//-----------------------------------------------------------------------------*

C_PrologueEpilogue gReader_lexicalSendDefaultActionAST_generateCocoaDefaultSendCode (NULL,
                                                                                     freeCategoryReader_lexicalSendDefaultActionAST_generateCocoaDefaultSendCode) ;

//-----------------------------------------------------------------------------*

GALGAS_string callCategoryReader_generateCocoaDefaultSendCode (const cPtr_lexicalSendDefaultActionAST * inObject,
                                                               GALGAS_string in_inScannerClassName,
                                                               C_Compiler * inCompiler
                                                               COMMA_LOCATION_ARGS) {
  GALGAS_string result ;
//--- Find Reader
  if (NULL != inObject) {
    macroValidSharedObject (inObject, const cPtr_lexicalSendDefaultActionAST) ;
    const C_galgas_type_descriptor * info = inObject->classDescriptor () ;
    const PMSInt32 classIndex = info->mSlotID ;
    categoryReaderSignature_lexicalSendDefaultActionAST_generateCocoaDefaultSendCode f = NULL ;
    if (classIndex < gCategoryReaderTable_lexicalSendDefaultActionAST_generateCocoaDefaultSendCode.count ()) {
      f = gCategoryReaderTable_lexicalSendDefaultActionAST_generateCocoaDefaultSendCode (classIndex COMMA_HERE) ;
    }
    if (NULL == f) {
       const C_galgas_type_descriptor * p = info->mSuperclassDescriptor ;
       while ((NULL == f) && (NULL != p)) {
         if (p->mSlotID < gCategoryReaderTable_lexicalSendDefaultActionAST_generateCocoaDefaultSendCode.count ()) {
           f = gCategoryReaderTable_lexicalSendDefaultActionAST_generateCocoaDefaultSendCode (p->mSlotID COMMA_HERE) ;
         }
         p = p->mSuperclassDescriptor ;
       }
       gCategoryReaderTable_lexicalSendDefaultActionAST_generateCocoaDefaultSendCode.forceObjectAtIndex (classIndex, f, NULL COMMA_HERE) ;
    }
    if (NULL == f) {
      fatalError ("FATAL CATEGORY READER CALL ERROR", __FILE__, __LINE__) ;
    }else{
      result = f (inObject, in_inScannerClassName, inCompiler COMMA_THERE) ;
    }
  }
  return result ;
}

//-----------------------------------------------------------------------------*
//                                                                             *
//Overriding category reader '@lexicalSendTerminalByDefaultAST generateCocoaDefaultSendCode'*
//                                                                             *
//-----------------------------------------------------------------------------*

static GALGAS_string categoryReader_lexicalSendTerminalByDefaultAST_generateCocoaDefaultSendCode (const cPtr_lexicalSendDefaultActionAST * inObject,
                                                                                                  GALGAS_string inArgument_inScannerClassName,
                                                                                                  C_Compiler * /* inCompiler */
                                                                                                  COMMA_UNUSED_LOCATION_ARGS) {
  GALGAS_string result_outGeneratedCode ; // Returned variable
  const cPtr_lexicalSendTerminalByDefaultAST * object = (const cPtr_lexicalSendTerminalByDefaultAST *) inObject ;
  macroValidSharedObject (object, const cPtr_lexicalSendTerminalByDefaultAST) ;
  result_outGeneratedCode = GALGAS_string ("mTokenCode = ").operator_concat (inArgument_inScannerClassName COMMA_SOURCE_FILE_AT_LINE (201)).operator_concat (GALGAS_string ("_1_") COMMA_SOURCE_FILE_AT_LINE (201)).operator_concat (object->mAttribute_mDefaultSentTerminal.reader_string (SOURCE_FILE_AT_LINE (201)).reader_identifierRepresentation (SOURCE_FILE_AT_LINE (201)) COMMA_SOURCE_FILE_AT_LINE (201)).operator_concat (GALGAS_string (" ;\n") COMMA_SOURCE_FILE_AT_LINE (201)) ;
//---
  return result_outGeneratedCode ;
}


//-----------------------------------------------------------------------------*

static void defineCategoryReader_lexicalSendTerminalByDefaultAST_generateCocoaDefaultSendCode (void) {
  enterCategoryReader_generateCocoaDefaultSendCode (kTypeDescriptor_GALGAS_lexicalSendTerminalByDefaultAST.mSlotID,
                                                    categoryReader_lexicalSendTerminalByDefaultAST_generateCocoaDefaultSendCode) ;
}

//-----------------------------------------------------------------------------*

C_PrologueEpilogue gReader_lexicalSendTerminalByDefaultAST_generateCocoaDefaultSendCode (defineCategoryReader_lexicalSendTerminalByDefaultAST_generateCocoaDefaultSendCode, NULL) ;

//-----------------------------------------------------------------------------*
//                                                                             *
//Overriding category reader '@lexicalErrorByDefaultAST generateCocoaDefaultSendCode'*
//                                                                             *
//-----------------------------------------------------------------------------*

static GALGAS_string categoryReader_lexicalErrorByDefaultAST_generateCocoaDefaultSendCode (const cPtr_lexicalSendDefaultActionAST * /* inObject */,
                                                                                           GALGAS_string /* inArgument_inScannerClassName */,
                                                                                           C_Compiler * /* inCompiler */
                                                                                           COMMA_UNUSED_LOCATION_ARGS) {
  GALGAS_string result_outGeneratedCode ; // Returned variable
  result_outGeneratedCode = GALGAS_string ("scanningOk = NO ;\n") ;
//---
  return result_outGeneratedCode ;
}


//-----------------------------------------------------------------------------*

static void defineCategoryReader_lexicalErrorByDefaultAST_generateCocoaDefaultSendCode (void) {
  enterCategoryReader_generateCocoaDefaultSendCode (kTypeDescriptor_GALGAS_lexicalErrorByDefaultAST.mSlotID,
                                                    categoryReader_lexicalErrorByDefaultAST_generateCocoaDefaultSendCode) ;
}

//-----------------------------------------------------------------------------*

C_PrologueEpilogue gReader_lexicalErrorByDefaultAST_generateCocoaDefaultSendCode (defineCategoryReader_lexicalErrorByDefaultAST_generateCocoaDefaultSendCode, NULL) ;

//-----------------------------------------------------------------------------*
//                                                                             *
//Abstract category reader '@lexicalInstructionAST generateCocoaInstructionCode'*
//                                                                             *
//-----------------------------------------------------------------------------*

static TC_UniqueArray <categoryReaderSignature_lexicalInstructionAST_generateCocoaInstructionCode> gCategoryReaderTable_lexicalInstructionAST_generateCocoaInstructionCode ;

//-----------------------------------------------------------------------------*

void enterCategoryReader_generateCocoaInstructionCode (const PMSInt32 inClassIndex,
                                                       categoryReaderSignature_lexicalInstructionAST_generateCocoaInstructionCode inReader) {
  gCategoryReaderTable_lexicalInstructionAST_generateCocoaInstructionCode.forceObjectAtIndex (inClassIndex, inReader, NULL COMMA_HERE) ;
}

//-----------------------------------------------------------------------------*

static void freeCategoryReader_lexicalInstructionAST_generateCocoaInstructionCode (void) {
  gCategoryReaderTable_lexicalInstructionAST_generateCocoaInstructionCode.free () ;
}

//-----------------------------------------------------------------------------*

C_PrologueEpilogue gReader_lexicalInstructionAST_generateCocoaInstructionCode (NULL,
                                                                               freeCategoryReader_lexicalInstructionAST_generateCocoaInstructionCode) ;

//-----------------------------------------------------------------------------*

GALGAS_string callCategoryReader_generateCocoaInstructionCode (const cPtr_lexicalInstructionAST * inObject,
                                                               GALGAS_string in_inScannerClassName,
                                                               GALGAS_lexiqueAnalysisContext in_inLexiqueAnalysisContext,
                                                               C_Compiler * inCompiler
                                                               COMMA_LOCATION_ARGS) {
  GALGAS_string result ;
//--- Find Reader
  if (NULL != inObject) {
    macroValidSharedObject (inObject, const cPtr_lexicalInstructionAST) ;
    const C_galgas_type_descriptor * info = inObject->classDescriptor () ;
    const PMSInt32 classIndex = info->mSlotID ;
    categoryReaderSignature_lexicalInstructionAST_generateCocoaInstructionCode f = NULL ;
    if (classIndex < gCategoryReaderTable_lexicalInstructionAST_generateCocoaInstructionCode.count ()) {
      f = gCategoryReaderTable_lexicalInstructionAST_generateCocoaInstructionCode (classIndex COMMA_HERE) ;
    }
    if (NULL == f) {
       const C_galgas_type_descriptor * p = info->mSuperclassDescriptor ;
       while ((NULL == f) && (NULL != p)) {
         if (p->mSlotID < gCategoryReaderTable_lexicalInstructionAST_generateCocoaInstructionCode.count ()) {
           f = gCategoryReaderTable_lexicalInstructionAST_generateCocoaInstructionCode (p->mSlotID COMMA_HERE) ;
         }
         p = p->mSuperclassDescriptor ;
       }
       gCategoryReaderTable_lexicalInstructionAST_generateCocoaInstructionCode.forceObjectAtIndex (classIndex, f, NULL COMMA_HERE) ;
    }
    if (NULL == f) {
      fatalError ("FATAL CATEGORY READER CALL ERROR", __FILE__, __LINE__) ;
    }else{
      result = f (inObject, in_inScannerClassName, in_inLexiqueAnalysisContext, inCompiler COMMA_THERE) ;
    }
  }
  return result ;
}

//-----------------------------------------------------------------------------*
//                                                                             *
//Overriding category reader '@lexicalStructuredSendInstructionAST generateCocoaInstructionCode'*
//                                                                             *
//-----------------------------------------------------------------------------*

static GALGAS_string categoryReader_lexicalStructuredSendInstructionAST_generateCocoaInstructionCode (const cPtr_lexicalInstructionAST * inObject,
                                                                                                      GALGAS_string inArgument_inScannerClassName,
                                                                                                      GALGAS_lexiqueAnalysisContext /* inArgument_inLexiqueAnalysisContext */,
                                                                                                      C_Compiler * inCompiler
                                                                                                      COMMA_UNUSED_LOCATION_ARGS) {
  GALGAS_string result_outGeneratedCode ; // Returned variable
  const cPtr_lexicalStructuredSendInstructionAST * object = (const cPtr_lexicalStructuredSendInstructionAST *) inObject ;
  macroValidSharedObject (object, const cPtr_lexicalStructuredSendInstructionAST) ;
  result_outGeneratedCode = GALGAS_string::makeEmptyString () ;
  cEnumerator_lexicalSendSearchListAST enumerator_9519 (object->mAttribute_mLexicalSendSearchList, kEnumeration_up) ;
  while (enumerator_9519.hasCurrentObject ()) {
    result_outGeneratedCode.dotAssign_operation (GALGAS_string ("if (mTokenCode == 0) {\n") COMMA_SOURCE_FILE_AT_LINE (232)) ;
    result_outGeneratedCode.dotAssign_operation (GALGAS_string ("  mTokenCode = search_into_").operator_concat (inArgument_inScannerClassName.reader_identifierRepresentation (SOURCE_FILE_AT_LINE (233)) COMMA_SOURCE_FILE_AT_LINE (233)).operator_concat (GALGAS_string ("_") COMMA_SOURCE_FILE_AT_LINE (233)).operator_concat (enumerator_9519.current_mSearchListName (HERE).reader_string (SOURCE_FILE_AT_LINE (233)) COMMA_SOURCE_FILE_AT_LINE (233)).operator_concat (GALGAS_string (" (mLexicalAttribute_") COMMA_SOURCE_FILE_AT_LINE (233)).operator_concat (enumerator_9519.current_mAttributeName (HERE).reader_string (SOURCE_FILE_AT_LINE (233)) COMMA_SOURCE_FILE_AT_LINE (233)).operator_concat (GALGAS_string (") ;\n") COMMA_SOURCE_FILE_AT_LINE (233)) COMMA_SOURCE_FILE_AT_LINE (233)) ;
    result_outGeneratedCode.dotAssign_operation (GALGAS_string ("}\n") COMMA_SOURCE_FILE_AT_LINE (234)) ;
    enumerator_9519.gotoNextObject () ;
  }
  result_outGeneratedCode.dotAssign_operation (GALGAS_string ("if (mTokenCode == 0) {\n") COMMA_SOURCE_FILE_AT_LINE (236)) ;
  result_outGeneratedCode.dotAssign_operation (GALGAS_string ("  ").operator_concat (callCategoryReader_generateCocoaDefaultSendCode ((const cPtr_lexicalSendDefaultActionAST *) object->mAttribute_mLexicalSendDefaultAction.ptr (), inArgument_inScannerClassName, inCompiler COMMA_SOURCE_FILE_AT_LINE (237)) COMMA_SOURCE_FILE_AT_LINE (237)) COMMA_SOURCE_FILE_AT_LINE (237)) ;
  result_outGeneratedCode.dotAssign_operation (GALGAS_string ("}\n") COMMA_SOURCE_FILE_AT_LINE (238)) ;
//---
  return result_outGeneratedCode ;
}


//-----------------------------------------------------------------------------*

static void defineCategoryReader_lexicalStructuredSendInstructionAST_generateCocoaInstructionCode (void) {
  enterCategoryReader_generateCocoaInstructionCode (kTypeDescriptor_GALGAS_lexicalStructuredSendInstructionAST.mSlotID,
                                                    categoryReader_lexicalStructuredSendInstructionAST_generateCocoaInstructionCode) ;
}

//-----------------------------------------------------------------------------*

C_PrologueEpilogue gReader_lexicalStructuredSendInstructionAST_generateCocoaInstructionCode (defineCategoryReader_lexicalStructuredSendInstructionAST_generateCocoaInstructionCode, NULL) ;

//-----------------------------------------------------------------------------*
//                                                                             *
//Overriding category reader '@lexicalSimpleSendInstructionAST generateCocoaInstructionCode'*
//                                                                             *
//-----------------------------------------------------------------------------*

static GALGAS_string categoryReader_lexicalSimpleSendInstructionAST_generateCocoaInstructionCode (const cPtr_lexicalInstructionAST * inObject,
                                                                                                  GALGAS_string inArgument_inScannerClassName,
                                                                                                  GALGAS_lexiqueAnalysisContext /* inArgument_inLexiqueAnalysisContext */,
                                                                                                  C_Compiler * /* inCompiler */
                                                                                                  COMMA_UNUSED_LOCATION_ARGS) {
  GALGAS_string result_outGeneratedCode ; // Returned variable
  const cPtr_lexicalSimpleSendInstructionAST * object = (const cPtr_lexicalSimpleSendInstructionAST *) inObject ;
  macroValidSharedObject (object, const cPtr_lexicalSimpleSendInstructionAST) ;
  result_outGeneratedCode = GALGAS_string ("mTokenCode = ").operator_concat (inArgument_inScannerClassName COMMA_SOURCE_FILE_AT_LINE (248)).operator_concat (GALGAS_string ("_1_") COMMA_SOURCE_FILE_AT_LINE (248)).operator_concat (object->mAttribute_mSentTerminal.reader_string (SOURCE_FILE_AT_LINE (248)).reader_identifierRepresentation (SOURCE_FILE_AT_LINE (248)) COMMA_SOURCE_FILE_AT_LINE (248)).operator_concat (GALGAS_string (" ;\n") COMMA_SOURCE_FILE_AT_LINE (248)) ;
//---
  return result_outGeneratedCode ;
}


//-----------------------------------------------------------------------------*

static void defineCategoryReader_lexicalSimpleSendInstructionAST_generateCocoaInstructionCode (void) {
  enterCategoryReader_generateCocoaInstructionCode (kTypeDescriptor_GALGAS_lexicalSimpleSendInstructionAST.mSlotID,
                                                    categoryReader_lexicalSimpleSendInstructionAST_generateCocoaInstructionCode) ;
}

//-----------------------------------------------------------------------------*

C_PrologueEpilogue gReader_lexicalSimpleSendInstructionAST_generateCocoaInstructionCode (defineCategoryReader_lexicalSimpleSendInstructionAST_generateCocoaInstructionCode, NULL) ;

//-----------------------------------------------------------------------------*
//                                                                             *
//Overriding category reader '@lexicalRepeatInstructionAST generateCocoaInstructionCode'*
//                                                                             *
//-----------------------------------------------------------------------------*

static GALGAS_string categoryReader_lexicalRepeatInstructionAST_generateCocoaInstructionCode (const cPtr_lexicalInstructionAST * inObject,
                                                                                              GALGAS_string inArgument_inScannerClassName,
                                                                                              GALGAS_lexiqueAnalysisContext inArgument_inLexiqueAnalysisContext,
                                                                                              C_Compiler * inCompiler
                                                                                              COMMA_UNUSED_LOCATION_ARGS) {
  GALGAS_string result_outGeneratedCode ; // Returned variable
  const cPtr_lexicalRepeatInstructionAST * object = (const cPtr_lexicalRepeatInstructionAST *) inObject ;
  macroValidSharedObject (object, const cPtr_lexicalRepeatInstructionAST) ;
  result_outGeneratedCode = GALGAS_string ("do {\n") ;
  {
  result_outGeneratedCode.modifier_incIndentation (GALGAS_uint ((PMUInt32) 2U), inCompiler COMMA_SOURCE_FILE_AT_LINE (259)) ;
  }
  cEnumerator_lexicalInstructionListAST enumerator_10832 (object->mAttribute_mRepeatedInstructionList, kEnumeration_up) ;
  while (enumerator_10832.hasCurrentObject ()) {
    result_outGeneratedCode.dotAssign_operation (callCategoryReader_generateCocoaInstructionCode ((const cPtr_lexicalInstructionAST *) enumerator_10832.current_mInstruction (HERE).ptr (), inArgument_inScannerClassName, inArgument_inLexiqueAnalysisContext, inCompiler COMMA_SOURCE_FILE_AT_LINE (262)) COMMA_SOURCE_FILE_AT_LINE (262)) ;
    enumerator_10832.gotoNextObject () ;
  }
  cEnumerator_lexicalWhileBranchListAST enumerator_11006 (object->mAttribute_mLexicalWhileBranchList, kEnumeration_up) ;
  while (enumerator_11006.hasCurrentObject ()) {
    result_outGeneratedCode.dotAssign_operation (GALGAS_string ("if (scanningOk && (") COMMA_SOURCE_FILE_AT_LINE (267)) ;
    result_outGeneratedCode.dotAssign_operation (callCategoryReader_generateCocoaConditionCode ((const cPtr_lexicalExpressionAST *) enumerator_11006.current_mWhileExpression (HERE).ptr (), inArgument_inLexiqueAnalysisContext, inCompiler COMMA_SOURCE_FILE_AT_LINE (268)) COMMA_SOURCE_FILE_AT_LINE (268)) ;
    result_outGeneratedCode.dotAssign_operation (GALGAS_string (")) {\n") COMMA_SOURCE_FILE_AT_LINE (269)) ;
    {
    result_outGeneratedCode.modifier_incIndentation (GALGAS_uint ((PMUInt32) 2U), inCompiler COMMA_SOURCE_FILE_AT_LINE (270)) ;
    }
    cEnumerator_lexicalInstructionListAST enumerator_11271 (enumerator_11006.current_mWhileInstructionList (HERE), kEnumeration_up) ;
    while (enumerator_11271.hasCurrentObject ()) {
      result_outGeneratedCode.dotAssign_operation (callCategoryReader_generateCocoaInstructionCode ((const cPtr_lexicalInstructionAST *) enumerator_11271.current_mInstruction (HERE).ptr (), inArgument_inScannerClassName, inArgument_inLexiqueAnalysisContext, inCompiler COMMA_SOURCE_FILE_AT_LINE (272)) COMMA_SOURCE_FILE_AT_LINE (272)) ;
      enumerator_11271.gotoNextObject () ;
    }
    {
    result_outGeneratedCode.modifier_decIndentation (GALGAS_uint ((PMUInt32) 2U), inCompiler COMMA_SOURCE_FILE_AT_LINE (274)) ;
    }
    if (enumerator_11006.hasNextObject ()) {
      result_outGeneratedCode.dotAssign_operation (GALGAS_string ("}else ") COMMA_SOURCE_FILE_AT_LINE (276)) ;
    }
    enumerator_11006.gotoNextObject () ;
  }
  result_outGeneratedCode.dotAssign_operation (GALGAS_string ("}else{\n"
    "  mLoop = NO ;\n"
    "}\n") COMMA_SOURCE_FILE_AT_LINE (278)) ;
  {
  result_outGeneratedCode.modifier_decIndentation (GALGAS_uint ((PMUInt32) 2U), inCompiler COMMA_SOURCE_FILE_AT_LINE (281)) ;
  }
  result_outGeneratedCode.dotAssign_operation (GALGAS_string ("}while (mLoop && scanningOk) ;\n"
    "mLoop = YES ;\n") COMMA_SOURCE_FILE_AT_LINE (282)) ;
//---
  return result_outGeneratedCode ;
}


//-----------------------------------------------------------------------------*

static void defineCategoryReader_lexicalRepeatInstructionAST_generateCocoaInstructionCode (void) {
  enterCategoryReader_generateCocoaInstructionCode (kTypeDescriptor_GALGAS_lexicalRepeatInstructionAST.mSlotID,
                                                    categoryReader_lexicalRepeatInstructionAST_generateCocoaInstructionCode) ;
}

//-----------------------------------------------------------------------------*

C_PrologueEpilogue gReader_lexicalRepeatInstructionAST_generateCocoaInstructionCode (defineCategoryReader_lexicalRepeatInstructionAST_generateCocoaInstructionCode, NULL) ;

//-----------------------------------------------------------------------------*
//                                                                             *
//Overriding category reader '@lexicalSelectInstructionAST generateCocoaInstructionCode'*
//                                                                             *
//-----------------------------------------------------------------------------*

static GALGAS_string categoryReader_lexicalSelectInstructionAST_generateCocoaInstructionCode (const cPtr_lexicalInstructionAST * inObject,
                                                                                              GALGAS_string inArgument_inScannerClassName,
                                                                                              GALGAS_lexiqueAnalysisContext inArgument_inLexiqueAnalysisContext,
                                                                                              C_Compiler * inCompiler
                                                                                              COMMA_UNUSED_LOCATION_ARGS) {
  GALGAS_string result_outGeneratedCode ; // Returned variable
  const cPtr_lexicalSelectInstructionAST * object = (const cPtr_lexicalSelectInstructionAST *) inObject ;
  macroValidSharedObject (object, const cPtr_lexicalSelectInstructionAST) ;
  result_outGeneratedCode = GALGAS_string::makeEmptyString () ;
  cEnumerator_lexicalSelectBranchListAST enumerator_12110 (object->mAttribute_mLexicalSelectBranchList, kEnumeration_up) ;
  while (enumerator_12110.hasCurrentObject ()) {
    result_outGeneratedCode.dotAssign_operation (GALGAS_string ("if (scanningOk && (") COMMA_SOURCE_FILE_AT_LINE (297)) ;
    result_outGeneratedCode.dotAssign_operation (callCategoryReader_generateCocoaConditionCode ((const cPtr_lexicalExpressionAST *) enumerator_12110.current_mSelectExpression (HERE).ptr (), inArgument_inLexiqueAnalysisContext, inCompiler COMMA_SOURCE_FILE_AT_LINE (298)) COMMA_SOURCE_FILE_AT_LINE (298)) ;
    result_outGeneratedCode.dotAssign_operation (GALGAS_string (")) {\n") COMMA_SOURCE_FILE_AT_LINE (299)) ;
    {
    result_outGeneratedCode.modifier_incIndentation (GALGAS_uint ((PMUInt32) 2U), inCompiler COMMA_SOURCE_FILE_AT_LINE (300)) ;
    }
    cEnumerator_lexicalInstructionListAST enumerator_12377 (enumerator_12110.current_mSelectInstructionList (HERE), kEnumeration_up) ;
    while (enumerator_12377.hasCurrentObject ()) {
      result_outGeneratedCode.dotAssign_operation (callCategoryReader_generateCocoaInstructionCode ((const cPtr_lexicalInstructionAST *) enumerator_12377.current_mInstruction (HERE).ptr (), inArgument_inScannerClassName, inArgument_inLexiqueAnalysisContext, inCompiler COMMA_SOURCE_FILE_AT_LINE (302)) COMMA_SOURCE_FILE_AT_LINE (302)) ;
      enumerator_12377.gotoNextObject () ;
    }
    {
    result_outGeneratedCode.modifier_decIndentation (GALGAS_uint ((PMUInt32) 2U), inCompiler COMMA_SOURCE_FILE_AT_LINE (304)) ;
    }
    if (enumerator_12110.hasNextObject ()) {
      result_outGeneratedCode.dotAssign_operation (GALGAS_string ("}else ") COMMA_SOURCE_FILE_AT_LINE (306)) ;
    }
    enumerator_12110.gotoNextObject () ;
  }
  const enumGalgasBool test_0 = GALGAS_bool (kIsStrictSup, object->mAttribute_mDefaultInstructionList.reader_length (SOURCE_FILE_AT_LINE (309)).objectCompare (GALGAS_uint ((PMUInt32) 0U))).boolEnum () ;
  if (kBoolTrue == test_0) {
    result_outGeneratedCode.dotAssign_operation (GALGAS_string ("}else{\n") COMMA_SOURCE_FILE_AT_LINE (310)) ;
    {
    result_outGeneratedCode.modifier_incIndentation (GALGAS_uint ((PMUInt32) 2U), inCompiler COMMA_SOURCE_FILE_AT_LINE (311)) ;
    }
    cEnumerator_lexicalInstructionListAST enumerator_12807 (object->mAttribute_mDefaultInstructionList, kEnumeration_up) ;
    while (enumerator_12807.hasCurrentObject ()) {
      result_outGeneratedCode.dotAssign_operation (callCategoryReader_generateCocoaInstructionCode ((const cPtr_lexicalInstructionAST *) enumerator_12807.current_mInstruction (HERE).ptr (), inArgument_inScannerClassName, inArgument_inLexiqueAnalysisContext, inCompiler COMMA_SOURCE_FILE_AT_LINE (313)) COMMA_SOURCE_FILE_AT_LINE (313)) ;
      enumerator_12807.gotoNextObject () ;
    }
    {
    result_outGeneratedCode.modifier_decIndentation (GALGAS_uint ((PMUInt32) 2U), inCompiler COMMA_SOURCE_FILE_AT_LINE (315)) ;
    }
  }
  result_outGeneratedCode.dotAssign_operation (GALGAS_string ("}\n") COMMA_SOURCE_FILE_AT_LINE (317)) ;
//---
  return result_outGeneratedCode ;
}


//-----------------------------------------------------------------------------*

static void defineCategoryReader_lexicalSelectInstructionAST_generateCocoaInstructionCode (void) {
  enterCategoryReader_generateCocoaInstructionCode (kTypeDescriptor_GALGAS_lexicalSelectInstructionAST.mSlotID,
                                                    categoryReader_lexicalSelectInstructionAST_generateCocoaInstructionCode) ;
}

//-----------------------------------------------------------------------------*

C_PrologueEpilogue gReader_lexicalSelectInstructionAST_generateCocoaInstructionCode (defineCategoryReader_lexicalSelectInstructionAST_generateCocoaInstructionCode, NULL) ;

//-----------------------------------------------------------------------------*
//                                                                             *
//Overriding category reader '@lexicalRoutineInstructionAST generateCocoaInstructionCode'*
//                                                                             *
//-----------------------------------------------------------------------------*

static GALGAS_string categoryReader_lexicalRoutineInstructionAST_generateCocoaInstructionCode (const cPtr_lexicalInstructionAST * inObject,
                                                                                               GALGAS_string /* inArgument_inScannerClassName */,
                                                                                               GALGAS_lexiqueAnalysisContext inArgument_inLexiqueAnalysisContext,
                                                                                               C_Compiler * inCompiler
                                                                                               COMMA_UNUSED_LOCATION_ARGS) {
  GALGAS_string result_outGeneratedCode ; // Returned variable
  const cPtr_lexicalRoutineInstructionAST * object = (const cPtr_lexicalRoutineInstructionAST *) inObject ;
  macroValidSharedObject (object, const cPtr_lexicalRoutineInstructionAST) ;
  result_outGeneratedCode = GALGAS_string ("scanner_cocoa_routine_").operator_concat (object->mAttribute_mRoutineName.reader_string (SOURCE_FILE_AT_LINE (327)) COMMA_SOURCE_FILE_AT_LINE (327)).operator_concat (GALGAS_string (" (& scanningOk") COMMA_SOURCE_FILE_AT_LINE (327)) ;
  cEnumerator_lexicalRoutineCallActualArgumentListAST enumerator_13434 (object->mAttribute_mActualArgumentList, kEnumeration_up) ;
  while (enumerator_13434.hasCurrentObject ()) {
    result_outGeneratedCode.dotAssign_operation (GALGAS_string (", ").operator_concat (callCategoryReader_generateCocoaRoutineArgument ((const cPtr_abstractLexicalRoutineActualArgumentAST *) enumerator_13434.current_mLexicalRoutineActualArgument (HERE).ptr (), inArgument_inLexiqueAnalysisContext, inCompiler COMMA_SOURCE_FILE_AT_LINE (329)) COMMA_SOURCE_FILE_AT_LINE (329)) COMMA_SOURCE_FILE_AT_LINE (329)) ;
    enumerator_13434.gotoNextObject () ;
  }
  result_outGeneratedCode.dotAssign_operation (GALGAS_string (") ;\n") COMMA_SOURCE_FILE_AT_LINE (331)) ;
//---
  return result_outGeneratedCode ;
}


//-----------------------------------------------------------------------------*

static void defineCategoryReader_lexicalRoutineInstructionAST_generateCocoaInstructionCode (void) {
  enterCategoryReader_generateCocoaInstructionCode (kTypeDescriptor_GALGAS_lexicalRoutineInstructionAST.mSlotID,
                                                    categoryReader_lexicalRoutineInstructionAST_generateCocoaInstructionCode) ;
}

//-----------------------------------------------------------------------------*

C_PrologueEpilogue gReader_lexicalRoutineInstructionAST_generateCocoaInstructionCode (defineCategoryReader_lexicalRoutineInstructionAST_generateCocoaInstructionCode, NULL) ;

//-----------------------------------------------------------------------------*
//                                                                             *
//Overriding category reader '@lexicalDropInstructionAST generateCocoaInstructionCode'*
//                                                                             *
//-----------------------------------------------------------------------------*

static GALGAS_string categoryReader_lexicalDropInstructionAST_generateCocoaInstructionCode (const cPtr_lexicalInstructionAST * inObject,
                                                                                            GALGAS_string inArgument_inScannerClassName,
                                                                                            GALGAS_lexiqueAnalysisContext /* inArgument_inLexiqueAnalysisContext */,
                                                                                            C_Compiler * /* inCompiler */
                                                                                            COMMA_UNUSED_LOCATION_ARGS) {
  GALGAS_string result_outGeneratedCode ; // Returned variable
  const cPtr_lexicalDropInstructionAST * object = (const cPtr_lexicalDropInstructionAST *) inObject ;
  macroValidSharedObject (object, const cPtr_lexicalDropInstructionAST) ;
  result_outGeneratedCode = GALGAS_string ("mTokenCode = ").operator_concat (inArgument_inScannerClassName COMMA_SOURCE_FILE_AT_LINE (341)).operator_concat (GALGAS_string ("_1_") COMMA_SOURCE_FILE_AT_LINE (341)).operator_concat (object->mAttribute_mTerminalName.reader_string (SOURCE_FILE_AT_LINE (341)).reader_identifierRepresentation (SOURCE_FILE_AT_LINE (341)) COMMA_SOURCE_FILE_AT_LINE (341)).operator_concat (GALGAS_string (" ;\n") COMMA_SOURCE_FILE_AT_LINE (341)) ;
//---
  return result_outGeneratedCode ;
}


//-----------------------------------------------------------------------------*

static void defineCategoryReader_lexicalDropInstructionAST_generateCocoaInstructionCode (void) {
  enterCategoryReader_generateCocoaInstructionCode (kTypeDescriptor_GALGAS_lexicalDropInstructionAST.mSlotID,
                                                    categoryReader_lexicalDropInstructionAST_generateCocoaInstructionCode) ;
}

//-----------------------------------------------------------------------------*

C_PrologueEpilogue gReader_lexicalDropInstructionAST_generateCocoaInstructionCode (defineCategoryReader_lexicalDropInstructionAST_generateCocoaInstructionCode, NULL) ;

//-----------------------------------------------------------------------------*
//                                                                             *
//Overriding category reader '@lexicalErrorInstructionAST generateCocoaInstructionCode'*
//                                                                             *
//-----------------------------------------------------------------------------*

static GALGAS_string categoryReader_lexicalErrorInstructionAST_generateCocoaInstructionCode (const cPtr_lexicalInstructionAST * /* inObject */,
                                                                                             GALGAS_string /* inArgument_inScannerClassName */,
                                                                                             GALGAS_lexiqueAnalysisContext /* inArgument_inLexiqueAnalysisContext */,
                                                                                             C_Compiler * /* inCompiler */
                                                                                             COMMA_UNUSED_LOCATION_ARGS) {
  GALGAS_string result_outGeneratedCode ; // Returned variable
  result_outGeneratedCode = GALGAS_string ("scanningOk = NO ;\n") ;
//---
  return result_outGeneratedCode ;
}


//-----------------------------------------------------------------------------*

static void defineCategoryReader_lexicalErrorInstructionAST_generateCocoaInstructionCode (void) {
  enterCategoryReader_generateCocoaInstructionCode (kTypeDescriptor_GALGAS_lexicalErrorInstructionAST.mSlotID,
                                                    categoryReader_lexicalErrorInstructionAST_generateCocoaInstructionCode) ;
}

//-----------------------------------------------------------------------------*

C_PrologueEpilogue gReader_lexicalErrorInstructionAST_generateCocoaInstructionCode (defineCategoryReader_lexicalErrorInstructionAST_generateCocoaInstructionCode, NULL) ;

//-----------------------------------------------------------------------------*
//                                                                             *
//Overriding category reader '@lexicalWarningInstructionAST generateCocoaInstructionCode'*
//                                                                             *
//-----------------------------------------------------------------------------*

static GALGAS_string categoryReader_lexicalWarningInstructionAST_generateCocoaInstructionCode (const cPtr_lexicalInstructionAST * /* inObject */,
                                                                                               GALGAS_string /* inArgument_inScannerClassName */,
                                                                                               GALGAS_lexiqueAnalysisContext /* inArgument_inLexiqueAnalysisContext */,
                                                                                               C_Compiler * /* inCompiler */
                                                                                               COMMA_UNUSED_LOCATION_ARGS) {
  GALGAS_string result_outGeneratedCode ; // Returned variable
  result_outGeneratedCode = GALGAS_string::makeEmptyString () ;
//---
  return result_outGeneratedCode ;
}


//-----------------------------------------------------------------------------*

static void defineCategoryReader_lexicalWarningInstructionAST_generateCocoaInstructionCode (void) {
  enterCategoryReader_generateCocoaInstructionCode (kTypeDescriptor_GALGAS_lexicalWarningInstructionAST.mSlotID,
                                                    categoryReader_lexicalWarningInstructionAST_generateCocoaInstructionCode) ;
}

//-----------------------------------------------------------------------------*

C_PrologueEpilogue gReader_lexicalWarningInstructionAST_generateCocoaInstructionCode (defineCategoryReader_lexicalWarningInstructionAST_generateCocoaInstructionCode, NULL) ;

//-----------------------------------------------------------------------------*
//                                                                             *
//Overriding category reader '@lexicalTagInstructionAST generateCocoaInstructionCode'*
//                                                                             *
//-----------------------------------------------------------------------------*

static GALGAS_string categoryReader_lexicalTagInstructionAST_generateCocoaInstructionCode (const cPtr_lexicalInstructionAST * inObject,
                                                                                           GALGAS_string /* inArgument_inScannerClassName */,
                                                                                           GALGAS_lexiqueAnalysisContext /* inArgument_inLexiqueAnalysisContext */,
                                                                                           C_Compiler * /* inCompiler */
                                                                                           COMMA_UNUSED_LOCATION_ARGS) {
  GALGAS_string result_outGeneratedCode ; // Returned variable
  const cPtr_lexicalTagInstructionAST * object = (const cPtr_lexicalTagInstructionAST *) inObject ;
  macroValidSharedObject (object, const cPtr_lexicalTagInstructionAST) ;
  result_outGeneratedCode = GALGAS_string ("scanningPointStructForCocoa locationForTag_").operator_concat (object->mAttribute_mLexicalTagName.reader_string (SOURCE_FILE_AT_LINE (371)) COMMA_SOURCE_FILE_AT_LINE (371)).operator_concat (GALGAS_string (" ;\n") COMMA_SOURCE_FILE_AT_LINE (371)) ;
  result_outGeneratedCode.dotAssign_operation (GALGAS_string ("[self saveScanningPoint: & locationForTag_").operator_concat (object->mAttribute_mLexicalTagName.reader_string (SOURCE_FILE_AT_LINE (372)) COMMA_SOURCE_FILE_AT_LINE (372)).operator_concat (GALGAS_string ("] ;\n") COMMA_SOURCE_FILE_AT_LINE (372)) COMMA_SOURCE_FILE_AT_LINE (372)) ;
//---
  return result_outGeneratedCode ;
}


//-----------------------------------------------------------------------------*

static void defineCategoryReader_lexicalTagInstructionAST_generateCocoaInstructionCode (void) {
  enterCategoryReader_generateCocoaInstructionCode (kTypeDescriptor_GALGAS_lexicalTagInstructionAST.mSlotID,
                                                    categoryReader_lexicalTagInstructionAST_generateCocoaInstructionCode) ;
}

//-----------------------------------------------------------------------------*

C_PrologueEpilogue gReader_lexicalTagInstructionAST_generateCocoaInstructionCode (defineCategoryReader_lexicalTagInstructionAST_generateCocoaInstructionCode, NULL) ;

//-----------------------------------------------------------------------------*
//                                                                             *
//Overriding category reader '@lexicalRewindInstructionAST generateCocoaInstructionCode'*
//                                                                             *
//-----------------------------------------------------------------------------*

static GALGAS_string categoryReader_lexicalRewindInstructionAST_generateCocoaInstructionCode (const cPtr_lexicalInstructionAST * inObject,
                                                                                              GALGAS_string inArgument_inScannerClassName,
                                                                                              GALGAS_lexiqueAnalysisContext /* inArgument_inLexiqueAnalysisContext */,
                                                                                              C_Compiler * /* inCompiler */
                                                                                              COMMA_UNUSED_LOCATION_ARGS) {
  GALGAS_string result_outGeneratedCode ; // Returned variable
  const cPtr_lexicalRewindInstructionAST * object = (const cPtr_lexicalRewindInstructionAST *) inObject ;
  macroValidSharedObject (object, const cPtr_lexicalRewindInstructionAST) ;
  result_outGeneratedCode = GALGAS_string ("[self restoreScanningPoint: & locationForTag_").operator_concat (object->mAttribute_mLexicalTagName.reader_string (SOURCE_FILE_AT_LINE (382)) COMMA_SOURCE_FILE_AT_LINE (382)).operator_concat (GALGAS_string ("] ;\n") COMMA_SOURCE_FILE_AT_LINE (382)) ;
  result_outGeneratedCode.dotAssign_operation (GALGAS_string ("mTokenCode = ").operator_concat (inArgument_inScannerClassName COMMA_SOURCE_FILE_AT_LINE (383)).operator_concat (GALGAS_string ("_1_") COMMA_SOURCE_FILE_AT_LINE (383)).operator_concat (object->mAttribute_mTerminalName.reader_string (SOURCE_FILE_AT_LINE (383)).reader_identifierRepresentation (SOURCE_FILE_AT_LINE (383)) COMMA_SOURCE_FILE_AT_LINE (383)).operator_concat (GALGAS_string (" ;\n") COMMA_SOURCE_FILE_AT_LINE (383)) COMMA_SOURCE_FILE_AT_LINE (383)) ;
//---
  return result_outGeneratedCode ;
}


//-----------------------------------------------------------------------------*

static void defineCategoryReader_lexicalRewindInstructionAST_generateCocoaInstructionCode (void) {
  enterCategoryReader_generateCocoaInstructionCode (kTypeDescriptor_GALGAS_lexicalRewindInstructionAST.mSlotID,
                                                    categoryReader_lexicalRewindInstructionAST_generateCocoaInstructionCode) ;
}

//-----------------------------------------------------------------------------*

C_PrologueEpilogue gReader_lexicalRewindInstructionAST_generateCocoaInstructionCode (defineCategoryReader_lexicalRewindInstructionAST_generateCocoaInstructionCode, NULL) ;

//-----------------------------------------------------------------------------*
//                                                                             *
//Overriding category reader '@lexicalLogInstructionAST generateCocoaInstructionCode'*
//                                                                             *
//-----------------------------------------------------------------------------*

static GALGAS_string categoryReader_lexicalLogInstructionAST_generateCocoaInstructionCode (const cPtr_lexicalInstructionAST * /* inObject */,
                                                                                           GALGAS_string /* inArgument_inScannerClassName */,
                                                                                           GALGAS_lexiqueAnalysisContext /* inArgument_inLexiqueAnalysisContext */,
                                                                                           C_Compiler * /* inCompiler */
                                                                                           COMMA_UNUSED_LOCATION_ARGS) {
  GALGAS_string result_outGeneratedCode ; // Returned variable
  result_outGeneratedCode = GALGAS_string ("/* lexicalLog (LINE_AND_SOURCE_FILE) ; */\n") ;
//---
  return result_outGeneratedCode ;
}


//-----------------------------------------------------------------------------*

static void defineCategoryReader_lexicalLogInstructionAST_generateCocoaInstructionCode (void) {
  enterCategoryReader_generateCocoaInstructionCode (kTypeDescriptor_GALGAS_lexicalLogInstructionAST.mSlotID,
                                                    categoryReader_lexicalLogInstructionAST_generateCocoaInstructionCode) ;
}

//-----------------------------------------------------------------------------*

C_PrologueEpilogue gReader_lexicalLogInstructionAST_generateCocoaInstructionCode (defineCategoryReader_lexicalLogInstructionAST_generateCocoaInstructionCode, NULL) ;

//-----------------------------------------------------------------------------*
//                                                                             *
//   Abstract category reader '@abstractLexicalRuleAST generateCocoaCode'    *
//                                                                             *
//-----------------------------------------------------------------------------*

static TC_UniqueArray <categoryReaderSignature_abstractLexicalRuleAST_generateCocoaCode> gCategoryReaderTable_abstractLexicalRuleAST_generateCocoaCode ;

//-----------------------------------------------------------------------------*

void enterCategoryReader_generateCocoaCode (const PMSInt32 inClassIndex,
                                            categoryReaderSignature_abstractLexicalRuleAST_generateCocoaCode inReader) {
  gCategoryReaderTable_abstractLexicalRuleAST_generateCocoaCode.forceObjectAtIndex (inClassIndex, inReader, NULL COMMA_HERE) ;
}

//-----------------------------------------------------------------------------*

static void freeCategoryReader_abstractLexicalRuleAST_generateCocoaCode (void) {
  gCategoryReaderTable_abstractLexicalRuleAST_generateCocoaCode.free () ;
}

//-----------------------------------------------------------------------------*

C_PrologueEpilogue gReader_abstractLexicalRuleAST_generateCocoaCode (NULL,
                                                                     freeCategoryReader_abstractLexicalRuleAST_generateCocoaCode) ;

//-----------------------------------------------------------------------------*

GALGAS_string callCategoryReader_generateCocoaCode (const cPtr_abstractLexicalRuleAST * inObject,
                                                    GALGAS_string in_inScannerClassName,
                                                    GALGAS_lexiqueAnalysisContext in_inLexiqueAnalysisContext,
                                                    C_Compiler * inCompiler
                                                    COMMA_LOCATION_ARGS) {
  GALGAS_string result ;
//--- Find Reader
  if (NULL != inObject) {
    macroValidSharedObject (inObject, const cPtr_abstractLexicalRuleAST) ;
    const C_galgas_type_descriptor * info = inObject->classDescriptor () ;
    const PMSInt32 classIndex = info->mSlotID ;
    categoryReaderSignature_abstractLexicalRuleAST_generateCocoaCode f = NULL ;
    if (classIndex < gCategoryReaderTable_abstractLexicalRuleAST_generateCocoaCode.count ()) {
      f = gCategoryReaderTable_abstractLexicalRuleAST_generateCocoaCode (classIndex COMMA_HERE) ;
    }
    if (NULL == f) {
       const C_galgas_type_descriptor * p = info->mSuperclassDescriptor ;
       while ((NULL == f) && (NULL != p)) {
         if (p->mSlotID < gCategoryReaderTable_abstractLexicalRuleAST_generateCocoaCode.count ()) {
           f = gCategoryReaderTable_abstractLexicalRuleAST_generateCocoaCode (p->mSlotID COMMA_HERE) ;
         }
         p = p->mSuperclassDescriptor ;
       }
       gCategoryReaderTable_abstractLexicalRuleAST_generateCocoaCode.forceObjectAtIndex (classIndex, f, NULL COMMA_HERE) ;
    }
    if (NULL == f) {
      fatalError ("FATAL CATEGORY READER CALL ERROR", __FILE__, __LINE__) ;
    }else{
      result = f (inObject, in_inScannerClassName, in_inLexiqueAnalysisContext, inCompiler COMMA_THERE) ;
    }
  }
  return result ;
}

//-----------------------------------------------------------------------------*
//                                                                             *
//  Overriding category reader '@lexicalImplicitRuleAST generateCocoaCode'   *
//                                                                             *
//-----------------------------------------------------------------------------*

static GALGAS_string categoryReader_lexicalImplicitRuleAST_generateCocoaCode (const cPtr_abstractLexicalRuleAST * inObject,
                                                                              GALGAS_string inArgument_inScannerClassName,
                                                                              GALGAS_lexiqueAnalysisContext inArgument_inLexiqueAnalysisContext,
                                                                              C_Compiler * inCompiler
                                                                              COMMA_UNUSED_LOCATION_ARGS) {
  GALGAS_string result_outGeneratedCode ; // Returned variable
  const cPtr_lexicalImplicitRuleAST * object = (const cPtr_lexicalImplicitRuleAST *) inObject ;
  macroValidSharedObject (object, const cPtr_lexicalImplicitRuleAST) ;
  GALGAS_tokenSortedlist var_tokenSortedList ;
  GALGAS_lexicalExplicitTokenListMap joker_16861_0 ; // Joker input parameter
  GALGAS_bool joker_16881_0 ; // Joker input parameter
  inArgument_inLexiqueAnalysisContext.reader_mLexicalTokenListMap (SOURCE_FILE_AT_LINE (414)).method_searchKey (object->mAttribute_mListName, joker_16861_0, var_tokenSortedList, joker_16881_0, inCompiler COMMA_SOURCE_FILE_AT_LINE (414)) ;
  result_outGeneratedCode = GALGAS_string::makeEmptyString () ;
  cEnumerator_tokenSortedlist enumerator_16940 (var_tokenSortedList, kEnumeration_down) ;
  while (enumerator_16940.hasCurrentObject ()) {
    result_outGeneratedCode.dotAssign_operation (GALGAS_string ("if (scanningOk && [self testForInputString:@") COMMA_SOURCE_FILE_AT_LINE (417)) ;
    result_outGeneratedCode.dotAssign_operation (enumerator_16940.current_mName (HERE).reader_utf_38_Representation (SOURCE_FILE_AT_LINE (418)) COMMA_SOURCE_FILE_AT_LINE (418)) ;
    result_outGeneratedCode.dotAssign_operation (GALGAS_string (" advance:YES]) {\n") COMMA_SOURCE_FILE_AT_LINE (419)) ;
    result_outGeneratedCode.dotAssign_operation (GALGAS_string ("  mTokenCode = ").operator_concat (inArgument_inScannerClassName COMMA_SOURCE_FILE_AT_LINE (420)).operator_concat (GALGAS_string ("_1_") COMMA_SOURCE_FILE_AT_LINE (420)).operator_concat (enumerator_16940.current_mTerminalName (HERE).reader_identifierRepresentation (SOURCE_FILE_AT_LINE (420)) COMMA_SOURCE_FILE_AT_LINE (420)).operator_concat (GALGAS_string (" ;\n") COMMA_SOURCE_FILE_AT_LINE (420)) COMMA_SOURCE_FILE_AT_LINE (420)) ;
    result_outGeneratedCode.dotAssign_operation (GALGAS_string ("}else ") COMMA_SOURCE_FILE_AT_LINE (421)) ;
    enumerator_16940.gotoNextObject () ;
  }
//---
  return result_outGeneratedCode ;
}


//-----------------------------------------------------------------------------*

static void defineCategoryReader_lexicalImplicitRuleAST_generateCocoaCode (void) {
  enterCategoryReader_generateCocoaCode (kTypeDescriptor_GALGAS_lexicalImplicitRuleAST.mSlotID,
                                         categoryReader_lexicalImplicitRuleAST_generateCocoaCode) ;
}

//-----------------------------------------------------------------------------*

C_PrologueEpilogue gReader_lexicalImplicitRuleAST_generateCocoaCode (defineCategoryReader_lexicalImplicitRuleAST_generateCocoaCode, NULL) ;

//-----------------------------------------------------------------------------*
//                                                                             *
//  Overriding category reader '@lexicalExplicitRuleAST generateCocoaCode'   *
//                                                                             *
//-----------------------------------------------------------------------------*

static GALGAS_string categoryReader_lexicalExplicitRuleAST_generateCocoaCode (const cPtr_abstractLexicalRuleAST * inObject,
                                                                              GALGAS_string inArgument_inScannerClassName,
                                                                              GALGAS_lexiqueAnalysisContext inArgument_inLexiqueAnalysisContext,
                                                                              C_Compiler * inCompiler
                                                                              COMMA_UNUSED_LOCATION_ARGS) {
  GALGAS_string result_outGeneratedCode ; // Returned variable
  const cPtr_lexicalExplicitRuleAST * object = (const cPtr_lexicalExplicitRuleAST *) inObject ;
  macroValidSharedObject (object, const cPtr_lexicalExplicitRuleAST) ;
  result_outGeneratedCode = GALGAS_string ("if (scanningOk && (") ;
  result_outGeneratedCode.dotAssign_operation (callCategoryReader_generateCocoaConditionCode ((const cPtr_lexicalExpressionAST *) object->mAttribute_mLexicalRuleExpression.ptr (), inArgument_inLexiqueAnalysisContext, inCompiler COMMA_SOURCE_FILE_AT_LINE (433)) COMMA_SOURCE_FILE_AT_LINE (433)) ;
  result_outGeneratedCode.dotAssign_operation (GALGAS_string (")) {\n") COMMA_SOURCE_FILE_AT_LINE (434)) ;
  {
  result_outGeneratedCode.modifier_incIndentation (GALGAS_uint ((PMUInt32) 2U), inCompiler COMMA_SOURCE_FILE_AT_LINE (435)) ;
  }
  cEnumerator_lexicalInstructionListAST enumerator_17808 (object->mAttribute_mInstructionList, kEnumeration_up) ;
  while (enumerator_17808.hasCurrentObject ()) {
    result_outGeneratedCode.dotAssign_operation (callCategoryReader_generateCocoaInstructionCode ((const cPtr_lexicalInstructionAST *) enumerator_17808.current_mInstruction (HERE).ptr (), inArgument_inScannerClassName, inArgument_inLexiqueAnalysisContext, inCompiler COMMA_SOURCE_FILE_AT_LINE (437)) COMMA_SOURCE_FILE_AT_LINE (437)) ;
    enumerator_17808.gotoNextObject () ;
  }
  {
  result_outGeneratedCode.modifier_decIndentation (GALGAS_uint ((PMUInt32) 2U), inCompiler COMMA_SOURCE_FILE_AT_LINE (439)) ;
  }
  result_outGeneratedCode.dotAssign_operation (GALGAS_string ("}else ") COMMA_SOURCE_FILE_AT_LINE (440)) ;
//---
  return result_outGeneratedCode ;
}


//-----------------------------------------------------------------------------*

static void defineCategoryReader_lexicalExplicitRuleAST_generateCocoaCode (void) {
  enterCategoryReader_generateCocoaCode (kTypeDescriptor_GALGAS_lexicalExplicitRuleAST.mSlotID,
                                         categoryReader_lexicalExplicitRuleAST_generateCocoaCode) ;
}

//-----------------------------------------------------------------------------*

C_PrologueEpilogue gReader_lexicalExplicitRuleAST_generateCocoaCode (defineCategoryReader_lexicalExplicitRuleAST_generateCocoaCode, NULL) ;

//--- START OF USER ZONE 2


//--- END OF USER ZONE 2


